/*@!Encoding:1252*/
includes
{
  
  #include "..\PostProcessFiles\DIM\speechDIM.cin"
}
variables
{
  
}
