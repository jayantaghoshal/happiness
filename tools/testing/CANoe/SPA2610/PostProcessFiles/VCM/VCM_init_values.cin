/*@!Encoding:1252*/
on preStart
{
  $FRNetworkStatus = 1;
}

