includes
{
  // Import required CAPL include files
  //--- begin generated part --- Block start #Hdr_Includes#; do not delete this line and do not add application code in this code block!
  /* #ChannelStart# |FR1| #BusStart# |Backbone| */
  /* #ChannelEnd# |FR1| #BusEnd# |Backbone| */
  //--- end generated part --- Block end #Hdr_Includes#; do not delete this line! Add application code below this line.
  //--- begin generated part --- Block start #Body_Includes#; do not delete this line and do not add application code in this code block!
  /* #ChannelStart# |FR1| #BusStart# |Backbone| */
  #include "..\CAPL\SPA-IL-KL30-Helper_FR1.cin"
  #include "..\CAPL\SPACommon_Common.cin"
  #include "..\Nodes\VDDM_Adaptation.cin"
  #include "..\CAPL\SPA-NM-Panel-Helper_FR1.cin"
  #include "..\CAPL\SPA-NM-ASR-Helper_FR1.cin"
  /* #ChannelEnd# |FR1| #BusEnd# |Backbone| */
  //--- end generated part --- Block end #Body_Includes#; do not delete this line! Add application code below this line.
}

variables
{
  // Define global variables for this CAPL file

  /*--- #GenHeader Begin# --- begin generated comment ---
  | Generated on Tuesday, februari 20, 2018, 08:03:58
  | By ModelGenerator for SPA 1.0.0.3, ModelGeneratorSPADLL 3.1.1.0
  | Package SPA 3.0.0
  | Target Bus: Backbone; Channel: FR1; DB Cluster: Backbone;
  | From Database: SPA2610_ConfigurationsSPA_Backbone_171027.xml
  | CANoe Version 9.0.133.0
    --- #GenHeader End  # --- end generated comment --- */

  char gECU[256] = "VDDM";
  //--- begin generated part --- Block start #Hdr_GlobalVariables#; do not delete this line and do not add application code in this code block!
  /* #ChannelStart# |FR1| #BusStart# |Backbone| */
  /* #ChannelEnd# |FR1| #BusEnd# |Backbone| */
  //--- end generated part --- Block end #Hdr_GlobalVariables#; do not delete this line! Add application code below this line.
  //--- begin generated part --- Block start #Body_GlobalVariables#; do not delete this line and do not add application code in this code block!
  /* #ChannelStart# |FR1| #BusStart# |Backbone| */
  char gFR1BusName[256] = "Backbone";
  int gFR1Channel = 1; //// The channel the bus is attached to
  int gFR1TXEnable = 1; //// enable/disable TX of application messages
  /* #ChannelEnd# |FR1| #BusEnd# |Backbone| */
  //--- end generated part --- Block end #Body_GlobalVariables#; do not delete this line! Add application code below this line.
}

on preStart
{
  // Initialize CAPL includes and node's modules/DLLs
  //--- begin generated part --- Block start #Hdr_OnInit#; do not delete this line and do not add application code in this code block!
  /* #ChannelStart# |FR1| #BusStart# |Backbone| */
  /* #ChannelEnd# |FR1| #BusEnd# |Backbone| */
  //--- end generated part --- Block end #Hdr_OnInit#; do not delete this line! Add application code below this line.
  //--- begin generated part --- Block start #Body_OnInit#; do not delete this line and do not add application code in this code block!
  /* #ChannelStart# |FR1| #BusStart# |Backbone| */
  ILFR1_OnInit();
  NMFR1_OnInit();
  /* #ChannelEnd# |FR1| #BusEnd# |Backbone| */
  //--- end generated part --- Block end #Body_OnInit#; do not delete this line! Add application code below this line.
}

on start
{
  // Start CAPL includes and node's modules/DLLs
  //--- begin generated part --- Block start #Hdr_OnStart#; do not delete this line and do not add application code in this code block!
  /* #ChannelStart# |FR1| #BusStart# |Backbone| */
  /* #ChannelEnd# |FR1| #BusEnd# |Backbone| */
  //--- end generated part --- Block end #Hdr_OnStart#; do not delete this line! Add application code below this line.
  //--- begin generated part --- Block start #Body_OnStart#; do not delete this line and do not add application code in this code block!
  /* #ChannelStart# |FR1| #BusStart# |Backbone| */
  ILFR1_OnStart();
  NMFR1_OnStart();
  /* #ChannelEnd# |FR1| #BusEnd# |Backbone| */
  //--- end generated part --- Block end #Body_OnStart#; do not delete this line! Add application code below this line.
}

on FrPOCState
{
  // Possibly propagate FlexRay POC state of interface to the FlexRay bus control
  //--- begin generated part --- Block start #Hdr_OnFrPOCState#; do not delete this line and do not add application code in this code block!
  /* #ChannelStart# |FR1| #BusStart# |Backbone| */
  /* #ChannelEnd# |FR1| #BusEnd# |Backbone| */
  //--- end generated part --- Block end #Hdr_OnFrPOCState#; do not delete this line! Add application code below this line.
  //--- begin generated part --- Block start #Body_OnFrPOCState#; do not delete this line and do not add application code in this code block!
  /* #ChannelStart# |FR1| #BusStart# |Backbone| */
  NMPFR1_ObservePOCState(this.MsgChannel, this.FR_POCState, this.FR_Info2);
  /* #ChannelEnd# |FR1| #BusEnd# |Backbone| */
  //--- end generated part --- Block end #Body_OnFrPOCState#; do not delete this line! Add application code below this line.
}

on FrSymbol
{
  // Possibly propagate FlexRay symbol reception to the FlexRay bus control
  //--- begin generated part --- Block start #Hdr_OnFrSymbol#; do not delete this line and do not add application code in this code block!
  /* #ChannelStart# |FR1| #BusStart# |Backbone| */
  /* #ChannelEnd# |FR1| #BusEnd# |Backbone| */
  //--- end generated part --- Block end #Hdr_OnFrSymbol#; do not delete this line! Add application code below this line.
  //--- begin generated part --- Block start #Body_OnFrSymbol#; do not delete this line and do not add application code in this code block!
  /* #ChannelStart# |FR1| #BusStart# |Backbone| */
  NMPFR1_ObserveSymbol(this.MsgChannel, this.FR_Symbol, this.FR_ChannelMask, this.FR_Length, this.FR_Cycle);
  /* #ChannelEnd# |FR1| #BusEnd# |Backbone| */
  //--- end generated part --- Block end #Body_OnFrSymbol#; do not delete this line! Add application code below this line.
}

on FRFrameError *
{
  // Possibly propagate FlexRay erroneous frame reception to the FlexRay bus control
  //--- begin generated part --- Block start #Hdr_OnFrFrameError#; do not delete this line and do not add application code in this code block!
  /* #ChannelStart# |FR1| #BusStart# |Backbone| */
  /* #ChannelEnd# |FR1| #BusEnd# |Backbone| */
  //--- end generated part --- Block end #Hdr_OnFrFrameError#; do not delete this line! Add application code below this line.
  //--- begin generated part --- Block start #Body_OnFrFrameError#; do not delete this line and do not add application code in this code block!
  /* #ChannelStart# |FR1| #BusStart# |Backbone| */
  NMPFR1_ObserveFrameError(this.MsgChannel, this.FR_ChannelMask, this.FR_SlotID, this.FR_Cycle, this.FR_Status);
  /* #ChannelEnd# |FR1| #BusEnd# |Backbone| */
  //--- end generated part --- Block end #Body_OnFrFrameError#; do not delete this line! Add application code below this line.
}

on preStop
{
  // Prepare stopping
  //--- begin generated part --- Block start #Hdr_OnStopping#; do not delete this line and do not add application code in this code block!
  /* #ChannelStart# |FR1| #BusStart# |Backbone| */
  /* #ChannelEnd# |FR1| #BusEnd# |Backbone| */
  //--- end generated part --- Block end #Hdr_OnStopping#; do not delete this line! Add application code below this line.
  //--- begin generated part --- Block start #Body_OnStopping#; do not delete this line and do not add application code in this code block!
  /* #ChannelStart# |FR1| #BusStart# |Backbone| */
  /* #ChannelEnd# |FR1| #BusEnd# |Backbone| */
  //--- end generated part --- Block end #Body_OnStopping#; do not delete this line! Add application code below this line.
}

on stopMeasurement
{
  // Stop actions
  //--- begin generated part --- Block start #Hdr_OnStop#; do not delete this line and do not add application code in this code block!
  /* #ChannelStart# |FR1| #BusStart# |Backbone| */
  /* #ChannelEnd# |FR1| #BusEnd# |Backbone| */
  //--- end generated part --- Block end #Hdr_OnStop#; do not delete this line! Add application code below this line.
  //--- begin generated part --- Block start #Body_OnStop#; do not delete this line and do not add application code in this code block!
  /* #ChannelStart# |FR1| #BusStart# |Backbone| */
  /* #ChannelEnd# |FR1| #BusEnd# |Backbone| */
  //--- end generated part --- Block end #Body_OnStop#; do not delete this line! Add application code below this line.
}

on sysvar_update sysvar::IL::Ignition
{
  // Handle system state variable
  //--- begin generated part --- Block start #Hdr_KL15_Ignition#; do not delete this line and do not add application code in this code block!
  /* #ChannelStart# |FR1| #BusStart# |Backbone| */
  /* #ChannelEnd# |FR1| #BusEnd# |Backbone| */
  //--- end generated part --- Block end #Hdr_KL15_Ignition#; do not delete this line! Add application code below this line.
  //--- begin generated part --- Block start #Body_KL15_Ignition#; do not delete this line and do not add application code in this code block!
  /* #ChannelStart# |FR1| #BusStart# |Backbone| */
  ILFR1_OnEnvClamp15(@this);
  /* #ChannelEnd# |FR1| #BusEnd# |Backbone| */
  //--- end generated part --- Block end #Body_KL15_Ignition#; do not delete this line! Add application code below this line.
}

on sysvar_update sysvar::IL::Power
{
  // Handle system state variable
  //--- begin generated part --- Block start #Hdr_KL30_Power#; do not delete this line and do not add application code in this code block!
  /* #ChannelStart# |FR1| #BusStart# |Backbone| */
  /* #ChannelEnd# |FR1| #BusEnd# |Backbone| */
  //--- end generated part --- Block end #Hdr_KL30_Power#; do not delete this line! Add application code below this line.
  //--- begin generated part --- Block start #Body_KL30_Power#; do not delete this line and do not add application code in this code block!
  /* #ChannelStart# |FR1| #BusStart# |Backbone| */
  ILFR1_OnEnvClamp30(@this);
  /* #ChannelEnd# |FR1| #BusEnd# |Backbone| */
  //--- end generated part --- Block end #Body_KL30_Power#; do not delete this line! Add application code below this line.
}

on sysvar_update sysvar::_SPAInternal::VIN::VinBlk
{
  //--- begin generated part --- Block start #Hdr_aModulesSignal_VinBlk_VinBlk#; do not delete this line and do not add application code in this code block!
  /* #ChannelStart# |FR1| #BusStart# |Backbone| */
  /* #ChannelEnd# |FR1| #BusEnd# |Backbone| */
  //--- end generated part --- Block end #Hdr_aModulesSignal_VinBlk_VinBlk#; do not delete this line! Add application code below this line.
  //--- begin generated part --- Block start #Body_aModulesSignal_VinBlk_VinBlk#; do not delete this line and do not add application code in this code block!
  /* #ChannelStart# |FR1| #BusStart# |Backbone| */
  /* #ChannelEnd# |FR1| #BusEnd# |Backbone| */
  //--- end generated part --- Block end #Body_aModulesSignal_VinBlk_VinBlk#; do not delete this line! Add application code below this line.
}

on sysvar_update sysvar::_SPAInternal::VIN::VinPosn1
{
  //--- begin generated part --- Block start #Hdr_aModulesSignal_VinPosn1_VinPosn1#; do not delete this line and do not add application code in this code block!
  /* #ChannelStart# |FR1| #BusStart# |Backbone| */
  /* #ChannelEnd# |FR1| #BusEnd# |Backbone| */
  //--- end generated part --- Block end #Hdr_aModulesSignal_VinPosn1_VinPosn1#; do not delete this line! Add application code below this line.
  //--- begin generated part --- Block start #Body_aModulesSignal_VinPosn1_VinPosn1#; do not delete this line and do not add application code in this code block!
  /* #ChannelStart# |FR1| #BusStart# |Backbone| */
  /* #ChannelEnd# |FR1| #BusEnd# |Backbone| */
  //--- end generated part --- Block end #Body_aModulesSignal_VinPosn1_VinPosn1#; do not delete this line! Add application code below this line.
}

on sysvar_update sysvar::_SPAInternal::VIN::VinPosn2
{
  //--- begin generated part --- Block start #Hdr_aModulesSignal_VinPosn2_VinPosn2#; do not delete this line and do not add application code in this code block!
  /* #ChannelStart# |FR1| #BusStart# |Backbone| */
  /* #ChannelEnd# |FR1| #BusEnd# |Backbone| */
  //--- end generated part --- Block end #Hdr_aModulesSignal_VinPosn2_VinPosn2#; do not delete this line! Add application code below this line.
  //--- begin generated part --- Block start #Body_aModulesSignal_VinPosn2_VinPosn2#; do not delete this line and do not add application code in this code block!
  /* #ChannelStart# |FR1| #BusStart# |Backbone| */
  /* #ChannelEnd# |FR1| #BusEnd# |Backbone| */
  //--- end generated part --- Block end #Body_aModulesSignal_VinPosn2_VinPosn2#; do not delete this line! Add application code below this line.
}

on sysvar_update sysvar::_SPAInternal::VIN::VinPosn3
{
  //--- begin generated part --- Block start #Hdr_aModulesSignal_VinPosn3_VinPosn3#; do not delete this line and do not add application code in this code block!
  /* #ChannelStart# |FR1| #BusStart# |Backbone| */
  /* #ChannelEnd# |FR1| #BusEnd# |Backbone| */
  //--- end generated part --- Block end #Hdr_aModulesSignal_VinPosn3_VinPosn3#; do not delete this line! Add application code below this line.
  //--- begin generated part --- Block start #Body_aModulesSignal_VinPosn3_VinPosn3#; do not delete this line and do not add application code in this code block!
  /* #ChannelStart# |FR1| #BusStart# |Backbone| */
  /* #ChannelEnd# |FR1| #BusEnd# |Backbone| */
  //--- end generated part --- Block end #Body_aModulesSignal_VinPosn3_VinPosn3#; do not delete this line! Add application code below this line.
}

on sysvar_update sysvar::_SPAInternal::VIN::VinPosn4
{
  //--- begin generated part --- Block start #Hdr_aModulesSignal_VinPosn4_VinPosn4#; do not delete this line and do not add application code in this code block!
  /* #ChannelStart# |FR1| #BusStart# |Backbone| */
  /* #ChannelEnd# |FR1| #BusEnd# |Backbone| */
  //--- end generated part --- Block end #Hdr_aModulesSignal_VinPosn4_VinPosn4#; do not delete this line! Add application code below this line.
  //--- begin generated part --- Block start #Body_aModulesSignal_VinPosn4_VinPosn4#; do not delete this line and do not add application code in this code block!
  /* #ChannelStart# |FR1| #BusStart# |Backbone| */
  /* #ChannelEnd# |FR1| #BusEnd# |Backbone| */
  //--- end generated part --- Block end #Body_aModulesSignal_VinPosn4_VinPosn4#; do not delete this line! Add application code below this line.
}

on sysvar_update sysvar::_SPAInternal::VIN::VinPosn5
{
  //--- begin generated part --- Block start #Hdr_aModulesSignal_VinPosn5_VinPosn5#; do not delete this line and do not add application code in this code block!
  /* #ChannelStart# |FR1| #BusStart# |Backbone| */
  /* #ChannelEnd# |FR1| #BusEnd# |Backbone| */
  //--- end generated part --- Block end #Hdr_aModulesSignal_VinPosn5_VinPosn5#; do not delete this line! Add application code below this line.
  //--- begin generated part --- Block start #Body_aModulesSignal_VinPosn5_VinPosn5#; do not delete this line and do not add application code in this code block!
  /* #ChannelStart# |FR1| #BusStart# |Backbone| */
  /* #ChannelEnd# |FR1| #BusEnd# |Backbone| */
  //--- end generated part --- Block end #Body_aModulesSignal_VinPosn5_VinPosn5#; do not delete this line! Add application code below this line.
}

on sysvar_update sysvar::_SPAInternal::VIN::VinPosn6
{
  //--- begin generated part --- Block start #Hdr_aModulesSignal_VinPosn6_VinPosn6#; do not delete this line and do not add application code in this code block!
  /* #ChannelStart# |FR1| #BusStart# |Backbone| */
  /* #ChannelEnd# |FR1| #BusEnd# |Backbone| */
  //--- end generated part --- Block end #Hdr_aModulesSignal_VinPosn6_VinPosn6#; do not delete this line! Add application code below this line.
  //--- begin generated part --- Block start #Body_aModulesSignal_VinPosn6_VinPosn6#; do not delete this line and do not add application code in this code block!
  /* #ChannelStart# |FR1| #BusStart# |Backbone| */
  /* #ChannelEnd# |FR1| #BusEnd# |Backbone| */
  //--- end generated part --- Block end #Body_aModulesSignal_VinPosn6_VinPosn6#; do not delete this line! Add application code below this line.
}

on sysvar_update sysvar::_SPAInternal::VIN::VinPosn7
{
  //--- begin generated part --- Block start #Hdr_aModulesSignal_VinPosn7_VinPosn7#; do not delete this line and do not add application code in this code block!
  /* #ChannelStart# |FR1| #BusStart# |Backbone| */
  /* #ChannelEnd# |FR1| #BusEnd# |Backbone| */
  //--- end generated part --- Block end #Hdr_aModulesSignal_VinPosn7_VinPosn7#; do not delete this line! Add application code below this line.
  //--- begin generated part --- Block start #Body_aModulesSignal_VinPosn7_VinPosn7#; do not delete this line and do not add application code in this code block!
  /* #ChannelStart# |FR1| #BusStart# |Backbone| */
  /* #ChannelEnd# |FR1| #BusEnd# |Backbone| */
  //--- end generated part --- Block end #Body_aModulesSignal_VinPosn7_VinPosn7#; do not delete this line! Add application code below this line.
}

on sysvar_update sysvar::_SPAInternal::CarConfig::VehCfgPrmBlk
{
  //--- begin generated part --- Block start #Hdr_aModulesSignal_VehCfgPrmBlk_VehCfgPrmBlk#; do not delete this line and do not add application code in this code block!
  /* #ChannelStart# |FR1| #BusStart# |Backbone| */
  /* #ChannelEnd# |FR1| #BusEnd# |Backbone| */
  //--- end generated part --- Block end #Hdr_aModulesSignal_VehCfgPrmBlk_VehCfgPrmBlk#; do not delete this line! Add application code below this line.
  //--- begin generated part --- Block start #Body_aModulesSignal_VehCfgPrmBlk_VehCfgPrmBlk#; do not delete this line and do not add application code in this code block!
  /* #ChannelStart# |FR1| #BusStart# |Backbone| */
  /* #ChannelEnd# |FR1| #BusEnd# |Backbone| */
  //--- end generated part --- Block end #Body_aModulesSignal_VehCfgPrmBlk_VehCfgPrmBlk#; do not delete this line! Add application code below this line.
}

on sysvar_update sysvar::_SPAInternal::CarConfig::VehCfgPrmVal1
{
  //--- begin generated part --- Block start #Hdr_aModulesSignal_VehCfgPrmVal1_VehCfgPrmVal1#; do not delete this line and do not add application code in this code block!
  /* #ChannelStart# |FR1| #BusStart# |Backbone| */
  /* #ChannelEnd# |FR1| #BusEnd# |Backbone| */
  //--- end generated part --- Block end #Hdr_aModulesSignal_VehCfgPrmVal1_VehCfgPrmVal1#; do not delete this line! Add application code below this line.
  //--- begin generated part --- Block start #Body_aModulesSignal_VehCfgPrmVal1_VehCfgPrmVal1#; do not delete this line and do not add application code in this code block!
  /* #ChannelStart# |FR1| #BusStart# |Backbone| */
  /* #ChannelEnd# |FR1| #BusEnd# |Backbone| */
  //--- end generated part --- Block end #Body_aModulesSignal_VehCfgPrmVal1_VehCfgPrmVal1#; do not delete this line! Add application code below this line.
}

on sysvar_update sysvar::_SPAInternal::CarConfig::VehCfgPrmVal2
{
  //--- begin generated part --- Block start #Hdr_aModulesSignal_VehCfgPrmVal2_VehCfgPrmVal2#; do not delete this line and do not add application code in this code block!
  /* #ChannelStart# |FR1| #BusStart# |Backbone| */
  /* #ChannelEnd# |FR1| #BusEnd# |Backbone| */
  //--- end generated part --- Block end #Hdr_aModulesSignal_VehCfgPrmVal2_VehCfgPrmVal2#; do not delete this line! Add application code below this line.
  //--- begin generated part --- Block start #Body_aModulesSignal_VehCfgPrmVal2_VehCfgPrmVal2#; do not delete this line and do not add application code in this code block!
  /* #ChannelStart# |FR1| #BusStart# |Backbone| */
  /* #ChannelEnd# |FR1| #BusEnd# |Backbone| */
  //--- end generated part --- Block end #Body_aModulesSignal_VehCfgPrmVal2_VehCfgPrmVal2#; do not delete this line! Add application code below this line.
}

on sysvar_update sysvar::_SPAInternal::CarConfig::VehCfgPrmVal3
{
  //--- begin generated part --- Block start #Hdr_aModulesSignal_VehCfgPrmVal3_VehCfgPrmVal3#; do not delete this line and do not add application code in this code block!
  /* #ChannelStart# |FR1| #BusStart# |Backbone| */
  /* #ChannelEnd# |FR1| #BusEnd# |Backbone| */
  //--- end generated part --- Block end #Hdr_aModulesSignal_VehCfgPrmVal3_VehCfgPrmVal3#; do not delete this line! Add application code below this line.
  //--- begin generated part --- Block start #Body_aModulesSignal_VehCfgPrmVal3_VehCfgPrmVal3#; do not delete this line and do not add application code in this code block!
  /* #ChannelStart# |FR1| #BusStart# |Backbone| */
  /* #ChannelEnd# |FR1| #BusEnd# |Backbone| */
  //--- end generated part --- Block end #Body_aModulesSignal_VehCfgPrmVal3_VehCfgPrmVal3#; do not delete this line! Add application code below this line.
}

on sysvar_update sysvar::_SPAInternal::CarConfig::VehCfgPrmVal4
{
  //--- begin generated part --- Block start #Hdr_aModulesSignal_VehCfgPrmVal4_VehCfgPrmVal4#; do not delete this line and do not add application code in this code block!
  /* #ChannelStart# |FR1| #BusStart# |Backbone| */
  /* #ChannelEnd# |FR1| #BusEnd# |Backbone| */
  //--- end generated part --- Block end #Hdr_aModulesSignal_VehCfgPrmVal4_VehCfgPrmVal4#; do not delete this line! Add application code below this line.
  //--- begin generated part --- Block start #Body_aModulesSignal_VehCfgPrmVal4_VehCfgPrmVal4#; do not delete this line and do not add application code in this code block!
  /* #ChannelStart# |FR1| #BusStart# |Backbone| */
  /* #ChannelEnd# |FR1| #BusEnd# |Backbone| */
  //--- end generated part --- Block end #Body_aModulesSignal_VehCfgPrmVal4_VehCfgPrmVal4#; do not delete this line! Add application code below this line.
}

on sysvar_update sysvar::_SPAInternal::CarConfig::VehCfgPrmVal5
{
  //--- begin generated part --- Block start #Hdr_aModulesSignal_VehCfgPrmVal5_VehCfgPrmVal5#; do not delete this line and do not add application code in this code block!
  /* #ChannelStart# |FR1| #BusStart# |Backbone| */
  /* #ChannelEnd# |FR1| #BusEnd# |Backbone| */
  //--- end generated part --- Block end #Hdr_aModulesSignal_VehCfgPrmVal5_VehCfgPrmVal5#; do not delete this line! Add application code below this line.
  //--- begin generated part --- Block start #Body_aModulesSignal_VehCfgPrmVal5_VehCfgPrmVal5#; do not delete this line and do not add application code in this code block!
  /* #ChannelStart# |FR1| #BusStart# |Backbone| */
  /* #ChannelEnd# |FR1| #BusEnd# |Backbone| */
  //--- end generated part --- Block end #Body_aModulesSignal_VehCfgPrmVal5_VehCfgPrmVal5#; do not delete this line! Add application code below this line.
}

on sysvar_update sysvar::_SPAInternal::CarConfig::VehCfgPrmVal6
{
  //--- begin generated part --- Block start #Hdr_aModulesSignal_VehCfgPrmVal6_VehCfgPrmVal6#; do not delete this line and do not add application code in this code block!
  /* #ChannelStart# |FR1| #BusStart# |Backbone| */
  /* #ChannelEnd# |FR1| #BusEnd# |Backbone| */
  //--- end generated part --- Block end #Hdr_aModulesSignal_VehCfgPrmVal6_VehCfgPrmVal6#; do not delete this line! Add application code below this line.
  //--- begin generated part --- Block start #Body_aModulesSignal_VehCfgPrmVal6_VehCfgPrmVal6#; do not delete this line and do not add application code in this code block!
  /* #ChannelStart# |FR1| #BusStart# |Backbone| */
  /* #ChannelEnd# |FR1| #BusEnd# |Backbone| */
  //--- end generated part --- Block end #Body_aModulesSignal_VehCfgPrmVal6_VehCfgPrmVal6#; do not delete this line! Add application code below this line.
}

on sysvar_update sysvar::_SPAInternal::CarConfig::VehCfgPrmVal7
{
  //--- begin generated part --- Block start #Hdr_aModulesSignal_VehCfgPrmVal7_VehCfgPrmVal7#; do not delete this line and do not add application code in this code block!
  /* #ChannelStart# |FR1| #BusStart# |Backbone| */
  /* #ChannelEnd# |FR1| #BusEnd# |Backbone| */
  //--- end generated part --- Block end #Hdr_aModulesSignal_VehCfgPrmVal7_VehCfgPrmVal7#; do not delete this line! Add application code below this line.
  //--- begin generated part --- Block start #Body_aModulesSignal_VehCfgPrmVal7_VehCfgPrmVal7#; do not delete this line and do not add application code in this code block!
  /* #ChannelStart# |FR1| #BusStart# |Backbone| */
  /* #ChannelEnd# |FR1| #BusEnd# |Backbone| */
  //--- end generated part --- Block end #Body_aModulesSignal_VehCfgPrmVal7_VehCfgPrmVal7#; do not delete this line! Add application code below this line.
}

on sysvar_update sysvar::_SPAInternal::CarTiGlb::CarTiGlbValue
{
  //--- begin generated part --- Block start #Hdr_aModulesSignal_CarTiGlb_CarTiGlbValue#; do not delete this line and do not add application code in this code block!
  /* #ChannelStart# |FR1| #BusStart# |Backbone| */
  /* #ChannelEnd# |FR1| #BusEnd# |Backbone| */
  //--- end generated part --- Block end #Hdr_aModulesSignal_CarTiGlb_CarTiGlbValue#; do not delete this line! Add application code below this line.
  //--- begin generated part --- Block start #Body_aModulesSignal_CarTiGlb_CarTiGlbValue#; do not delete this line and do not add application code in this code block!
  /* #ChannelStart# |FR1| #BusStart# |Backbone| */
  /* #ChannelEnd# |FR1| #BusEnd# |Backbone| */
  //--- end generated part --- Block end #Body_aModulesSignal_CarTiGlb_CarTiGlbValue#; do not delete this line! Add application code below this line.
}

on sysvar_update sysvar::_SPACommon::GParVehBattU::VehBattUSysU
{
  //--- begin generated part --- Block start #Hdr_aModulesSignal_VehBattUSysU_VehBattUSysU#; do not delete this line and do not add application code in this code block!
  /* #ChannelStart# |FR1| #BusStart# |Backbone| */
  /* #ChannelEnd# |FR1| #BusEnd# |Backbone| */
  //--- end generated part --- Block end #Hdr_aModulesSignal_VehBattUSysU_VehBattUSysU#; do not delete this line! Add application code below this line.
  //--- begin generated part --- Block start #Body_aModulesSignal_VehBattUSysU_VehBattUSysU#; do not delete this line and do not add application code in this code block!
  /* #ChannelStart# |FR1| #BusStart# |Backbone| */
  /* #ChannelEnd# |FR1| #BusEnd# |Backbone| */
  //--- end generated part --- Block end #Body_aModulesSignal_VehBattUSysU_VehBattUSysU#; do not delete this line! Add application code below this line.
}

on sysvar_update sysvar::_SPACommon::GParTiAndDate::Yr
{
  //--- begin generated part --- Block start #Hdr_aModulesSignal_Yr_Yr#; do not delete this line and do not add application code in this code block!
  /* #ChannelStart# |FR1| #BusStart# |Backbone| */
  /* #ChannelEnd# |FR1| #BusEnd# |Backbone| */
  //--- end generated part --- Block end #Hdr_aModulesSignal_Yr_Yr#; do not delete this line! Add application code below this line.
  //--- begin generated part --- Block start #Body_aModulesSignal_Yr_Yr#; do not delete this line and do not add application code in this code block!
  /* #ChannelStart# |FR1| #BusStart# |Backbone| */
  /* #ChannelEnd# |FR1| #BusEnd# |Backbone| */
  //--- end generated part --- Block end #Body_aModulesSignal_Yr_Yr#; do not delete this line! Add application code below this line.
}

on sysvar_update sysvar::_SPACommon::GParTiAndDate::Mth
{
  //--- begin generated part --- Block start #Hdr_aModulesSignal_Mth_Mth#; do not delete this line and do not add application code in this code block!
  /* #ChannelStart# |FR1| #BusStart# |Backbone| */
  /* #ChannelEnd# |FR1| #BusEnd# |Backbone| */
  //--- end generated part --- Block end #Hdr_aModulesSignal_Mth_Mth#; do not delete this line! Add application code below this line.
  //--- begin generated part --- Block start #Body_aModulesSignal_Mth_Mth#; do not delete this line and do not add application code in this code block!
  /* #ChannelStart# |FR1| #BusStart# |Backbone| */
  /* #ChannelEnd# |FR1| #BusEnd# |Backbone| */
  //--- end generated part --- Block end #Body_aModulesSignal_Mth_Mth#; do not delete this line! Add application code below this line.
}

on sysvar_update sysvar::_SPACommon::GParTiAndDate::Day
{
  //--- begin generated part --- Block start #Hdr_aModulesSignal_Day_Day#; do not delete this line and do not add application code in this code block!
  /* #ChannelStart# |FR1| #BusStart# |Backbone| */
  /* #ChannelEnd# |FR1| #BusEnd# |Backbone| */
  //--- end generated part --- Block end #Hdr_aModulesSignal_Day_Day#; do not delete this line! Add application code below this line.
  //--- begin generated part --- Block start #Body_aModulesSignal_Day_Day#; do not delete this line and do not add application code in this code block!
  /* #ChannelStart# |FR1| #BusStart# |Backbone| */
  /* #ChannelEnd# |FR1| #BusEnd# |Backbone| */
  //--- end generated part --- Block end #Body_aModulesSignal_Day_Day#; do not delete this line! Add application code below this line.
}

on sysvar_update sysvar::_SPACommon::GParTiAndDate::Hr
{
  //--- begin generated part --- Block start #Hdr_aModulesSignal_Hr_Hr#; do not delete this line and do not add application code in this code block!
  /* #ChannelStart# |FR1| #BusStart# |Backbone| */
  /* #ChannelEnd# |FR1| #BusEnd# |Backbone| */
  //--- end generated part --- Block end #Hdr_aModulesSignal_Hr_Hr#; do not delete this line! Add application code below this line.
  //--- begin generated part --- Block start #Body_aModulesSignal_Hr_Hr#; do not delete this line and do not add application code in this code block!
  /* #ChannelStart# |FR1| #BusStart# |Backbone| */
  /* #ChannelEnd# |FR1| #BusEnd# |Backbone| */
  //--- end generated part --- Block end #Body_aModulesSignal_Hr_Hr#; do not delete this line! Add application code below this line.
}

on sysvar_update sysvar::_SPACommon::GParTiAndDate::Mins
{
  //--- begin generated part --- Block start #Hdr_aModulesSignal_Mins_Mins#; do not delete this line and do not add application code in this code block!
  /* #ChannelStart# |FR1| #BusStart# |Backbone| */
  /* #ChannelEnd# |FR1| #BusEnd# |Backbone| */
  //--- end generated part --- Block end #Hdr_aModulesSignal_Mins_Mins#; do not delete this line! Add application code below this line.
  //--- begin generated part --- Block start #Body_aModulesSignal_Mins_Mins#; do not delete this line and do not add application code in this code block!
  /* #ChannelStart# |FR1| #BusStart# |Backbone| */
  /* #ChannelEnd# |FR1| #BusEnd# |Backbone| */
  //--- end generated part --- Block end #Body_aModulesSignal_Mins_Mins#; do not delete this line! Add application code below this line.
}

on sysvar_update sysvar::_SPACommon::GParTiAndDate::Sec
{
  //--- begin generated part --- Block start #Hdr_aModulesSignal_Sec_Sec#; do not delete this line and do not add application code in this code block!
  /* #ChannelStart# |FR1| #BusStart# |Backbone| */
  /* #ChannelEnd# |FR1| #BusEnd# |Backbone| */
  //--- end generated part --- Block end #Hdr_aModulesSignal_Sec_Sec#; do not delete this line! Add application code below this line.
  //--- begin generated part --- Block start #Body_aModulesSignal_Sec_Sec#; do not delete this line and do not add application code in this code block!
  /* #ChannelStart# |FR1| #BusStart# |Backbone| */
  /* #ChannelEnd# |FR1| #BusEnd# |Backbone| */
  //--- end generated part --- Block end #Body_aModulesSignal_Sec_Sec#; do not delete this line! Add application code below this line.
}

on sysvar_update sysvar::_SPACommon::GParTiAndDate::TiAndDateVld
{
  //--- begin generated part --- Block start #Hdr_aModulesSignal_TiAndDateVld_TiAndDateVld#; do not delete this line and do not add application code in this code block!
  /* #ChannelStart# |FR1| #BusStart# |Backbone| */
  /* #ChannelEnd# |FR1| #BusEnd# |Backbone| */
  //--- end generated part --- Block end #Hdr_aModulesSignal_TiAndDateVld_TiAndDateVld#; do not delete this line! Add application code below this line.
  //--- begin generated part --- Block start #Body_aModulesSignal_TiAndDateVld_TiAndDateVld#; do not delete this line and do not add application code in this code block!
  /* #ChannelStart# |FR1| #BusStart# |Backbone| */
  /* #ChannelEnd# |FR1| #BusEnd# |Backbone| */
  //--- end generated part --- Block end #Body_aModulesSignal_TiAndDateVld_TiAndDateVld#; do not delete this line! Add application code below this line.
}

on sysvar_update sysvar::IL::UBPlugNPlay
{
  // Handle system state variable
  //--- begin generated part --- Block start #Hdr_UBOpMode_UBPlugNPlay#; do not delete this line and do not add application code in this code block!
  /* #ChannelStart# |FR1| #BusStart# |Backbone| */
  /* #ChannelEnd# |FR1| #BusEnd# |Backbone| */
  //--- end generated part --- Block end #Hdr_UBOpMode_UBPlugNPlay#; do not delete this line! Add application code below this line.
  //--- begin generated part --- Block start #Body_UBOpMode_UBPlugNPlay#; do not delete this line and do not add application code in this code block!
  /* #ChannelStart# |FR1| #BusStart# |Backbone| */
  /* #ChannelEnd# |FR1| #BusEnd# |Backbone| */
  //--- end generated part --- Block end #Body_UBOpMode_UBPlugNPlay#; do not delete this line! Add application code below this line.
}

void Nm_NetworkStartInd()
{
  // Callback of CAN AUTOSAR NM DLL
  dword lBusContext;
  //--- begin generated part --- Block start #Hdr_Nm_NetworkStartInd#; do not delete this line and do not add application code in this code block!
  /* #ChannelStart# |FR1| #BusStart# |Backbone| */
  /* #ChannelEnd# |FR1| #BusEnd# |Backbone| */
  //--- end generated part --- Block end #Hdr_Nm_NetworkStartInd#; do not delete this line! Add application code below this line.
  lBusContext = GetBusContext();
  //--- begin generated part --- Block start #Body_Nm_NetworkStartInd#; do not delete this line and do not add application code in this code block!
  /* #ChannelStart# |FR1| #BusStart# |Backbone| */
  /* #ChannelEnd# |FR1| #BusEnd# |Backbone| */
  //--- end generated part --- Block end #Body_Nm_NetworkStartInd#; do not delete this line! Add application code below this line.
  SetBusContext(lBusContext);
}

void Nm_NetworkModeInd()
{
  // Callback of CAN AUTOSAR NM DLL
  dword lBusContext;
  //--- begin generated part --- Block start #Hdr_Nm_NetworkModeInd#; do not delete this line and do not add application code in this code block!
  /* #ChannelStart# |FR1| #BusStart# |Backbone| */
  /* #ChannelEnd# |FR1| #BusEnd# |Backbone| */
  //--- end generated part --- Block end #Hdr_Nm_NetworkModeInd#; do not delete this line! Add application code below this line.
  lBusContext = GetBusContext();
  //--- begin generated part --- Block start #Body_Nm_NetworkModeInd#; do not delete this line and do not add application code in this code block!
  /* #ChannelStart# |FR1| #BusStart# |Backbone| */
  /* #ChannelEnd# |FR1| #BusEnd# |Backbone| */
  //--- end generated part --- Block end #Body_Nm_NetworkModeInd#; do not delete this line! Add application code below this line.
  SetBusContext(lBusContext);
}

void Nm_NetworkTimeoutInd()
{
  // Callback of CAN AUTOSAR NM DLL
  dword lBusContext;
  //--- begin generated part --- Block start #Hdr_Nm_NetworkTimeoutInd#; do not delete this line and do not add application code in this code block!
  /* #ChannelStart# |FR1| #BusStart# |Backbone| */
  /* #ChannelEnd# |FR1| #BusEnd# |Backbone| */
  //--- end generated part --- Block end #Hdr_Nm_NetworkTimeoutInd#; do not delete this line! Add application code below this line.
  lBusContext = GetBusContext();
  //--- begin generated part --- Block start #Body_Nm_NetworkTimeoutInd#; do not delete this line and do not add application code in this code block!
  /* #ChannelStart# |FR1| #BusStart# |Backbone| */
  /* #ChannelEnd# |FR1| #BusEnd# |Backbone| */
  //--- end generated part --- Block end #Body_Nm_NetworkTimeoutInd#; do not delete this line! Add application code below this line.
  SetBusContext(lBusContext);
}

void Nm_PrepareBusSleepModeInd()
{
  // Callback of CAN AUTOSAR NM DLL
  dword lBusContext;
  //--- begin generated part --- Block start #Hdr_Nm_PrepareBusSleepModeInd#; do not delete this line and do not add application code in this code block!
  /* #ChannelStart# |FR1| #BusStart# |Backbone| */
  /* #ChannelEnd# |FR1| #BusEnd# |Backbone| */
  //--- end generated part --- Block end #Hdr_Nm_PrepareBusSleepModeInd#; do not delete this line! Add application code below this line.
  lBusContext = GetBusContext();
  //--- begin generated part --- Block start #Body_Nm_PrepareBusSleepModeInd#; do not delete this line and do not add application code in this code block!
  /* #ChannelStart# |FR1| #BusStart# |Backbone| */
  /* #ChannelEnd# |FR1| #BusEnd# |Backbone| */
  //--- end generated part --- Block end #Body_Nm_PrepareBusSleepModeInd#; do not delete this line! Add application code below this line.
  SetBusContext(lBusContext);
}

void Nm_BusSleepModeInd()
{
  // Callback of CAN AUTOSAR NM DLL
  dword lBusContext;
  //--- begin generated part --- Block start #Hdr_Nm_BusSleepModeInd#; do not delete this line and do not add application code in this code block!
  /* #ChannelStart# |FR1| #BusStart# |Backbone| */
  /* #ChannelEnd# |FR1| #BusEnd# |Backbone| */
  //--- end generated part --- Block end #Hdr_Nm_BusSleepModeInd#; do not delete this line! Add application code below this line.
  lBusContext = GetBusContext();
  //--- begin generated part --- Block start #Body_Nm_BusSleepModeInd#; do not delete this line and do not add application code in this code block!
  /* #ChannelStart# |FR1| #BusStart# |Backbone| */
  /* #ChannelEnd# |FR1| #BusEnd# |Backbone| */
  //--- end generated part --- Block end #Body_Nm_BusSleepModeInd#; do not delete this line! Add application code below this line.
  SetBusContext(lBusContext);
}

void Nm_StateChangeNotification(long previousState, long currentState)
{
  // Callback of CAN AUTOSAR NM DLL
  dword lBusContext;
  //--- begin generated part --- Block start #Hdr_Nm_StateChangeNotification#; do not delete this line and do not add application code in this code block!
  /* #ChannelStart# |FR1| #BusStart# |Backbone| */
  /* #ChannelEnd# |FR1| #BusEnd# |Backbone| */
  //--- end generated part --- Block end #Hdr_Nm_StateChangeNotification#; do not delete this line! Add application code below this line.
  lBusContext = GetBusContext();
  //--- begin generated part --- Block start #Body_Nm_StateChangeNotification#; do not delete this line and do not add application code in this code block!
  /* #ChannelStart# |FR1| #BusStart# |Backbone| */
  /* #ChannelEnd# |FR1| #BusEnd# |Backbone| */
  //--- end generated part --- Block end #Body_Nm_StateChangeNotification#; do not delete this line! Add application code below this line.
  SetBusContext(lBusContext);
}

void FrNm_NetworkStartInd()
{
  // Callback of FlexRay AUTOSAR NM DLL
  dword lBusContext;
  //--- begin generated part --- Block start #Hdr_FrNm_NetworkStartInd#; do not delete this line and do not add application code in this code block!
  /* #ChannelStart# |FR1| #BusStart# |Backbone| */
  /* #ChannelEnd# |FR1| #BusEnd# |Backbone| */
  //--- end generated part --- Block end #Hdr_FrNm_NetworkStartInd#; do not delete this line! Add application code below this line.
  lBusContext = GetBusContext();
  //--- begin generated part --- Block start #Body_FrNm_NetworkStartInd#; do not delete this line and do not add application code in this code block!
  /* #ChannelStart# |FR1| #BusStart# |Backbone| */
  if (lBusContext == gNMFR1_BusContext) NMFR1_IndNetworkStart();
  /* #ChannelEnd# |FR1| #BusEnd# |Backbone| */
  //--- end generated part --- Block end #Body_FrNm_NetworkStartInd#; do not delete this line! Add application code below this line.
  SetBusContext(lBusContext);
}

void FrNm_NetworkModeInd()
{
  // Callback of FlexRay AUTOSAR NM DLL
  dword lBusContext;
  //--- begin generated part --- Block start #Hdr_FrNm_NetworkModeInd#; do not delete this line and do not add application code in this code block!
  /* #ChannelStart# |FR1| #BusStart# |Backbone| */
  /* #ChannelEnd# |FR1| #BusEnd# |Backbone| */
  //--- end generated part --- Block end #Hdr_FrNm_NetworkModeInd#; do not delete this line! Add application code below this line.
  lBusContext = GetBusContext();
  //--- begin generated part --- Block start #Body_FrNm_NetworkModeInd#; do not delete this line and do not add application code in this code block!
  /* #ChannelStart# |FR1| #BusStart# |Backbone| */
  if (lBusContext == gNMFR1_BusContext) NMFR1_IndNetworkMode();
  /* #ChannelEnd# |FR1| #BusEnd# |Backbone| */
  //--- end generated part --- Block end #Body_FrNm_NetworkModeInd#; do not delete this line! Add application code below this line.
  SetBusContext(lBusContext);
}

void FrNm_NetworkTimeoutInd()
{
  // Callback of FlexRay AUTOSAR NM DLL
  dword lBusContext;
  //--- begin generated part --- Block start #Hdr_FrNm_NetworkTimeoutInd#; do not delete this line and do not add application code in this code block!
  /* #ChannelStart# |FR1| #BusStart# |Backbone| */
  /* #ChannelEnd# |FR1| #BusEnd# |Backbone| */
  //--- end generated part --- Block end #Hdr_FrNm_NetworkTimeoutInd#; do not delete this line! Add application code below this line.
  lBusContext = GetBusContext();
  //--- begin generated part --- Block start #Body_FrNm_NetworkTimeoutInd#; do not delete this line and do not add application code in this code block!
  /* #ChannelStart# |FR1| #BusStart# |Backbone| */
  if (lBusContext == gNMFR1_BusContext) NMFR1_IndNetworkTimeout();
  /* #ChannelEnd# |FR1| #BusEnd# |Backbone| */
  //--- end generated part --- Block end #Body_FrNm_NetworkTimeoutInd#; do not delete this line! Add application code below this line.
  SetBusContext(lBusContext);
}

void FrNm_BusSleepModeInd()
{
  // Callback of FlexRay AUTOSAR NM DLL
  dword lBusContext;
  //--- begin generated part --- Block start #Hdr_FrNm_BusSleepModeInd#; do not delete this line and do not add application code in this code block!
  /* #ChannelStart# |FR1| #BusStart# |Backbone| */
  /* #ChannelEnd# |FR1| #BusEnd# |Backbone| */
  //--- end generated part --- Block end #Hdr_FrNm_BusSleepModeInd#; do not delete this line! Add application code below this line.
  lBusContext = GetBusContext();
  //--- begin generated part --- Block start #Body_FrNm_BusSleepModeInd#; do not delete this line and do not add application code in this code block!
  /* #ChannelStart# |FR1| #BusStart# |Backbone| */
  if (lBusContext == gNMFR1_BusContext) NMFR1_IndBusSleepMode();
  /* #ChannelEnd# |FR1| #BusEnd# |Backbone| */
  //--- end generated part --- Block end #Body_FrNm_BusSleepModeInd#; do not delete this line! Add application code below this line.
  SetBusContext(lBusContext);
}

void FrNm_StateChangeNotification(long previousState, long currentState)
{
  // Callback of FlexRay AUTOSAR NM DLL
  dword lBusContext;
  //--- begin generated part --- Block start #Hdr_FrNm_StateChangeNotification#; do not delete this line and do not add application code in this code block!
  /* #ChannelStart# |FR1| #BusStart# |Backbone| */
  /* #ChannelEnd# |FR1| #BusEnd# |Backbone| */
  //--- end generated part --- Block end #Hdr_FrNm_StateChangeNotification#; do not delete this line! Add application code below this line.
  lBusContext = GetBusContext();
  //--- begin generated part --- Block start #Body_FrNm_StateChangeNotification#; do not delete this line and do not add application code in this code block!
  /* #ChannelStart# |FR1| #BusStart# |Backbone| */
  if (lBusContext == gNMFR1_BusContext) NMFR1_IndStateChangeNotification(previousState, currentState);
  /* #ChannelEnd# |FR1| #BusEnd# |Backbone| */
  //--- end generated part --- Block end #Body_FrNm_StateChangeNotification#; do not delete this line! Add application code below this line.
  SetBusContext(lBusContext);
}

void FrNm_SynchronizeModeInd()
{
  // Callback of FlexRay AUTOSAR NM DLL
  dword lBusContext;
  //--- begin generated part --- Block start #Hdr_FrNm_SynchronizeModeInd#; do not delete this line and do not add application code in this code block!
  /* #ChannelStart# |FR1| #BusStart# |Backbone| */
  /* #ChannelEnd# |FR1| #BusEnd# |Backbone| */
  //--- end generated part --- Block end #Hdr_FrNm_SynchronizeModeInd#; do not delete this line! Add application code below this line.
  lBusContext = GetBusContext();
  //--- begin generated part --- Block start #Body_FrNm_SynchronizeModeInd#; do not delete this line and do not add application code in this code block!
  /* #ChannelStart# |FR1| #BusStart# |Backbone| */
  if (lBusContext == gNMFR1_BusContext) NMFR1_IndSynchronizeMode();
  /* #ChannelEnd# |FR1| #BusEnd# |Backbone| */
  //--- end generated part --- Block end #Body_FrNm_SynchronizeModeInd#; do not delete this line! Add application code below this line.
  SetBusContext(lBusContext);
}

void StartSim(dword busContext, int busActive, int mode)
{
  //--- begin generated part --- Block start #Hdr_StartSim#; do not delete this line and do not add application code in this code block!
  /* #ChannelStart# |FR1| #BusStart# |Backbone| */
  /* #ChannelEnd# |FR1| #BusEnd# |Backbone| */
  //--- end generated part --- Block end #Hdr_StartSim#; do not delete this line! Add application code below this line.
  //--- begin generated part --- Block start #Body_StartSim#; do not delete this line and do not add application code in this code block!
  /* #ChannelStart# |FR1| #BusStart# |Backbone| */
  /* #ChannelEnd# |FR1| #BusEnd# |Backbone| */
  //--- end generated part --- Block end #Body_StartSim#; do not delete this line! Add application code below this line.
}

void StopSim(dword busContext, int busActive, int mode)
{
  //--- begin generated part --- Block start #Hdr_StopSim#; do not delete this line and do not add application code in this code block!
  /* #ChannelStart# |FR1| #BusStart# |Backbone| */
  /* #ChannelEnd# |FR1| #BusEnd# |Backbone| */
  //--- end generated part --- Block end #Hdr_StopSim#; do not delete this line! Add application code below this line.
  //--- begin generated part --- Block start #Body_StopSim#; do not delete this line and do not add application code in this code block!
  /* #ChannelStart# |FR1| #BusStart# |Backbone| */
  /* #ChannelEnd# |FR1| #BusEnd# |Backbone| */
  //--- end generated part --- Block end #Body_StopSim#; do not delete this line! Add application code below this line.
}

void FrILTxPending(char pduName[], long len, byte payload[], long TxAck)
{
  //--- begin generated part --- Block start #Hdr_FrILTxPending#; do not delete this line and do not add application code in this code block!
  /* #ChannelStart# |FR1| #BusStart# |Backbone| */
  /* #ChannelEnd# |FR1| #BusEnd# |Backbone| */
  //--- end generated part --- Block end #Hdr_FrILTxPending#; do not delete this line! Add application code below this line.
  //--- begin generated part --- Block start #Body_FrILTxPending#; do not delete this line and do not add application code in this code block!
  /* #ChannelStart# |FR1| #BusStart# |Backbone| */
  /* #ChannelEnd# |FR1| #BusEnd# |Backbone| */
  //--- end generated part --- Block end #Body_FrILTxPending#; do not delete this line! Add application code below this line.
}

dword applILTxPending(long aId, dword aDlc, byte data[])
{
  dword ret = 1;
  //--- begin generated part --- Block start #Hdr_applILTxPending#; do not delete this line and do not add application code in this code block!
  /* #ChannelStart# |FR1| #BusStart# |Backbone| */
  /* #ChannelEnd# |FR1| #BusEnd# |Backbone| */
  //--- end generated part --- Block end #Hdr_applILTxPending#; do not delete this line! Add application code below this line.
  //--- begin generated part --- Block start #Body_applILTxPending#; do not delete this line and do not add application code in this code block!
  /* #ChannelStart# |FR1| #BusStart# |Backbone| */
  /* #ChannelEnd# |FR1| #BusEnd# |Backbone| */
  //--- end generated part --- Block end #Body_applILTxPending#; do not delete this line! Add application code below this line.
  return ret;
}

on sysvar_update sysvar::VDDM::Common::Control::SimulationControl
{
  //--- begin generated part --- Block start #Hdr_Name_SimulationControl#; do not delete this line and do not add application code in this code block!
  /* #ChannelStart# |FR1| #BusStart# |Backbone| */
  /* #ChannelEnd# |FR1| #BusEnd# |Backbone| */
  //--- end generated part --- Block end #Hdr_Name_SimulationControl#; do not delete this line! Add application code below this line.
  //--- begin generated part --- Block start #Body_Name_SimulationControl#; do not delete this line and do not add application code in this code block!
  /* #ChannelStart# |FR1| #BusStart# |Backbone| */
  setBusContext(getBusNameContext(gFR1BusName));
  @sysvar::IL_FR1::NODES::N_VDDM::EnableNode = @this;
  /* #ChannelEnd# |FR1| #BusEnd# |Backbone| */
  //--- end generated part --- Block end #Body_Name_SimulationControl#; do not delete this line! Add application code below this line.
}

on sysvar_update sysvar::VDDM::Common::Control::E2EUBMode
{
  int controlValue;
  long resultValue;
  
  //--- begin generated part --- Block start #Hdr_Name_E2EUBMode#; do not delete this line and do not add application code in this code block!
  /* #ChannelStart# |FR1| #BusStart# |Backbone| */
  /* #ChannelEnd# |FR1| #BusEnd# |Backbone| */
  //--- end generated part --- Block end #Hdr_Name_E2EUBMode#; do not delete this line! Add application code below this line.
  //--- begin generated part --- Block start #Body_Name_E2EUBMode#; do not delete this line and do not add application code in this code block!
  /* #ChannelStart# |FR1| #BusStart# |Backbone| */
  controlValue = (int) @this;
  setBusContext(getBusNameContext(gFR1BusName));
  switch(controlValue)
  {
     Case(this::NodeReal) :
        resultValue = SetOperationMode(1,0); break;
     Case(this::NodePnP) :
        resultValue = SetOperationMode(1,1); break;
     Default :
        resultValue = -1;
  }
  
  /* #ChannelEnd# |FR1| #BusEnd# |Backbone| */
  //--- end generated part --- Block end #Body_Name_E2EUBMode#; do not delete this line! Add application code below this line.
}

on sysvar_update sysvar::VDDM::Common::Control::UB
{
  int controlValue;
  long resultValue;
  
  //--- begin generated part --- Block start #Hdr_Name_UB#; do not delete this line and do not add application code in this code block!
  /* #ChannelStart# |FR1| #BusStart# |Backbone| */
  /* #ChannelEnd# |FR1| #BusEnd# |Backbone| */
  //--- end generated part --- Block end #Hdr_Name_UB#; do not delete this line! Add application code below this line.
  //--- begin generated part --- Block start #Body_Name_UB#; do not delete this line and do not add application code in this code block!
  /* #ChannelStart# |FR1| #BusStart# |Backbone| */
  controlValue = (int) @this;
  setBusContext(getBusNameContext(gFR1BusName));
  switch(controlValue)
  {
     Case(this::NodeUBOFF) :
        resultValue = DisturbUB(0,0,-1,0); break;
     Case(this::NodeUBHandled) :
        resultValue = DisturbUB(0,0,0,0); break;
     Case(this::NodeUBON) :
        resultValue = DisturbUB(0,0,-1,1); break;
     Default :
        resultValue = -1;
  }
  
  /* #ChannelEnd# |FR1| #BusEnd# |Backbone| */
  //--- end generated part --- Block end #Body_Name_UB#; do not delete this line! Add application code below this line.
}

//--- begin generated part --- Block start <#Helper_Functions#> do not delete this line and do not add application code in this code block!
/* #ChannelStart# |FR1| #BusStart# |Backbone| */
/* #ChannelEnd# |FR1| #BusEnd# |Backbone| */
//--- end generated part --- Block end <#Helper_Functions#> do not delete this line! Add application code below this line.

//--- begin generated part --- Block start <#SysVar_Handler#> do not delete this line and do not add application code in this code block!
/* #ChannelStart# |FR1| #BusStart# |Backbone| */
on sysvar_update sysvar::VDDM::Backbone::SignalGroups::Control::E2E::BrkPedlPsdChks_Control
{
  int controlValue;
  long resultValue;
  
  // --- FR ---
  controlValue = (int) @this;
  setBusContext(getBusNameContext(gFR1BusName));
  switch(controlValue)
  {
     Case(this::ChksHandled) :
        resultValue = EnableCRC("BrkPedlPsdSafeGroup", 1); break;
     Case(this::ChksManual) :
        resultValue = EnableCRC("BrkPedlPsdSafeGroup", 0); break;
     Default :
        resultValue = -1;
  }
  
}

on sysvar_update sysvar::VDDM::Backbone::SignalGroups::Control::E2E::BrkPedlPsdCntr_Control
{
  int controlValue;
  long resultValue;
  
  // --- FR ---
  controlValue = (int) @this;
  setBusContext(getBusNameContext(gFR1BusName));
  switch(controlValue)
  {
     Case(this::CntrHandled) :
        resultValue = EnableCounter ("BrkPedlPsdSafeGroup", 1); break;
     Case(this::CntrManual) :
        resultValue = EnableCounter ("BrkPedlPsdSafeGroup", 0); break;
     Default :
        resultValue = -1;
  }
  
}

on sysvar_update sysvar::VDDM::Backbone::SignalGroups::Control::E2E::EpbStsEpbStsChks_Control
{
  int controlValue;
  long resultValue;
  
  // --- FR ---
  controlValue = (int) @this;
  setBusContext(getBusNameContext(gFR1BusName));
  switch(controlValue)
  {
     Case(this::ChksHandled) :
        resultValue = EnableCRC("EpbSts", 1); break;
     Case(this::ChksManual) :
        resultValue = EnableCRC("EpbSts", 0); break;
     Default :
        resultValue = -1;
  }
  
}

on sysvar_update sysvar::VDDM::Backbone::SignalGroups::Control::E2E::EpbStsEpbStsCntr_Control
{
  int controlValue;
  long resultValue;
  
  // --- FR ---
  controlValue = (int) @this;
  setBusContext(getBusNameContext(gFR1BusName));
  switch(controlValue)
  {
     Case(this::CntrHandled) :
        resultValue = EnableCounter ("EpbSts", 1); break;
     Case(this::CntrManual) :
        resultValue = EnableCounter ("EpbSts", 0); break;
     Default :
        resultValue = -1;
  }
  
}

on sysvar_update sysvar::VDDM::Backbone::SignalGroups::Control::E2E::SteerWhlSnsrSafeChks_Control
{
  int controlValue;
  long resultValue;
  
  // --- FR ---
  controlValue = (int) @this;
  setBusContext(getBusNameContext(gFR1BusName));
  switch(controlValue)
  {
     Case(this::ChksHandled) :
        resultValue = EnableCRC("SteerWhlSnsr", 1); break;
     Case(this::ChksManual) :
        resultValue = EnableCRC("SteerWhlSnsr", 0); break;
     Default :
        resultValue = -1;
  }
  
}

on sysvar_update sysvar::VDDM::Backbone::SignalGroups::Control::E2E::SteerWhlSnsrSafeCntr_Control
{
  int controlValue;
  long resultValue;
  
  // --- FR ---
  controlValue = (int) @this;
  setBusContext(getBusNameContext(gFR1BusName));
  switch(controlValue)
  {
     Case(this::CntrHandled) :
        resultValue = EnableCounter ("SteerWhlSnsr", 1); break;
     Case(this::CntrManual) :
        resultValue = EnableCounter ("SteerWhlSnsr", 0); break;
     Default :
        resultValue = -1;
  }
  
}

on sysvar_update sysvar::VDDM::Backbone::SignalGroups::Control::E2E::VehMtnStChks_Control
{
  int controlValue;
  long resultValue;
  
  // --- FR ---
  controlValue = (int) @this;
  setBusContext(getBusNameContext(gFR1BusName));
  switch(controlValue)
  {
     Case(this::ChksHandled) :
        resultValue = EnableCRC("VehMtnStSafeGroup", 1); break;
     Case(this::ChksManual) :
        resultValue = EnableCRC("VehMtnStSafeGroup", 0); break;
     Default :
        resultValue = -1;
  }
  
}

on sysvar_update sysvar::VDDM::Backbone::SignalGroups::Control::E2E::VehMtnStCntr_Control
{
  int controlValue;
  long resultValue;
  
  // --- FR ---
  controlValue = (int) @this;
  setBusContext(getBusNameContext(gFR1BusName));
  switch(controlValue)
  {
     Case(this::CntrHandled) :
        resultValue = EnableCounter ("VehMtnStSafeGroup", 1); break;
     Case(this::CntrManual) :
        resultValue = EnableCounter ("VehMtnStSafeGroup", 0); break;
     Default :
        resultValue = -1;
  }
  
}

on sysvar_update sysvar::VDDM::Backbone::SignalGroups::Control::E2E::VehSpdLgtSafeChks_Control
{
  int controlValue;
  long resultValue;
  
  // --- FR ---
  controlValue = (int) @this;
  setBusContext(getBusNameContext(gFR1BusName));
  switch(controlValue)
  {
     Case(this::ChksHandled) :
        resultValue = EnableCRC("VehSpdLgtSafeGroup", 1); break;
     Case(this::ChksManual) :
        resultValue = EnableCRC("VehSpdLgtSafeGroup", 0); break;
     Default :
        resultValue = -1;
  }
  
}

on sysvar_update sysvar::VDDM::Backbone::SignalGroups::Control::E2E::VehSpdLgtSafeCntr_Control
{
  int controlValue;
  long resultValue;
  
  // --- FR ---
  controlValue = (int) @this;
  setBusContext(getBusNameContext(gFR1BusName));
  switch(controlValue)
  {
     Case(this::CntrHandled) :
        resultValue = EnableCounter ("VehSpdLgtSafeGroup", 1); break;
     Case(this::CntrManual) :
        resultValue = EnableCounter ("VehSpdLgtSafeGroup", 0); break;
     Default :
        resultValue = -1;
  }
  
}

on sysvar_update sysvar::VDDM::Backbone::Signals::Control::UB::BrkPedlPsdSafeGroup_UB_Control
{
  long resultValue;
  
  // --- FR ---
  setBusContext(getBusNameContext(gFR1BusName));
  switch(@this)
  {
     Case(this::SignalUBOFF) :
        resultValue = DisturbUB(Backbone::VDDM::VDDMBackBoneSignalIPdu01::BrkPedlPsdSafeGroup_UB,0,-1,0); break;
     Case(this::SignalUBHandled) :
        resultValue = DisturbUB(Backbone::VDDM::VDDMBackBoneSignalIPdu01::BrkPedlPsdSafeGroup_UB,0,0,0); break;
     Case(this::SignalUBON) :
        resultValue = DisturbUB(Backbone::VDDM::VDDMBackBoneSignalIPdu01::BrkPedlPsdSafeGroup_UB,0,-1,1); break;
     Default :
        resultValue = -1;
  }
  
}

on sysvar_update sysvar::VDDM::Backbone::Signals::Control::UB::EpbSts_UB_Control
{
  long resultValue;
  
  // --- FR ---
  setBusContext(getBusNameContext(gFR1BusName));
  switch(@this)
  {
     Case(this::SignalUBOFF) :
        resultValue = DisturbUB(Backbone::VDDM::VDDMBackBoneSignalIPdu01::EpbSts_UB,0,-1,0); break;
     Case(this::SignalUBHandled) :
        resultValue = DisturbUB(Backbone::VDDM::VDDMBackBoneSignalIPdu01::EpbSts_UB,0,0,0); break;
     Case(this::SignalUBON) :
        resultValue = DisturbUB(Backbone::VDDM::VDDMBackBoneSignalIPdu01::EpbSts_UB,0,-1,1); break;
     Default :
        resultValue = -1;
  }
  
}

on sysvar_update sysvar::VDDM::Backbone::Signals::Control::UB::PinionSteerAgSpd1Group_UB_Control
{
  long resultValue;
  
  // --- FR ---
  setBusContext(getBusNameContext(gFR1BusName));
  switch(@this)
  {
     Case(this::SignalUBOFF) :
        resultValue = DisturbUB(Backbone::VDDM::VDDMBackBoneSignalIPdu01::PinionSteerAgSpd1Group_UB,0,-1,0); break;
     Case(this::SignalUBHandled) :
        resultValue = DisturbUB(Backbone::VDDM::VDDMBackBoneSignalIPdu01::PinionSteerAgSpd1Group_UB,0,0,0); break;
     Case(this::SignalUBON) :
        resultValue = DisturbUB(Backbone::VDDM::VDDMBackBoneSignalIPdu01::PinionSteerAgSpd1Group_UB,0,-1,1); break;
     Default :
        resultValue = -1;
  }
  
}

on sysvar_update sysvar::VDDM::Backbone::Signals::Control::UB::SteerWhlSnsr_UB_Control
{
  long resultValue;
  
  // --- FR ---
  setBusContext(getBusNameContext(gFR1BusName));
  switch(@this)
  {
     Case(this::SignalUBOFF) :
        resultValue = DisturbUB(Backbone::VDDM::VDDMBackBoneSignalIPdu01::SteerWhlSnsr_UB,0,-1,0); break;
     Case(this::SignalUBHandled) :
        resultValue = DisturbUB(Backbone::VDDM::VDDMBackBoneSignalIPdu01::SteerWhlSnsr_UB,0,0,0); break;
     Case(this::SignalUBON) :
        resultValue = DisturbUB(Backbone::VDDM::VDDMBackBoneSignalIPdu01::SteerWhlSnsr_UB,0,-1,1); break;
     Default :
        resultValue = -1;
  }
  
}

on sysvar_update sysvar::VDDM::Backbone::Signals::Control::UB::SteerWhlTqGroup_UB_Control
{
  long resultValue;
  
  // --- FR ---
  setBusContext(getBusNameContext(gFR1BusName));
  switch(@this)
  {
     Case(this::SignalUBOFF) :
        resultValue = DisturbUB(Backbone::VDDM::VDDMBackBoneSignalIPdu01::SteerWhlTqGroup_UB,0,-1,0); break;
     Case(this::SignalUBHandled) :
        resultValue = DisturbUB(Backbone::VDDM::VDDMBackBoneSignalIPdu01::SteerWhlTqGroup_UB,0,0,0); break;
     Case(this::SignalUBON) :
        resultValue = DisturbUB(Backbone::VDDM::VDDMBackBoneSignalIPdu01::SteerWhlTqGroup_UB,0,-1,1); break;
     Default :
        resultValue = -1;
  }
  
}

on sysvar_update sysvar::VDDM::Backbone::Signals::Control::UB::SuspPosnVertAgGroup_UB_Control
{
  long resultValue;
  
  // --- FR ---
  setBusContext(getBusNameContext(gFR1BusName));
  switch(@this)
  {
     Case(this::SignalUBOFF) :
        resultValue = DisturbUB(Backbone::VDDM::VDDMBackBoneSignalIPdu01::SuspPosnVertAgGroup_UB,0,-1,0); break;
     Case(this::SignalUBHandled) :
        resultValue = DisturbUB(Backbone::VDDM::VDDMBackBoneSignalIPdu01::SuspPosnVertAgGroup_UB,0,0,0); break;
     Case(this::SignalUBON) :
        resultValue = DisturbUB(Backbone::VDDM::VDDMBackBoneSignalIPdu01::SuspPosnVertAgGroup_UB,0,-1,1); break;
     Default :
        resultValue = -1;
  }
  
}

on sysvar_update sysvar::VDDM::Backbone::Signals::Control::UB::VehMtnStSafeGroup_UB_Control
{
  long resultValue;
  
  // --- FR ---
  setBusContext(getBusNameContext(gFR1BusName));
  switch(@this)
  {
     Case(this::SignalUBOFF) :
        resultValue = DisturbUB(Backbone::VDDM::VDDMBackBoneSignalIPdu01::VehMtnStSafeGroup_UB,0,-1,0); break;
     Case(this::SignalUBHandled) :
        resultValue = DisturbUB(Backbone::VDDM::VDDMBackBoneSignalIPdu01::VehMtnStSafeGroup_UB,0,0,0); break;
     Case(this::SignalUBON) :
        resultValue = DisturbUB(Backbone::VDDM::VDDMBackBoneSignalIPdu01::VehMtnStSafeGroup_UB,0,-1,1); break;
     Default :
        resultValue = -1;
  }
  
}

on sysvar_update sysvar::VDDM::Backbone::Signals::Control::UB::VehSpdLgtSafeGroup_UB_Control
{
  long resultValue;
  
  // --- FR ---
  setBusContext(getBusNameContext(gFR1BusName));
  switch(@this)
  {
     Case(this::SignalUBOFF) :
        resultValue = DisturbUB(Backbone::VDDM::VDDMBackBoneSignalIPdu01::VehSpdLgtSafeGroup_UB,0,-1,0); break;
     Case(this::SignalUBHandled) :
        resultValue = DisturbUB(Backbone::VDDM::VDDMBackBoneSignalIPdu01::VehSpdLgtSafeGroup_UB,0,0,0); break;
     Case(this::SignalUBON) :
        resultValue = DisturbUB(Backbone::VDDM::VDDMBackBoneSignalIPdu01::VehSpdLgtSafeGroup_UB,0,-1,1); break;
     Default :
        resultValue = -1;
  }
  
}

on sysvar_update sysvar::VDDM::Backbone::Signals::Control::UB::WhlDirRotlRe_UB_Control
{
  long resultValue;
  
  // --- FR ---
  setBusContext(getBusNameContext(gFR1BusName));
  switch(@this)
  {
     Case(this::SignalUBOFF) :
        resultValue = DisturbUB(Backbone::VDDM::VDDMBackBoneSignalIPdu01::WhlDirRotlRe_UB,0,-1,0); break;
     Case(this::SignalUBHandled) :
        resultValue = DisturbUB(Backbone::VDDM::VDDMBackBoneSignalIPdu01::WhlDirRotlRe_UB,0,0,0); break;
     Case(this::SignalUBON) :
        resultValue = DisturbUB(Backbone::VDDM::VDDMBackBoneSignalIPdu01::WhlDirRotlRe_UB,0,-1,1); break;
     Default :
        resultValue = -1;
  }
  
}

on sysvar_update sysvar::VDDM::Backbone::Signals::Control::UB::AbsCtrlActv_UB_Control
{
  long resultValue;
  
  // --- FR ---
  setBusContext(getBusNameContext(gFR1BusName));
  switch(@this)
  {
     Case(this::SignalUBOFF) :
        resultValue = DisturbUB(Backbone::VDDM::VDDMBackBoneSignalIPdu01::AbsCtrlActv_UB,0,-1,0); break;
     Case(this::SignalUBHandled) :
        resultValue = DisturbUB(Backbone::VDDM::VDDMBackBoneSignalIPdu01::AbsCtrlActv_UB,0,0,0); break;
     Case(this::SignalUBON) :
        resultValue = DisturbUB(Backbone::VDDM::VDDMBackBoneSignalIPdu01::AbsCtrlActv_UB,0,-1,1); break;
     Default :
        resultValue = -1;
  }
  
}

on sysvar_update sysvar::VDDM::Backbone::Signals::Control::UB::AccStbOk_UB_Control
{
  long resultValue;
  
  // --- FR ---
  setBusContext(getBusNameContext(gFR1BusName));
  switch(@this)
  {
     Case(this::SignalUBOFF) :
        resultValue = DisturbUB(Backbone::VDDM::VDDMBackBoneSignalIPdu01::AccStbOk_UB,0,-1,0); break;
     Case(this::SignalUBHandled) :
        resultValue = DisturbUB(Backbone::VDDM::VDDMBackBoneSignalIPdu01::AccStbOk_UB,0,0,0); break;
     Case(this::SignalUBON) :
        resultValue = DisturbUB(Backbone::VDDM::VDDMBackBoneSignalIPdu01::AccStbOk_UB,0,-1,1); break;
     Default :
        resultValue = -1;
  }
  
}

on sysvar_update sysvar::VDDM::Backbone::Signals::Control::UB::AccStopModOk_UB_Control
{
  long resultValue;
  
  // --- FR ---
  setBusContext(getBusNameContext(gFR1BusName));
  switch(@this)
  {
     Case(this::SignalUBOFF) :
        resultValue = DisturbUB(Backbone::VDDM::VDDMBackBoneSignalIPdu01::AccStopModOk_UB,0,-1,0); break;
     Case(this::SignalUBHandled) :
        resultValue = DisturbUB(Backbone::VDDM::VDDMBackBoneSignalIPdu01::AccStopModOk_UB,0,0,0); break;
     Case(this::SignalUBON) :
        resultValue = DisturbUB(Backbone::VDDM::VDDMBackBoneSignalIPdu01::AccStopModOk_UB,0,-1,1); break;
     Default :
        resultValue = -1;
  }
  
}

on sysvar_update sysvar::VDDM::Backbone::Signals::Control::UB::AccSts_UB_Control
{
  long resultValue;
  
  // --- FR ---
  setBusContext(getBusNameContext(gFR1BusName));
  switch(@this)
  {
     Case(this::SignalUBOFF) :
        resultValue = DisturbUB(Backbone::VDDM::VDDMBackBoneSignalIPdu01::AccSts_UB,0,-1,0); break;
     Case(this::SignalUBHandled) :
        resultValue = DisturbUB(Backbone::VDDM::VDDMBackBoneSignalIPdu01::AccSts_UB,0,0,0); break;
     Case(this::SignalUBON) :
        resultValue = DisturbUB(Backbone::VDDM::VDDMBackBoneSignalIPdu01::AccSts_UB,0,-1,1); break;
     Default :
        resultValue = -1;
  }
  
}

on sysvar_update sysvar::VDDM::Backbone::Signals::Control::UB::AdjSpdLimnActvnOk_UB_Control
{
  long resultValue;
  
  // --- FR ---
  setBusContext(getBusNameContext(gFR1BusName));
  switch(@this)
  {
     Case(this::SignalUBOFF) :
        resultValue = DisturbUB(Backbone::VDDM::VDDMBackBoneSignalIPdu01::AdjSpdLimnActvnOk_UB,0,-1,0); break;
     Case(this::SignalUBHandled) :
        resultValue = DisturbUB(Backbone::VDDM::VDDMBackBoneSignalIPdu01::AdjSpdLimnActvnOk_UB,0,0,0); break;
     Case(this::SignalUBON) :
        resultValue = DisturbUB(Backbone::VDDM::VDDMBackBoneSignalIPdu01::AdjSpdLimnActvnOk_UB,0,-1,1); break;
     Default :
        resultValue = -1;
  }
  
}

on sysvar_update sysvar::VDDM::Backbone::Signals::Control::UB::AdjSpdLimnMsg_UB_Control
{
  long resultValue;
  
  // --- FR ---
  setBusContext(getBusNameContext(gFR1BusName));
  switch(@this)
  {
     Case(this::SignalUBOFF) :
        resultValue = DisturbUB(Backbone::VDDM::VDDMBackBoneSignalIPdu01::AdjSpdLimnMsg_UB,0,-1,0); break;
     Case(this::SignalUBHandled) :
        resultValue = DisturbUB(Backbone::VDDM::VDDMBackBoneSignalIPdu01::AdjSpdLimnMsg_UB,0,0,0); break;
     Case(this::SignalUBON) :
        resultValue = DisturbUB(Backbone::VDDM::VDDMBackBoneSignalIPdu01::AdjSpdLimnMsg_UB,0,-1,1); break;
     Default :
        resultValue = -1;
  }
  
}

on sysvar_update sysvar::VDDM::Backbone::Signals::Control::UB::AdjSpdLimnStbOk_UB_Control
{
  long resultValue;
  
  // --- FR ---
  setBusContext(getBusNameContext(gFR1BusName));
  switch(@this)
  {
     Case(this::SignalUBOFF) :
        resultValue = DisturbUB(Backbone::VDDM::VDDMBackBoneSignalIPdu01::AdjSpdLimnStbOk_UB,0,-1,0); break;
     Case(this::SignalUBHandled) :
        resultValue = DisturbUB(Backbone::VDDM::VDDMBackBoneSignalIPdu01::AdjSpdLimnStbOk_UB,0,0,0); break;
     Case(this::SignalUBON) :
        resultValue = DisturbUB(Backbone::VDDM::VDDMBackBoneSignalIPdu01::AdjSpdLimnStbOk_UB,0,-1,1); break;
     Default :
        resultValue = -1;
  }
  
}

on sysvar_update sysvar::VDDM::Backbone::Signals::Control::UB::AdjSpdLimnSts_UB_Control
{
  long resultValue;
  
  // --- FR ---
  setBusContext(getBusNameContext(gFR1BusName));
  switch(@this)
  {
     Case(this::SignalUBOFF) :
        resultValue = DisturbUB(Backbone::VDDM::VDDMBackBoneSignalIPdu01::AdjSpdLimnSts_UB,0,-1,0); break;
     Case(this::SignalUBHandled) :
        resultValue = DisturbUB(Backbone::VDDM::VDDMBackBoneSignalIPdu01::AdjSpdLimnSts_UB,0,0,0); break;
     Case(this::SignalUBON) :
        resultValue = DisturbUB(Backbone::VDDM::VDDMBackBoneSignalIPdu01::AdjSpdLimnSts_UB,0,-1,1); break;
     Default :
        resultValue = -1;
  }
  
}

on sysvar_update sysvar::VDDM::Backbone::Signals::Control::UB::AdjSpdLimnWarn_UB_Control
{
  long resultValue;
  
  // --- FR ---
  setBusContext(getBusNameContext(gFR1BusName));
  switch(@this)
  {
     Case(this::SignalUBOFF) :
        resultValue = DisturbUB(Backbone::VDDM::VDDMBackBoneSignalIPdu01::AdjSpdLimnWarn_UB,0,-1,0); break;
     Case(this::SignalUBHandled) :
        resultValue = DisturbUB(Backbone::VDDM::VDDMBackBoneSignalIPdu01::AdjSpdLimnWarn_UB,0,0,0); break;
     Case(this::SignalUBON) :
        resultValue = DisturbUB(Backbone::VDDM::VDDMBackBoneSignalIPdu01::AdjSpdLimnWarn_UB,0,-1,1); break;
     Default :
        resultValue = -1;
  }
  
}

on sysvar_update sysvar::VDDM::Backbone::Signals::Control::UB::CrsCtrlrActvnOk_UB_Control
{
  long resultValue;
  
  // --- FR ---
  setBusContext(getBusNameContext(gFR1BusName));
  switch(@this)
  {
     Case(this::SignalUBOFF) :
        resultValue = DisturbUB(Backbone::VDDM::VDDMBackBoneSignalIPdu01::CrsCtrlrActvnOk_UB,0,-1,0); break;
     Case(this::SignalUBHandled) :
        resultValue = DisturbUB(Backbone::VDDM::VDDMBackBoneSignalIPdu01::CrsCtrlrActvnOk_UB,0,0,0); break;
     Case(this::SignalUBON) :
        resultValue = DisturbUB(Backbone::VDDM::VDDMBackBoneSignalIPdu01::CrsCtrlrActvnOk_UB,0,-1,1); break;
     Default :
        resultValue = -1;
  }
  
}

on sysvar_update sysvar::VDDM::Backbone::Signals::Control::UB::CrsCtrlrStbOk_UB_Control
{
  long resultValue;
  
  // --- FR ---
  setBusContext(getBusNameContext(gFR1BusName));
  switch(@this)
  {
     Case(this::SignalUBOFF) :
        resultValue = DisturbUB(Backbone::VDDM::VDDMBackBoneSignalIPdu01::CrsCtrlrStbOk_UB,0,-1,0); break;
     Case(this::SignalUBHandled) :
        resultValue = DisturbUB(Backbone::VDDM::VDDMBackBoneSignalIPdu01::CrsCtrlrStbOk_UB,0,0,0); break;
     Case(this::SignalUBON) :
        resultValue = DisturbUB(Backbone::VDDM::VDDMBackBoneSignalIPdu01::CrsCtrlrStbOk_UB,0,-1,1); break;
     Default :
        resultValue = -1;
  }
  
}

on sysvar_update sysvar::VDDM::Backbone::Signals::Control::UB::CrsCtrlrSts_UB_Control
{
  long resultValue;
  
  // --- FR ---
  setBusContext(getBusNameContext(gFR1BusName));
  switch(@this)
  {
     Case(this::SignalUBOFF) :
        resultValue = DisturbUB(Backbone::VDDM::VDDMBackBoneSignalIPdu01::CrsCtrlrSts_UB,0,-1,0); break;
     Case(this::SignalUBHandled) :
        resultValue = DisturbUB(Backbone::VDDM::VDDMBackBoneSignalIPdu01::CrsCtrlrSts_UB,0,0,0); break;
     Case(this::SignalUBON) :
        resultValue = DisturbUB(Backbone::VDDM::VDDMBackBoneSignalIPdu01::CrsCtrlrSts_UB,0,-1,1); break;
     Default :
        resultValue = -1;
  }
  
}

on sysvar_update sysvar::VDDM::Backbone::Signals::Control::UB::DispOfPrpsnPwrPercAct_UB_Control
{
  long resultValue;
  
  // --- FR ---
  setBusContext(getBusNameContext(gFR1BusName));
  switch(@this)
  {
     Case(this::SignalUBOFF) :
        resultValue = DisturbUB(Backbone::VDDM::VDDMBackBoneSignalIPdu01::DispOfPrpsnPwrPercAct_UB,0,-1,0); break;
     Case(this::SignalUBHandled) :
        resultValue = DisturbUB(Backbone::VDDM::VDDMBackBoneSignalIPdu01::DispOfPrpsnPwrPercAct_UB,0,0,0); break;
     Case(this::SignalUBON) :
        resultValue = DisturbUB(Backbone::VDDM::VDDMBackBoneSignalIPdu01::DispOfPrpsnPwrPercAct_UB,0,-1,1); break;
     Default :
        resultValue = -1;
  }
  
}

on sysvar_update sysvar::VDDM::Backbone::Signals::Control::UB::EscCtrlIndcn_UB_Control
{
  long resultValue;
  
  // --- FR ---
  setBusContext(getBusNameContext(gFR1BusName));
  switch(@this)
  {
     Case(this::SignalUBOFF) :
        resultValue = DisturbUB(Backbone::VDDM::VDDMBackBoneSignalIPdu01::EscCtrlIndcn_UB,0,-1,0); break;
     Case(this::SignalUBHandled) :
        resultValue = DisturbUB(Backbone::VDDM::VDDMBackBoneSignalIPdu01::EscCtrlIndcn_UB,0,0,0); break;
     Case(this::SignalUBON) :
        resultValue = DisturbUB(Backbone::VDDM::VDDMBackBoneSignalIPdu01::EscCtrlIndcn_UB,0,-1,1); break;
     Default :
        resultValue = -1;
  }
  
}

on sysvar_update sysvar::VDDM::Backbone::Signals::Control::UB::ParkAssiDrvrSteerOvrdSts_UB_Control
{
  long resultValue;
  
  // --- FR ---
  setBusContext(getBusNameContext(gFR1BusName));
  switch(@this)
  {
     Case(this::SignalUBOFF) :
        resultValue = DisturbUB(Backbone::VDDM::VDDMBackBoneSignalIPdu01::ParkAssiDrvrSteerOvrdSts_UB,0,-1,0); break;
     Case(this::SignalUBHandled) :
        resultValue = DisturbUB(Backbone::VDDM::VDDMBackBoneSignalIPdu01::ParkAssiDrvrSteerOvrdSts_UB,0,0,0); break;
     Case(this::SignalUBON) :
        resultValue = DisturbUB(Backbone::VDDM::VDDMBackBoneSignalIPdu01::ParkAssiDrvrSteerOvrdSts_UB,0,-1,1); break;
     Default :
        resultValue = -1;
  }
  
}

on sysvar_update sysvar::VDDM::Backbone::Signals::Control::UB::SteerStsToParkAssi_UB_Control
{
  long resultValue;
  
  // --- FR ---
  setBusContext(getBusNameContext(gFR1BusName));
  switch(@this)
  {
     Case(this::SignalUBOFF) :
        resultValue = DisturbUB(Backbone::VDDM::VDDMBackBoneSignalIPdu01::SteerStsToParkAssi_UB,0,-1,0); break;
     Case(this::SignalUBHandled) :
        resultValue = DisturbUB(Backbone::VDDM::VDDMBackBoneSignalIPdu01::SteerStsToParkAssi_UB,0,0,0); break;
     Case(this::SignalUBON) :
        resultValue = DisturbUB(Backbone::VDDM::VDDMBackBoneSignalIPdu01::SteerStsToParkAssi_UB,0,-1,1); break;
     Default :
        resultValue = -1;
  }
  
}

on sysvar_update sysvar::VDDM::Backbone::Signals::Control::UB::StopStrtInhb_UB_Control
{
  long resultValue;
  
  // --- FR ---
  setBusContext(getBusNameContext(gFR1BusName));
  switch(@this)
  {
     Case(this::SignalUBOFF) :
        resultValue = DisturbUB(Backbone::VDDM::VDDMBackBoneSignalIPdu01::StopStrtInhb_UB,0,-1,0); break;
     Case(this::SignalUBHandled) :
        resultValue = DisturbUB(Backbone::VDDM::VDDMBackBoneSignalIPdu01::StopStrtInhb_UB,0,0,0); break;
     Case(this::SignalUBON) :
        resultValue = DisturbUB(Backbone::VDDM::VDDMBackBoneSignalIPdu01::StopStrtInhb_UB,0,-1,1); break;
     Default :
        resultValue = -1;
  }
  
}

on sysvar_update sysvar::VDDM::Backbone::SignalGroups::Control::E2E::ALgtStdFromWhlSpdSafeChks_Control
{
  int controlValue;
  long resultValue;
  
  // --- FR ---
  controlValue = (int) @this;
  setBusContext(getBusNameContext(gFR1BusName));
  switch(controlValue)
  {
     Case(this::ChksHandled) :
        resultValue = EnableCRC("ALgtStdFromWhlSpdSafeGroup", 1); break;
     Case(this::ChksManual) :
        resultValue = EnableCRC("ALgtStdFromWhlSpdSafeGroup", 0); break;
     Default :
        resultValue = -1;
  }
  
}

on sysvar_update sysvar::VDDM::Backbone::SignalGroups::Control::E2E::ALgtStdFromWhlSpdSafeCntr_Control
{
  int controlValue;
  long resultValue;
  
  // --- FR ---
  controlValue = (int) @this;
  setBusContext(getBusNameContext(gFR1BusName));
  switch(controlValue)
  {
     Case(this::CntrHandled) :
        resultValue = EnableCounter ("ALgtStdFromWhlSpdSafeGroup", 1); break;
     Case(this::CntrManual) :
        resultValue = EnableCounter ("ALgtStdFromWhlSpdSafeGroup", 0); break;
     Default :
        resultValue = -1;
  }
  
}

on sysvar_update sysvar::VDDM::Backbone::SignalGroups::Control::E2E::DrvrBrkTqAtWhlsReqdDrvrBrkTqAtWhlsReqdChks_Control
{
  int controlValue;
  long resultValue;
  
  // --- FR ---
  controlValue = (int) @this;
  setBusContext(getBusNameContext(gFR1BusName));
  switch(controlValue)
  {
     Case(this::ChksHandled) :
        resultValue = EnableCRC("DrvrBrkTqAtWhlsReqdGroup", 1); break;
     Case(this::ChksManual) :
        resultValue = EnableCRC("DrvrBrkTqAtWhlsReqdGroup", 0); break;
     Default :
        resultValue = -1;
  }
  
}

on sysvar_update sysvar::VDDM::Backbone::SignalGroups::Control::E2E::DrvrBrkTqAtWhlsReqdDrvrBrkTqAtWhlsReqdCntr_Control
{
  int controlValue;
  long resultValue;
  
  // --- FR ---
  controlValue = (int) @this;
  setBusContext(getBusNameContext(gFR1BusName));
  switch(controlValue)
  {
     Case(this::CntrHandled) :
        resultValue = EnableCounter ("DrvrBrkTqAtWhlsReqdGroup", 1); break;
     Case(this::CntrManual) :
        resultValue = EnableCounter ("DrvrBrkTqAtWhlsReqdGroup", 0); break;
     Default :
        resultValue = -1;
  }
  
}

on sysvar_update sysvar::VDDM::Backbone::SignalGroups::Control::E2E::LatCtrlModCfmdChks_Control
{
  int controlValue;
  long resultValue;
  
  // --- FR ---
  controlValue = (int) @this;
  setBusContext(getBusNameContext(gFR1BusName));
  switch(controlValue)
  {
     Case(this::ChksHandled) :
        resultValue = EnableCRC("LatCtrlModCfmd", 1); break;
     Case(this::ChksManual) :
        resultValue = EnableCRC("LatCtrlModCfmd", 0); break;
     Default :
        resultValue = -1;
  }
  
}

on sysvar_update sysvar::VDDM::Backbone::SignalGroups::Control::E2E::LatCtrlModCfmdCntr_Control
{
  int controlValue;
  long resultValue;
  
  // --- FR ---
  controlValue = (int) @this;
  setBusContext(getBusNameContext(gFR1BusName));
  switch(controlValue)
  {
     Case(this::CntrHandled) :
        resultValue = EnableCounter ("LatCtrlModCfmd", 1); break;
     Case(this::CntrManual) :
        resultValue = EnableCounter ("LatCtrlModCfmd", 0); break;
     Default :
        resultValue = -1;
  }
  
}

on sysvar_update sysvar::VDDM::Backbone::Signals::Control::UB::ALgtStdFromWhlSpdSafeGroup_UB_Control
{
  long resultValue;
  
  // --- FR ---
  setBusContext(getBusNameContext(gFR1BusName));
  switch(@this)
  {
     Case(this::SignalUBOFF) :
        resultValue = DisturbUB(Backbone::VDDM::VDDMBackBoneSignalIPdu02::ALgtStdFromWhlSpdSafeGroup_UB,0,-1,0); break;
     Case(this::SignalUBHandled) :
        resultValue = DisturbUB(Backbone::VDDM::VDDMBackBoneSignalIPdu02::ALgtStdFromWhlSpdSafeGroup_UB,0,0,0); break;
     Case(this::SignalUBON) :
        resultValue = DisturbUB(Backbone::VDDM::VDDMBackBoneSignalIPdu02::ALgtStdFromWhlSpdSafeGroup_UB,0,-1,1); break;
     Default :
        resultValue = -1;
  }
  
}

on sysvar_update sysvar::VDDM::Backbone::Signals::Control::UB::DrvrBrkTqAtWhlsReqdGroup_UB_Control
{
  long resultValue;
  
  // --- FR ---
  setBusContext(getBusNameContext(gFR1BusName));
  switch(@this)
  {
     Case(this::SignalUBOFF) :
        resultValue = DisturbUB(Backbone::VDDM::VDDMBackBoneSignalIPdu02::DrvrBrkTqAtWhlsReqdGroup_UB,0,-1,0); break;
     Case(this::SignalUBHandled) :
        resultValue = DisturbUB(Backbone::VDDM::VDDMBackBoneSignalIPdu02::DrvrBrkTqAtWhlsReqdGroup_UB,0,0,0); break;
     Case(this::SignalUBON) :
        resultValue = DisturbUB(Backbone::VDDM::VDDMBackBoneSignalIPdu02::DrvrBrkTqAtWhlsReqdGroup_UB,0,-1,1); break;
     Default :
        resultValue = -1;
  }
  
}

on sysvar_update sysvar::VDDM::Backbone::Signals::Control::UB::GearIndcnRec_UB_Control
{
  long resultValue;
  
  // --- FR ---
  setBusContext(getBusNameContext(gFR1BusName));
  switch(@this)
  {
     Case(this::SignalUBOFF) :
        resultValue = DisturbUB(Backbone::VDDM::VDDMBackBoneSignalIPdu02::GearIndcnRec_UB,0,-1,0); break;
     Case(this::SignalUBHandled) :
        resultValue = DisturbUB(Backbone::VDDM::VDDMBackBoneSignalIPdu02::GearIndcnRec_UB,0,0,0); break;
     Case(this::SignalUBON) :
        resultValue = DisturbUB(Backbone::VDDM::VDDMBackBoneSignalIPdu02::GearIndcnRec_UB,0,-1,1); break;
     Default :
        resultValue = -1;
  }
  
}

on sysvar_update sysvar::VDDM::Backbone::Signals::Control::UB::LatCtrlModCfmd_UB_Control
{
  long resultValue;
  
  // --- FR ---
  setBusContext(getBusNameContext(gFR1BusName));
  switch(@this)
  {
     Case(this::SignalUBOFF) :
        resultValue = DisturbUB(Backbone::VDDM::VDDMBackBoneSignalIPdu02::LatCtrlModCfmd_UB,0,-1,0); break;
     Case(this::SignalUBHandled) :
        resultValue = DisturbUB(Backbone::VDDM::VDDMBackBoneSignalIPdu02::LatCtrlModCfmd_UB,0,0,0); break;
     Case(this::SignalUBON) :
        resultValue = DisturbUB(Backbone::VDDM::VDDMBackBoneSignalIPdu02::LatCtrlModCfmd_UB,0,-1,1); break;
     Default :
        resultValue = -1;
  }
  
}

on sysvar_update sysvar::VDDM::Backbone::Signals::Control::UB::PinionSteerAg1Group_UB_Control
{
  long resultValue;
  
  // --- FR ---
  setBusContext(getBusNameContext(gFR1BusName));
  switch(@this)
  {
     Case(this::SignalUBOFF) :
        resultValue = DisturbUB(Backbone::VDDM::VDDMBackBoneSignalIPdu02::PinionSteerAg1Group_UB,0,-1,0); break;
     Case(this::SignalUBHandled) :
        resultValue = DisturbUB(Backbone::VDDM::VDDMBackBoneSignalIPdu02::PinionSteerAg1Group_UB,0,0,0); break;
     Case(this::SignalUBON) :
        resultValue = DisturbUB(Backbone::VDDM::VDDMBackBoneSignalIPdu02::PinionSteerAg1Group_UB,0,-1,1); break;
     Default :
        resultValue = -1;
  }
  
}

on sysvar_update sysvar::VDDM::Backbone::Signals::Control::UB::WhlRotToothCntr_UB_Control
{
  long resultValue;
  
  // --- FR ---
  setBusContext(getBusNameContext(gFR1BusName));
  switch(@this)
  {
     Case(this::SignalUBOFF) :
        resultValue = DisturbUB(Backbone::VDDM::VDDMBackBoneSignalIPdu02::WhlRotToothCntr_UB,0,-1,0); break;
     Case(this::SignalUBHandled) :
        resultValue = DisturbUB(Backbone::VDDM::VDDMBackBoneSignalIPdu02::WhlRotToothCntr_UB,0,0,0); break;
     Case(this::SignalUBON) :
        resultValue = DisturbUB(Backbone::VDDM::VDDMBackBoneSignalIPdu02::WhlRotToothCntr_UB,0,-1,1); break;
     Default :
        resultValue = -1;
  }
  
}

on sysvar_update sysvar::VDDM::Backbone::Signals::Control::UB::AccActvnOk_UB_Control
{
  long resultValue;
  
  // --- FR ---
  setBusContext(getBusNameContext(gFR1BusName));
  switch(@this)
  {
     Case(this::SignalUBOFF) :
        resultValue = DisturbUB(Backbone::VDDM::VDDMBackBoneSignalIPdu02::AccActvnOk_UB,0,-1,0); break;
     Case(this::SignalUBHandled) :
        resultValue = DisturbUB(Backbone::VDDM::VDDMBackBoneSignalIPdu02::AccActvnOk_UB,0,0,0); break;
     Case(this::SignalUBON) :
        resultValue = DisturbUB(Backbone::VDDM::VDDMBackBoneSignalIPdu02::AccActvnOk_UB,0,-1,1); break;
     Default :
        resultValue = -1;
  }
  
}

on sysvar_update sysvar::VDDM::Backbone::Signals::Control::UB::AccInhbByPrpsn_UB_Control
{
  long resultValue;
  
  // --- FR ---
  setBusContext(getBusNameContext(gFR1BusName));
  switch(@this)
  {
     Case(this::SignalUBOFF) :
        resultValue = DisturbUB(Backbone::VDDM::VDDMBackBoneSignalIPdu02::AccInhbByPrpsn_UB,0,-1,0); break;
     Case(this::SignalUBHandled) :
        resultValue = DisturbUB(Backbone::VDDM::VDDMBackBoneSignalIPdu02::AccInhbByPrpsn_UB,0,0,0); break;
     Case(this::SignalUBON) :
        resultValue = DisturbUB(Backbone::VDDM::VDDMBackBoneSignalIPdu02::AccInhbByPrpsn_UB,0,-1,1); break;
     Default :
        resultValue = -1;
  }
  
}

on sysvar_update sysvar::VDDM::Backbone::Signals::Control::UB::AccrPedlRat_UB_Control
{
  long resultValue;
  
  // --- FR ---
  setBusContext(getBusNameContext(gFR1BusName));
  switch(@this)
  {
     Case(this::SignalUBOFF) :
        resultValue = DisturbUB(Backbone::VDDM::VDDMBackBoneSignalIPdu02::AccrPedlRat_UB,0,-1,0); break;
     Case(this::SignalUBHandled) :
        resultValue = DisturbUB(Backbone::VDDM::VDDMBackBoneSignalIPdu02::AccrPedlRat_UB,0,0,0); break;
     Case(this::SignalUBON) :
        resultValue = DisturbUB(Backbone::VDDM::VDDMBackBoneSignalIPdu02::AccrPedlRat_UB,0,-1,1); break;
     Default :
        resultValue = -1;
  }
  
}

on sysvar_update sysvar::VDDM::Backbone::Signals::Control::UB::AsyALgtActvAftLim_UB_Control
{
  long resultValue;
  
  // --- FR ---
  setBusContext(getBusNameContext(gFR1BusName));
  switch(@this)
  {
     Case(this::SignalUBOFF) :
        resultValue = DisturbUB(Backbone::VDDM::VDDMBackBoneSignalIPdu02::AsyALgtActvAftLim_UB,0,-1,0); break;
     Case(this::SignalUBHandled) :
        resultValue = DisturbUB(Backbone::VDDM::VDDMBackBoneSignalIPdu02::AsyALgtActvAftLim_UB,0,0,0); break;
     Case(this::SignalUBON) :
        resultValue = DisturbUB(Backbone::VDDM::VDDMBackBoneSignalIPdu02::AsyALgtActvAftLim_UB,0,-1,1); break;
     Default :
        resultValue = -1;
  }
  
}

on sysvar_update sysvar::VDDM::Backbone::Signals::Control::UB::CrsCtrlOvrdn_UB_Control
{
  long resultValue;
  
  // --- FR ---
  setBusContext(getBusNameContext(gFR1BusName));
  switch(@this)
  {
     Case(this::SignalUBOFF) :
        resultValue = DisturbUB(Backbone::VDDM::VDDMBackBoneSignalIPdu02::CrsCtrlOvrdn_UB,0,-1,0); break;
     Case(this::SignalUBHandled) :
        resultValue = DisturbUB(Backbone::VDDM::VDDMBackBoneSignalIPdu02::CrsCtrlOvrdn_UB,0,0,0); break;
     Case(this::SignalUBON) :
        resultValue = DisturbUB(Backbone::VDDM::VDDMBackBoneSignalIPdu02::CrsCtrlOvrdn_UB,0,-1,1); break;
     Default :
        resultValue = -1;
  }
  
}

on sysvar_update sysvar::VDDM::Backbone::Signals::Control::UB::CrsCtrlrMsg_UB_Control
{
  long resultValue;
  
  // --- FR ---
  setBusContext(getBusNameContext(gFR1BusName));
  switch(@this)
  {
     Case(this::SignalUBOFF) :
        resultValue = DisturbUB(Backbone::VDDM::VDDMBackBoneSignalIPdu02::CrsCtrlrMsg_UB,0,-1,0); break;
     Case(this::SignalUBHandled) :
        resultValue = DisturbUB(Backbone::VDDM::VDDMBackBoneSignalIPdu02::CrsCtrlrMsg_UB,0,0,0); break;
     Case(this::SignalUBON) :
        resultValue = DisturbUB(Backbone::VDDM::VDDMBackBoneSignalIPdu02::CrsCtrlrMsg_UB,0,-1,1); break;
     Default :
        resultValue = -1;
  }
  
}

on sysvar_update sysvar::VDDM::Backbone::Signals::Control::UB::DispBoostElec_UB_Control
{
  long resultValue;
  
  // --- FR ---
  setBusContext(getBusNameContext(gFR1BusName));
  switch(@this)
  {
     Case(this::SignalUBOFF) :
        resultValue = DisturbUB(Backbone::VDDM::VDDMBackBoneSignalIPdu02::DispBoostElec_UB,0,-1,0); break;
     Case(this::SignalUBHandled) :
        resultValue = DisturbUB(Backbone::VDDM::VDDMBackBoneSignalIPdu02::DispBoostElec_UB,0,0,0); break;
     Case(this::SignalUBON) :
        resultValue = DisturbUB(Backbone::VDDM::VDDMBackBoneSignalIPdu02::DispBoostElec_UB,0,-1,1); break;
     Default :
        resultValue = -1;
  }
  
}

on sysvar_update sysvar::VDDM::Backbone::Signals::Control::UB::DrvrBrkTqAtWhlsGrdtReqd_UB_Control
{
  long resultValue;
  
  // --- FR ---
  setBusContext(getBusNameContext(gFR1BusName));
  switch(@this)
  {
     Case(this::SignalUBOFF) :
        resultValue = DisturbUB(Backbone::VDDM::VDDMBackBoneSignalIPdu02::DrvrBrkTqAtWhlsGrdtReqd_UB,0,-1,0); break;
     Case(this::SignalUBHandled) :
        resultValue = DisturbUB(Backbone::VDDM::VDDMBackBoneSignalIPdu02::DrvrBrkTqAtWhlsGrdtReqd_UB,0,0,0); break;
     Case(this::SignalUBON) :
        resultValue = DisturbUB(Backbone::VDDM::VDDMBackBoneSignalIPdu02::DrvrBrkTqAtWhlsGrdtReqd_UB,0,-1,1); break;
     Default :
        resultValue = -1;
  }
  
}

on sysvar_update sysvar::VDDM::Backbone::Signals::Control::UB::DrvrDecelReq_UB_Control
{
  long resultValue;
  
  // --- FR ---
  setBusContext(getBusNameContext(gFR1BusName));
  switch(@this)
  {
     Case(this::SignalUBOFF) :
        resultValue = DisturbUB(Backbone::VDDM::VDDMBackBoneSignalIPdu02::DrvrDecelReq_UB,0,-1,0); break;
     Case(this::SignalUBHandled) :
        resultValue = DisturbUB(Backbone::VDDM::VDDMBackBoneSignalIPdu02::DrvrDecelReq_UB,0,0,0); break;
     Case(this::SignalUBON) :
        resultValue = DisturbUB(Backbone::VDDM::VDDMBackBoneSignalIPdu02::DrvrDecelReq_UB,0,-1,1); break;
     Default :
        resultValue = -1;
  }
  
}

on sysvar_update sysvar::VDDM::Backbone::Signals::Control::UB::DrvrDesDir_UB_Control
{
  long resultValue;
  
  // --- FR ---
  setBusContext(getBusNameContext(gFR1BusName));
  switch(@this)
  {
     Case(this::SignalUBOFF) :
        resultValue = DisturbUB(Backbone::VDDM::VDDMBackBoneSignalIPdu02::DrvrDesDir_UB,0,-1,0); break;
     Case(this::SignalUBHandled) :
        resultValue = DisturbUB(Backbone::VDDM::VDDMBackBoneSignalIPdu02::DrvrDesDir_UB,0,0,0); break;
     Case(this::SignalUBON) :
        resultValue = DisturbUB(Backbone::VDDM::VDDMBackBoneSignalIPdu02::DrvrDesDir_UB,0,-1,1); break;
     Default :
        resultValue = -1;
  }
  
}

on sysvar_update sysvar::VDDM::Backbone::Signals::Control::UB::DrvrGearLvrLockIndcn_UB_Control
{
  long resultValue;
  
  // --- FR ---
  setBusContext(getBusNameContext(gFR1BusName));
  switch(@this)
  {
     Case(this::SignalUBOFF) :
        resultValue = DisturbUB(Backbone::VDDM::VDDMBackBoneSignalIPdu02::DrvrGearLvrLockIndcn_UB,0,-1,0); break;
     Case(this::SignalUBHandled) :
        resultValue = DisturbUB(Backbone::VDDM::VDDMBackBoneSignalIPdu02::DrvrGearLvrLockIndcn_UB,0,0,0); break;
     Case(this::SignalUBON) :
        resultValue = DisturbUB(Backbone::VDDM::VDDMBackBoneSignalIPdu02::DrvrGearLvrLockIndcn_UB,0,-1,1); break;
     Default :
        resultValue = -1;
  }
  
}

on sysvar_update sysvar::VDDM::Backbone::Signals::Control::UB::EngSt1WdSts_UB_Control
{
  long resultValue;
  
  // --- FR ---
  setBusContext(getBusNameContext(gFR1BusName));
  switch(@this)
  {
     Case(this::SignalUBOFF) :
        resultValue = DisturbUB(Backbone::VDDM::VDDMBackBoneSignalIPdu02::EngSt1WdSts_UB,0,-1,0); break;
     Case(this::SignalUBHandled) :
        resultValue = DisturbUB(Backbone::VDDM::VDDMBackBoneSignalIPdu02::EngSt1WdSts_UB,0,0,0); break;
     Case(this::SignalUBON) :
        resultValue = DisturbUB(Backbone::VDDM::VDDMBackBoneSignalIPdu02::EngSt1WdSts_UB,0,-1,1); break;
     Default :
        resultValue = -1;
  }
  
}

on sysvar_update sysvar::VDDM::Backbone::Signals::Control::UB::GearLvrIndcn_UB_Control
{
  long resultValue;
  
  // --- FR ---
  setBusContext(getBusNameContext(gFR1BusName));
  switch(@this)
  {
     Case(this::SignalUBOFF) :
        resultValue = DisturbUB(Backbone::VDDM::VDDMBackBoneSignalIPdu02::GearLvrIndcn_UB,0,-1,0); break;
     Case(this::SignalUBHandled) :
        resultValue = DisturbUB(Backbone::VDDM::VDDMBackBoneSignalIPdu02::GearLvrIndcn_UB,0,0,0); break;
     Case(this::SignalUBON) :
        resultValue = DisturbUB(Backbone::VDDM::VDDMBackBoneSignalIPdu02::GearLvrIndcn_UB,0,-1,1); break;
     Default :
        resultValue = -1;
  }
  
}

on sysvar_update sysvar::VDDM::Backbone::Signals::Control::UB::PrpsnStsForAcc_UB_Control
{
  long resultValue;
  
  // --- FR ---
  setBusContext(getBusNameContext(gFR1BusName));
  switch(@this)
  {
     Case(this::SignalUBOFF) :
        resultValue = DisturbUB(Backbone::VDDM::VDDMBackBoneSignalIPdu02::PrpsnStsForAcc_UB,0,-1,0); break;
     Case(this::SignalUBHandled) :
        resultValue = DisturbUB(Backbone::VDDM::VDDMBackBoneSignalIPdu02::PrpsnStsForAcc_UB,0,0,0); break;
     Case(this::SignalUBON) :
        resultValue = DisturbUB(Backbone::VDDM::VDDMBackBoneSignalIPdu02::PrpsnStsForAcc_UB,0,-1,1); break;
     Default :
        resultValue = -1;
  }
  
}

on sysvar_update sysvar::VDDM::Backbone::Signals::Control::UB::RlyCrashForHvsysReq_UB_Control
{
  long resultValue;
  
  // --- FR ---
  setBusContext(getBusNameContext(gFR1BusName));
  switch(@this)
  {
     Case(this::SignalUBOFF) :
        resultValue = DisturbUB(Backbone::VDDM::VDDMBackBoneSignalIPdu02::RlyCrashForHvsysReq_UB,0,-1,0); break;
     Case(this::SignalUBHandled) :
        resultValue = DisturbUB(Backbone::VDDM::VDDMBackBoneSignalIPdu02::RlyCrashForHvsysReq_UB,0,0,0); break;
     Case(this::SignalUBON) :
        resultValue = DisturbUB(Backbone::VDDM::VDDMBackBoneSignalIPdu02::RlyCrashForHvsysReq_UB,0,-1,1); break;
     Default :
        resultValue = -1;
  }
  
}

on sysvar_update sysvar::VDDM::Backbone::Signals::Control::UB::SteerWhlTqLimActvd_UB_Control
{
  long resultValue;
  
  // --- FR ---
  setBusContext(getBusNameContext(gFR1BusName));
  switch(@this)
  {
     Case(this::SignalUBOFF) :
        resultValue = DisturbUB(Backbone::VDDM::VDDMBackBoneSignalIPdu02::SteerWhlTqLimActvd_UB,0,-1,0); break;
     Case(this::SignalUBHandled) :
        resultValue = DisturbUB(Backbone::VDDM::VDDMBackBoneSignalIPdu02::SteerWhlTqLimActvd_UB,0,0,0); break;
     Case(this::SignalUBON) :
        resultValue = DisturbUB(Backbone::VDDM::VDDMBackBoneSignalIPdu02::SteerWhlTqLimActvd_UB,0,-1,1); break;
     Default :
        resultValue = -1;
  }
  
}

on sysvar_update sysvar::VDDM::Backbone::Signals::Control::UB::UBoostReqBySteerFrnt_UB_Control
{
  long resultValue;
  
  // --- FR ---
  setBusContext(getBusNameContext(gFR1BusName));
  switch(@this)
  {
     Case(this::SignalUBOFF) :
        resultValue = DisturbUB(Backbone::VDDM::VDDMBackBoneSignalIPdu02::UBoostReqBySteerFrnt_UB,0,-1,0); break;
     Case(this::SignalUBHandled) :
        resultValue = DisturbUB(Backbone::VDDM::VDDMBackBoneSignalIPdu02::UBoostReqBySteerFrnt_UB,0,0,0); break;
     Case(this::SignalUBON) :
        resultValue = DisturbUB(Backbone::VDDM::VDDMBackBoneSignalIPdu02::UBoostReqBySteerFrnt_UB,0,-1,1); break;
     Default :
        resultValue = -1;
  }
  
}

on sysvar_update sysvar::VDDM::Backbone::Signals::Control::UB::WhlMotSysSpdAct_UB_Control
{
  long resultValue;
  
  // --- FR ---
  setBusContext(getBusNameContext(gFR1BusName));
  switch(@this)
  {
     Case(this::SignalUBOFF) :
        resultValue = DisturbUB(Backbone::VDDM::VDDMBackBoneSignalIPdu02::WhlMotSysSpdAct_UB,0,-1,0); break;
     Case(this::SignalUBHandled) :
        resultValue = DisturbUB(Backbone::VDDM::VDDMBackBoneSignalIPdu02::WhlMotSysSpdAct_UB,0,0,0); break;
     Case(this::SignalUBON) :
        resultValue = DisturbUB(Backbone::VDDM::VDDMBackBoneSignalIPdu02::WhlMotSysSpdAct_UB,0,-1,1); break;
     Default :
        resultValue = -1;
  }
  
}

on sysvar_update sysvar::VDDM::Backbone::SignalGroups::Control::E2E::AccrPedlPsdAccrPedlPsdChks_Control
{
  int controlValue;
  long resultValue;
  
  // --- FR ---
  controlValue = (int) @this;
  setBusContext(getBusNameContext(gFR1BusName));
  switch(controlValue)
  {
     Case(this::ChksHandled) :
        resultValue = EnableCRC("AccrPedlPsd", 1); break;
     Case(this::ChksManual) :
        resultValue = EnableCRC("AccrPedlPsd", 0); break;
     Default :
        resultValue = -1;
  }
  
}

on sysvar_update sysvar::VDDM::Backbone::SignalGroups::Control::E2E::AccrPedlPsdAccrPedlPsdCntr_Control
{
  int controlValue;
  long resultValue;
  
  // --- FR ---
  controlValue = (int) @this;
  setBusContext(getBusNameContext(gFR1BusName));
  switch(controlValue)
  {
     Case(this::CntrHandled) :
        resultValue = EnableCounter ("AccrPedlPsd", 1); break;
     Case(this::CntrManual) :
        resultValue = EnableCounter ("AccrPedlPsd", 0); break;
     Default :
        resultValue = -1;
  }
  
}

on sysvar_update sysvar::VDDM::Backbone::SignalGroups::Control::E2E::CluPedlPsdCluPedlPsdChks_Control
{
  int controlValue;
  long resultValue;
  
  // --- FR ---
  controlValue = (int) @this;
  setBusContext(getBusNameContext(gFR1BusName));
  switch(controlValue)
  {
     Case(this::ChksHandled) :
        resultValue = EnableCRC("CluPedlPsd", 1); break;
     Case(this::ChksManual) :
        resultValue = EnableCRC("CluPedlPsd", 0); break;
     Default :
        resultValue = -1;
  }
  
}

on sysvar_update sysvar::VDDM::Backbone::SignalGroups::Control::E2E::CluPedlPsdCluPedlPsdCntr_Control
{
  int controlValue;
  long resultValue;
  
  // --- FR ---
  controlValue = (int) @this;
  setBusContext(getBusNameContext(gFR1BusName));
  switch(controlValue)
  {
     Case(this::CntrHandled) :
        resultValue = EnableCounter ("CluPedlPsd", 1); break;
     Case(this::CntrManual) :
        resultValue = EnableCounter ("CluPedlPsd", 0); break;
     Default :
        resultValue = -1;
  }
  
}

on sysvar_update sysvar::VDDM::Backbone::SignalGroups::Control::E2E::EngNChks_Control
{
  int controlValue;
  long resultValue;
  
  // --- FR ---
  controlValue = (int) @this;
  setBusContext(getBusNameContext(gFR1BusName));
  switch(controlValue)
  {
     Case(this::ChksHandled) :
        resultValue = EnableCRC("EngNSafe", 1); break;
     Case(this::ChksManual) :
        resultValue = EnableCRC("EngNSafe", 0); break;
     Default :
        resultValue = -1;
  }
  
}

on sysvar_update sysvar::VDDM::Backbone::SignalGroups::Control::E2E::EngNCntr_Control
{
  int controlValue;
  long resultValue;
  
  // --- FR ---
  controlValue = (int) @this;
  setBusContext(getBusNameContext(gFR1BusName));
  switch(controlValue)
  {
     Case(this::CntrHandled) :
        resultValue = EnableCounter ("EngNSafe", 1); break;
     Case(this::CntrManual) :
        resultValue = EnableCounter ("EngNSafe", 0); break;
     Default :
        resultValue = -1;
  }
  
}

on sysvar_update sysvar::VDDM::Backbone::SignalGroups::Control::E2E::SteerErrReqChks_Control
{
  int controlValue;
  long resultValue;
  
  // --- FR ---
  controlValue = (int) @this;
  setBusContext(getBusNameContext(gFR1BusName));
  switch(controlValue)
  {
     Case(this::ChksHandled) :
        resultValue = EnableCRC("SteerErrReqSafe", 1); break;
     Case(this::ChksManual) :
        resultValue = EnableCRC("SteerErrReqSafe", 0); break;
     Default :
        resultValue = -1;
  }
  
}

on sysvar_update sysvar::VDDM::Backbone::SignalGroups::Control::E2E::SteerErrReqCntr_Control
{
  int controlValue;
  long resultValue;
  
  // --- FR ---
  controlValue = (int) @this;
  setBusContext(getBusNameContext(gFR1BusName));
  switch(controlValue)
  {
     Case(this::CntrHandled) :
        resultValue = EnableCounter ("SteerErrReqSafe", 1); break;
     Case(this::CntrManual) :
        resultValue = EnableCounter ("SteerErrReqSafe", 0); break;
     Default :
        resultValue = -1;
  }
  
}

on sysvar_update sysvar::VDDM::Backbone::SignalGroups::Control::E2E::WhlMotSysTqEstChks_Control
{
  int controlValue;
  long resultValue;
  
  // --- FR ---
  controlValue = (int) @this;
  setBusContext(getBusNameContext(gFR1BusName));
  switch(controlValue)
  {
     Case(this::ChksHandled) :
        resultValue = EnableCRC("WhlMotSysTqEstGroup", 1); break;
     Case(this::ChksManual) :
        resultValue = EnableCRC("WhlMotSysTqEstGroup", 0); break;
     Default :
        resultValue = -1;
  }
  
}

on sysvar_update sysvar::VDDM::Backbone::SignalGroups::Control::E2E::WhlMotSysTqEstCntr_Control
{
  int controlValue;
  long resultValue;
  
  // --- FR ---
  controlValue = (int) @this;
  setBusContext(getBusNameContext(gFR1BusName));
  switch(controlValue)
  {
     Case(this::CntrHandled) :
        resultValue = EnableCounter ("WhlMotSysTqEstGroup", 1); break;
     Case(this::CntrManual) :
        resultValue = EnableCounter ("WhlMotSysTqEstGroup", 0); break;
     Default :
        resultValue = -1;
  }
  
}

on sysvar_update sysvar::VDDM::Backbone::Signals::Control::UB::AccrPedlPsd_UB_Control
{
  long resultValue;
  
  // --- FR ---
  setBusContext(getBusNameContext(gFR1BusName));
  switch(@this)
  {
     Case(this::SignalUBOFF) :
        resultValue = DisturbUB(Backbone::VDDM::VDDMBackBoneSignalIPdu03::AccrPedlPsd_UB,0,-1,0); break;
     Case(this::SignalUBHandled) :
        resultValue = DisturbUB(Backbone::VDDM::VDDMBackBoneSignalIPdu03::AccrPedlPsd_UB,0,0,0); break;
     Case(this::SignalUBON) :
        resultValue = DisturbUB(Backbone::VDDM::VDDMBackBoneSignalIPdu03::AccrPedlPsd_UB,0,-1,1); break;
     Default :
        resultValue = -1;
  }
  
}

on sysvar_update sysvar::VDDM::Backbone::Signals::Control::UB::CluPedlPsd_UB_Control
{
  long resultValue;
  
  // --- FR ---
  setBusContext(getBusNameContext(gFR1BusName));
  switch(@this)
  {
     Case(this::SignalUBOFF) :
        resultValue = DisturbUB(Backbone::VDDM::VDDMBackBoneSignalIPdu03::CluPedlPsd_UB,0,-1,0); break;
     Case(this::SignalUBHandled) :
        resultValue = DisturbUB(Backbone::VDDM::VDDMBackBoneSignalIPdu03::CluPedlPsd_UB,0,0,0); break;
     Case(this::SignalUBON) :
        resultValue = DisturbUB(Backbone::VDDM::VDDMBackBoneSignalIPdu03::CluPedlPsd_UB,0,-1,1); break;
     Default :
        resultValue = -1;
  }
  
}

on sysvar_update sysvar::VDDM::Backbone::Signals::Control::UB::DrvrSteerWhlHldGroup_UB_Control
{
  long resultValue;
  
  // --- FR ---
  setBusContext(getBusNameContext(gFR1BusName));
  switch(@this)
  {
     Case(this::SignalUBOFF) :
        resultValue = DisturbUB(Backbone::VDDM::VDDMBackBoneSignalIPdu03::DrvrSteerWhlHldGroup_UB,0,-1,0); break;
     Case(this::SignalUBHandled) :
        resultValue = DisturbUB(Backbone::VDDM::VDDMBackBoneSignalIPdu03::DrvrSteerWhlHldGroup_UB,0,0,0); break;
     Case(this::SignalUBON) :
        resultValue = DisturbUB(Backbone::VDDM::VDDMBackBoneSignalIPdu03::DrvrSteerWhlHldGroup_UB,0,-1,1); break;
     Default :
        resultValue = -1;
  }
  
}

on sysvar_update sysvar::VDDM::Backbone::Signals::Control::UB::EngNSafe_UB_Control
{
  long resultValue;
  
  // --- FR ---
  setBusContext(getBusNameContext(gFR1BusName));
  switch(@this)
  {
     Case(this::SignalUBOFF) :
        resultValue = DisturbUB(Backbone::VDDM::VDDMBackBoneSignalIPdu03::EngNSafe_UB,0,-1,0); break;
     Case(this::SignalUBHandled) :
        resultValue = DisturbUB(Backbone::VDDM::VDDMBackBoneSignalIPdu03::EngNSafe_UB,0,0,0); break;
     Case(this::SignalUBON) :
        resultValue = DisturbUB(Backbone::VDDM::VDDMBackBoneSignalIPdu03::EngNSafe_UB,0,-1,1); break;
     Default :
        resultValue = -1;
  }
  
}

on sysvar_update sysvar::VDDM::Backbone::Signals::Control::UB::PtTqAtWhlFrntActGroup_UB_Control
{
  long resultValue;
  
  // --- FR ---
  setBusContext(getBusNameContext(gFR1BusName));
  switch(@this)
  {
     Case(this::SignalUBOFF) :
        resultValue = DisturbUB(Backbone::VDDM::VDDMBackBoneSignalIPdu03::PtTqAtWhlFrntActGroup_UB,0,-1,0); break;
     Case(this::SignalUBHandled) :
        resultValue = DisturbUB(Backbone::VDDM::VDDMBackBoneSignalIPdu03::PtTqAtWhlFrntActGroup_UB,0,0,0); break;
     Case(this::SignalUBON) :
        resultValue = DisturbUB(Backbone::VDDM::VDDMBackBoneSignalIPdu03::PtTqAtWhlFrntActGroup_UB,0,-1,1); break;
     Default :
        resultValue = -1;
  }
  
}

on sysvar_update sysvar::VDDM::Backbone::Signals::Control::UB::SteerErrReqSafe_UB_Control
{
  long resultValue;
  
  // --- FR ---
  setBusContext(getBusNameContext(gFR1BusName));
  switch(@this)
  {
     Case(this::SignalUBOFF) :
        resultValue = DisturbUB(Backbone::VDDM::VDDMBackBoneSignalIPdu03::SteerErrReqSafe_UB,0,-1,0); break;
     Case(this::SignalUBHandled) :
        resultValue = DisturbUB(Backbone::VDDM::VDDMBackBoneSignalIPdu03::SteerErrReqSafe_UB,0,0,0); break;
     Case(this::SignalUBON) :
        resultValue = DisturbUB(Backbone::VDDM::VDDMBackBoneSignalIPdu03::SteerErrReqSafe_UB,0,-1,1); break;
     Default :
        resultValue = -1;
  }
  
}

on sysvar_update sysvar::VDDM::Backbone::Signals::Control::UB::WhlMotSysTqEstGroup_UB_Control
{
  long resultValue;
  
  // --- FR ---
  setBusContext(getBusNameContext(gFR1BusName));
  switch(@this)
  {
     Case(this::SignalUBOFF) :
        resultValue = DisturbUB(Backbone::VDDM::VDDMBackBoneSignalIPdu03::WhlMotSysTqEstGroup_UB,0,-1,0); break;
     Case(this::SignalUBHandled) :
        resultValue = DisturbUB(Backbone::VDDM::VDDMBackBoneSignalIPdu03::WhlMotSysTqEstGroup_UB,0,0,0); break;
     Case(this::SignalUBON) :
        resultValue = DisturbUB(Backbone::VDDM::VDDMBackBoneSignalIPdu03::WhlMotSysTqEstGroup_UB,0,-1,1); break;
     Default :
        resultValue = -1;
  }
  
}

on sysvar_update sysvar::VDDM::Backbone::Signals::Control::UB::AccrPedlRatGrdt_UB_Control
{
  long resultValue;
  
  // --- FR ---
  setBusContext(getBusNameContext(gFR1BusName));
  switch(@this)
  {
     Case(this::SignalUBOFF) :
        resultValue = DisturbUB(Backbone::VDDM::VDDMBackBoneSignalIPdu03::AccrPedlRatGrdt_UB,0,-1,0); break;
     Case(this::SignalUBHandled) :
        resultValue = DisturbUB(Backbone::VDDM::VDDMBackBoneSignalIPdu03::AccrPedlRatGrdt_UB,0,0,0); break;
     Case(this::SignalUBON) :
        resultValue = DisturbUB(Backbone::VDDM::VDDMBackBoneSignalIPdu03::AccrPedlRatGrdt_UB,0,-1,1); break;
     Default :
        resultValue = -1;
  }
  
}

on sysvar_update sysvar::VDDM::Backbone::Signals::Control::UB::BrkRelsWarnReq_UB_Control
{
  long resultValue;
  
  // --- FR ---
  setBusContext(getBusNameContext(gFR1BusName));
  switch(@this)
  {
     Case(this::SignalUBOFF) :
        resultValue = DisturbUB(Backbone::VDDM::VDDMBackBoneSignalIPdu03::BrkRelsWarnReq_UB,0,-1,0); break;
     Case(this::SignalUBHandled) :
        resultValue = DisturbUB(Backbone::VDDM::VDDMBackBoneSignalIPdu03::BrkRelsWarnReq_UB,0,0,0); break;
     Case(this::SignalUBON) :
        resultValue = DisturbUB(Backbone::VDDM::VDDMBackBoneSignalIPdu03::BrkRelsWarnReq_UB,0,-1,1); break;
     Default :
        resultValue = -1;
  }
  
}

on sysvar_update sysvar::VDDM::Backbone::Signals::Control::UB::DispOfBrkPwrPercRgnMin_UB_Control
{
  long resultValue;
  
  // --- FR ---
  setBusContext(getBusNameContext(gFR1BusName));
  switch(@this)
  {
     Case(this::SignalUBOFF) :
        resultValue = DisturbUB(Backbone::VDDM::VDDMBackBoneSignalIPdu03::DispOfBrkPwrPercRgnMin_UB,0,-1,0); break;
     Case(this::SignalUBHandled) :
        resultValue = DisturbUB(Backbone::VDDM::VDDMBackBoneSignalIPdu03::DispOfBrkPwrPercRgnMin_UB,0,0,0); break;
     Case(this::SignalUBON) :
        resultValue = DisturbUB(Backbone::VDDM::VDDMBackBoneSignalIPdu03::DispOfBrkPwrPercRgnMin_UB,0,-1,1); break;
     Default :
        resultValue = -1;
  }
  
}

on sysvar_update sysvar::VDDM::Backbone::Signals::Control::UB::DispOfPrpsnPwrPercElecMax_UB_Control
{
  long resultValue;
  
  // --- FR ---
  setBusContext(getBusNameContext(gFR1BusName));
  switch(@this)
  {
     Case(this::SignalUBOFF) :
        resultValue = DisturbUB(Backbone::VDDM::VDDMBackBoneSignalIPdu03::DispOfPrpsnPwrPercElecMax_UB,0,-1,0); break;
     Case(this::SignalUBHandled) :
        resultValue = DisturbUB(Backbone::VDDM::VDDMBackBoneSignalIPdu03::DispOfPrpsnPwrPercElecMax_UB,0,0,0); break;
     Case(this::SignalUBON) :
        resultValue = DisturbUB(Backbone::VDDM::VDDMBackBoneSignalIPdu03::DispOfPrpsnPwrPercElecMax_UB,0,-1,1); break;
     Default :
        resultValue = -1;
  }
  
}

on sysvar_update sysvar::VDDM::Backbone::Signals::Control::UB::FltElecDcDc_UB_Control
{
  long resultValue;
  
  // --- FR ---
  setBusContext(getBusNameContext(gFR1BusName));
  switch(@this)
  {
     Case(this::SignalUBOFF) :
        resultValue = DisturbUB(Backbone::VDDM::VDDMBackBoneSignalIPdu03::FltElecDcDc_UB,0,-1,0); break;
     Case(this::SignalUBHandled) :
        resultValue = DisturbUB(Backbone::VDDM::VDDMBackBoneSignalIPdu03::FltElecDcDc_UB,0,0,0); break;
     Case(this::SignalUBON) :
        resultValue = DisturbUB(Backbone::VDDM::VDDMBackBoneSignalIPdu03::FltElecDcDc_UB,0,-1,1); break;
     Default :
        resultValue = -1;
  }
  
}

on sysvar_update sysvar::VDDM::Backbone::Signals::Control::UB::FltTDcDc_UB_Control
{
  long resultValue;
  
  // --- FR ---
  setBusContext(getBusNameContext(gFR1BusName));
  switch(@this)
  {
     Case(this::SignalUBOFF) :
        resultValue = DisturbUB(Backbone::VDDM::VDDMBackBoneSignalIPdu03::FltTDcDc_UB,0,-1,0); break;
     Case(this::SignalUBHandled) :
        resultValue = DisturbUB(Backbone::VDDM::VDDMBackBoneSignalIPdu03::FltTDcDc_UB,0,0,0); break;
     Case(this::SignalUBON) :
        resultValue = DisturbUB(Backbone::VDDM::VDDMBackBoneSignalIPdu03::FltTDcDc_UB,0,-1,1); break;
     Default :
        resultValue = -1;
  }
  
}

on sysvar_update sysvar::VDDM::Backbone::Signals::Control::UB::HvCooltHeatrEnad_UB_Control
{
  long resultValue;
  
  // --- FR ---
  setBusContext(getBusNameContext(gFR1BusName));
  switch(@this)
  {
     Case(this::SignalUBOFF) :
        resultValue = DisturbUB(Backbone::VDDM::VDDMBackBoneSignalIPdu03::HvCooltHeatrEnad_UB,0,-1,0); break;
     Case(this::SignalUBHandled) :
        resultValue = DisturbUB(Backbone::VDDM::VDDMBackBoneSignalIPdu03::HvCooltHeatrEnad_UB,0,0,0); break;
     Case(this::SignalUBON) :
        resultValue = DisturbUB(Backbone::VDDM::VDDMBackBoneSignalIPdu03::HvCooltHeatrEnad_UB,0,-1,1); break;
     Default :
        resultValue = -1;
  }
  
}

on sysvar_update sysvar::VDDM::Backbone::Signals::Control::UB::IDcDcActLoSide_UB_Control
{
  long resultValue;
  
  // --- FR ---
  setBusContext(getBusNameContext(gFR1BusName));
  switch(@this)
  {
     Case(this::SignalUBOFF) :
        resultValue = DisturbUB(Backbone::VDDM::VDDMBackBoneSignalIPdu03::IDcDcActLoSide_UB,0,-1,0); break;
     Case(this::SignalUBHandled) :
        resultValue = DisturbUB(Backbone::VDDM::VDDMBackBoneSignalIPdu03::IDcDcActLoSide_UB,0,0,0); break;
     Case(this::SignalUBON) :
        resultValue = DisturbUB(Backbone::VDDM::VDDMBackBoneSignalIPdu03::IDcDcActLoSide_UB,0,-1,1); break;
     Default :
        resultValue = -1;
  }
  
}

on sysvar_update sysvar::VDDM::Backbone::Signals::Control::UB::IDcDcAvlMaxLoSide_UB_Control
{
  long resultValue;
  
  // --- FR ---
  setBusContext(getBusNameContext(gFR1BusName));
  switch(@this)
  {
     Case(this::SignalUBOFF) :
        resultValue = DisturbUB(Backbone::VDDM::VDDMBackBoneSignalIPdu03::IDcDcAvlMaxLoSide_UB,0,-1,0); break;
     Case(this::SignalUBHandled) :
        resultValue = DisturbUB(Backbone::VDDM::VDDMBackBoneSignalIPdu03::IDcDcAvlMaxLoSide_UB,0,0,0); break;
     Case(this::SignalUBON) :
        resultValue = DisturbUB(Backbone::VDDM::VDDMBackBoneSignalIPdu03::IDcDcAvlMaxLoSide_UB,0,-1,1); break;
     Default :
        resultValue = -1;
  }
  
}

on sysvar_update sysvar::VDDM::Backbone::Signals::Control::UB::ParkByDrvrWhlsFrnt_UB_Control
{
  long resultValue;
  
  // --- FR ---
  setBusContext(getBusNameContext(gFR1BusName));
  switch(@this)
  {
     Case(this::SignalUBOFF) :
        resultValue = DisturbUB(Backbone::VDDM::VDDMBackBoneSignalIPdu03::ParkByDrvrWhlsFrnt_UB,0,-1,0); break;
     Case(this::SignalUBHandled) :
        resultValue = DisturbUB(Backbone::VDDM::VDDMBackBoneSignalIPdu03::ParkByDrvrWhlsFrnt_UB,0,0,0); break;
     Case(this::SignalUBON) :
        resultValue = DisturbUB(Backbone::VDDM::VDDMBackBoneSignalIPdu03::ParkByDrvrWhlsFrnt_UB,0,-1,1); break;
     Default :
        resultValue = -1;
  }
  
}

on sysvar_update sysvar::VDDM::Backbone::Signals::Control::UB::SteerTqReqScaCoeff_UB_Control
{
  long resultValue;
  
  // --- FR ---
  setBusContext(getBusNameContext(gFR1BusName));
  switch(@this)
  {
     Case(this::SignalUBOFF) :
        resultValue = DisturbUB(Backbone::VDDM::VDDMBackBoneSignalIPdu03::SteerTqReqScaCoeff_UB,0,-1,0); break;
     Case(this::SignalUBHandled) :
        resultValue = DisturbUB(Backbone::VDDM::VDDMBackBoneSignalIPdu03::SteerTqReqScaCoeff_UB,0,0,0); break;
     Case(this::SignalUBON) :
        resultValue = DisturbUB(Backbone::VDDM::VDDMBackBoneSignalIPdu03::SteerTqReqScaCoeff_UB,0,-1,1); break;
     Default :
        resultValue = -1;
  }
  
}

on sysvar_update sysvar::VDDM::Backbone::SignalGroups::Control::E2E::VehVVehVChks_Control
{
  int controlValue;
  long resultValue;
  
  // --- FR ---
  controlValue = (int) @this;
  setBusContext(getBusNameContext(gFR1BusName));
  switch(controlValue)
  {
     Case(this::ChksHandled) :
        resultValue = EnableCRC("VehV", 1); break;
     Case(this::ChksManual) :
        resultValue = EnableCRC("VehV", 0); break;
     Default :
        resultValue = -1;
  }
  
}

on sysvar_update sysvar::VDDM::Backbone::SignalGroups::Control::E2E::VehVVehVCntr_Control
{
  int controlValue;
  long resultValue;
  
  // --- FR ---
  controlValue = (int) @this;
  setBusContext(getBusNameContext(gFR1BusName));
  switch(controlValue)
  {
     Case(this::CntrHandled) :
        resultValue = EnableCounter ("VehV", 1); break;
     Case(this::CntrManual) :
        resultValue = EnableCounter ("VehV", 0); break;
     Default :
        resultValue = -1;
  }
  
}

on sysvar_update sysvar::VDDM::Backbone::SignalGroups::Control::E2E::WhlSpdCircumlFrntWhlSpdCircumlFrntChks_Control
{
  int controlValue;
  long resultValue;
  
  // --- FR ---
  controlValue = (int) @this;
  setBusContext(getBusNameContext(gFR1BusName));
  switch(controlValue)
  {
     Case(this::ChksHandled) :
        resultValue = EnableCRC("WhlSpdCircumlFrnt", 1); break;
     Case(this::ChksManual) :
        resultValue = EnableCRC("WhlSpdCircumlFrnt", 0); break;
     Default :
        resultValue = -1;
  }
  
}

on sysvar_update sysvar::VDDM::Backbone::SignalGroups::Control::E2E::WhlSpdCircumlFrntWhlSpdCircumlFrntCntr_Control
{
  int controlValue;
  long resultValue;
  
  // --- FR ---
  controlValue = (int) @this;
  setBusContext(getBusNameContext(gFR1BusName));
  switch(controlValue)
  {
     Case(this::CntrHandled) :
        resultValue = EnableCounter ("WhlSpdCircumlFrnt", 1); break;
     Case(this::CntrManual) :
        resultValue = EnableCounter ("WhlSpdCircumlFrnt", 0); break;
     Default :
        resultValue = -1;
  }
  
}

on sysvar_update sysvar::VDDM::Backbone::SignalGroups::Control::E2E::WhlSpdCircumlReWhlSpdCircumlReChks_Control
{
  int controlValue;
  long resultValue;
  
  // --- FR ---
  controlValue = (int) @this;
  setBusContext(getBusNameContext(gFR1BusName));
  switch(controlValue)
  {
     Case(this::ChksHandled) :
        resultValue = EnableCRC("WhlSpdCircumlRe", 1); break;
     Case(this::ChksManual) :
        resultValue = EnableCRC("WhlSpdCircumlRe", 0); break;
     Default :
        resultValue = -1;
  }
  
}

on sysvar_update sysvar::VDDM::Backbone::SignalGroups::Control::E2E::WhlSpdCircumlReWhlSpdCircumlReCntr_Control
{
  int controlValue;
  long resultValue;
  
  // --- FR ---
  controlValue = (int) @this;
  setBusContext(getBusNameContext(gFR1BusName));
  switch(controlValue)
  {
     Case(this::CntrHandled) :
        resultValue = EnableCounter ("WhlSpdCircumlRe", 1); break;
     Case(this::CntrManual) :
        resultValue = EnableCounter ("WhlSpdCircumlRe", 0); break;
     Default :
        resultValue = -1;
  }
  
}

on sysvar_update sysvar::VDDM::Backbone::Signals::Control::UB::CchForFuEco_UB_Control
{
  long resultValue;
  
  // --- FR ---
  setBusContext(getBusNameContext(gFR1BusName));
  switch(@this)
  {
     Case(this::SignalUBOFF) :
        resultValue = DisturbUB(Backbone::VDDM::VDDMBackBoneSignalIPdu04::CchForFuEco_UB,0,-1,0); break;
     Case(this::SignalUBHandled) :
        resultValue = DisturbUB(Backbone::VDDM::VDDMBackBoneSignalIPdu04::CchForFuEco_UB,0,0,0); break;
     Case(this::SignalUBON) :
        resultValue = DisturbUB(Backbone::VDDM::VDDMBackBoneSignalIPdu04::CchForFuEco_UB,0,-1,1); break;
     Default :
        resultValue = -1;
  }
  
}

on sysvar_update sysvar::VDDM::Backbone::Signals::Control::UB::PtCluTq_UB_Control
{
  long resultValue;
  
  // --- FR ---
  setBusContext(getBusNameContext(gFR1BusName));
  switch(@this)
  {
     Case(this::SignalUBOFF) :
        resultValue = DisturbUB(Backbone::VDDM::VDDMBackBoneSignalIPdu04::PtCluTq_UB,0,-1,0); break;
     Case(this::SignalUBHandled) :
        resultValue = DisturbUB(Backbone::VDDM::VDDMBackBoneSignalIPdu04::PtCluTq_UB,0,0,0); break;
     Case(this::SignalUBON) :
        resultValue = DisturbUB(Backbone::VDDM::VDDMBackBoneSignalIPdu04::PtCluTq_UB,0,-1,1); break;
     Default :
        resultValue = -1;
  }
  
}

on sysvar_update sysvar::VDDM::Backbone::Signals::Control::UB::VehV_UB_Control
{
  long resultValue;
  
  // --- FR ---
  setBusContext(getBusNameContext(gFR1BusName));
  switch(@this)
  {
     Case(this::SignalUBOFF) :
        resultValue = DisturbUB(Backbone::VDDM::VDDMBackBoneSignalIPdu04::VehV_UB,0,-1,0); break;
     Case(this::SignalUBHandled) :
        resultValue = DisturbUB(Backbone::VDDM::VDDMBackBoneSignalIPdu04::VehV_UB,0,0,0); break;
     Case(this::SignalUBON) :
        resultValue = DisturbUB(Backbone::VDDM::VDDMBackBoneSignalIPdu04::VehV_UB,0,-1,1); break;
     Default :
        resultValue = -1;
  }
  
}

on sysvar_update sysvar::VDDM::Backbone::Signals::Control::UB::WhlSpdCircumlFrnt_UB_Control
{
  long resultValue;
  
  // --- FR ---
  setBusContext(getBusNameContext(gFR1BusName));
  switch(@this)
  {
     Case(this::SignalUBOFF) :
        resultValue = DisturbUB(Backbone::VDDM::VDDMBackBoneSignalIPdu04::WhlSpdCircumlFrnt_UB,0,-1,0); break;
     Case(this::SignalUBHandled) :
        resultValue = DisturbUB(Backbone::VDDM::VDDMBackBoneSignalIPdu04::WhlSpdCircumlFrnt_UB,0,0,0); break;
     Case(this::SignalUBON) :
        resultValue = DisturbUB(Backbone::VDDM::VDDMBackBoneSignalIPdu04::WhlSpdCircumlFrnt_UB,0,-1,1); break;
     Default :
        resultValue = -1;
  }
  
}

on sysvar_update sysvar::VDDM::Backbone::Signals::Control::UB::WhlSpdCircumlRe_UB_Control
{
  long resultValue;
  
  // --- FR ---
  setBusContext(getBusNameContext(gFR1BusName));
  switch(@this)
  {
     Case(this::SignalUBOFF) :
        resultValue = DisturbUB(Backbone::VDDM::VDDMBackBoneSignalIPdu04::WhlSpdCircumlRe_UB,0,-1,0); break;
     Case(this::SignalUBHandled) :
        resultValue = DisturbUB(Backbone::VDDM::VDDMBackBoneSignalIPdu04::WhlSpdCircumlRe_UB,0,0,0); break;
     Case(this::SignalUBON) :
        resultValue = DisturbUB(Backbone::VDDM::VDDMBackBoneSignalIPdu04::WhlSpdCircumlRe_UB,0,-1,1); break;
     Default :
        resultValue = -1;
  }
  
}

on sysvar_update sysvar::VDDM::Backbone::Signals::Control::UB::EngSpdDispd_UB_Control
{
  long resultValue;
  
  // --- FR ---
  setBusContext(getBusNameContext(gFR1BusName));
  switch(@this)
  {
     Case(this::SignalUBOFF) :
        resultValue = DisturbUB(Backbone::VDDM::VDDMBackBoneSignalIPdu04::EngSpdDispd_UB,0,-1,0); break;
     Case(this::SignalUBHandled) :
        resultValue = DisturbUB(Backbone::VDDM::VDDMBackBoneSignalIPdu04::EngSpdDispd_UB,0,0,0); break;
     Case(this::SignalUBON) :
        resultValue = DisturbUB(Backbone::VDDM::VDDMBackBoneSignalIPdu04::EngSpdDispd_UB,0,-1,1); break;
     Default :
        resultValue = -1;
  }
  
}

on sysvar_update sysvar::VDDM::Backbone::Signals::Control::UB::PwrCnsReqAtHvBattFlt_UB_Control
{
  long resultValue;
  
  // --- FR ---
  setBusContext(getBusNameContext(gFR1BusName));
  switch(@this)
  {
     Case(this::SignalUBOFF) :
        resultValue = DisturbUB(Backbone::VDDM::VDDMBackBoneSignalIPdu04::PwrCnsReqAtHvBattFlt_UB,0,-1,0); break;
     Case(this::SignalUBHandled) :
        resultValue = DisturbUB(Backbone::VDDM::VDDMBackBoneSignalIPdu04::PwrCnsReqAtHvBattFlt_UB,0,0,0); break;
     Case(this::SignalUBON) :
        resultValue = DisturbUB(Backbone::VDDM::VDDMBackBoneSignalIPdu04::PwrCnsReqAtHvBattFlt_UB,0,-1,1); break;
     Default :
        resultValue = -1;
  }
  
}

on sysvar_update sysvar::VDDM::Backbone::Signals::Control::UB::SteerWhlTqAddl_UB_Control
{
  long resultValue;
  
  // --- FR ---
  setBusContext(getBusNameContext(gFR1BusName));
  switch(@this)
  {
     Case(this::SignalUBOFF) :
        resultValue = DisturbUB(Backbone::VDDM::VDDMBackBoneSignalIPdu04::SteerWhlTqAddl_UB,0,-1,0); break;
     Case(this::SignalUBHandled) :
        resultValue = DisturbUB(Backbone::VDDM::VDDMBackBoneSignalIPdu04::SteerWhlTqAddl_UB,0,0,0); break;
     Case(this::SignalUBON) :
        resultValue = DisturbUB(Backbone::VDDM::VDDMBackBoneSignalIPdu04::SteerWhlTqAddl_UB,0,-1,1); break;
     Default :
        resultValue = -1;
  }
  
}

on sysvar_update sysvar::VDDM::Backbone::SignalGroups::Control::E2E::BrkHptcStsSafeChks_Control
{
  int controlValue;
  long resultValue;
  
  // --- FR ---
  controlValue = (int) @this;
  setBusContext(getBusNameContext(gFR1BusName));
  switch(controlValue)
  {
     Case(this::ChksHandled) :
        resultValue = EnableCRC("BrkHptcStsSafeGroup", 1); break;
     Case(this::ChksManual) :
        resultValue = EnableCRC("BrkHptcStsSafeGroup", 0); break;
     Default :
        resultValue = -1;
  }
  
}

on sysvar_update sysvar::VDDM::Backbone::SignalGroups::Control::E2E::BrkHptcStsSafeCntr_Control
{
  int controlValue;
  long resultValue;
  
  // --- FR ---
  controlValue = (int) @this;
  setBusContext(getBusNameContext(gFR1BusName));
  switch(controlValue)
  {
     Case(this::CntrHandled) :
        resultValue = EnableCounter ("BrkHptcStsSafeGroup", 1); break;
     Case(this::CntrManual) :
        resultValue = EnableCounter ("BrkHptcStsSafeGroup", 0); break;
     Default :
        resultValue = -1;
  }
  
}

on sysvar_update sysvar::VDDM::Backbone::SignalGroups::Control::E2E::DrvrDesDirSafeChks_Control
{
  int controlValue;
  long resultValue;
  
  // --- FR ---
  controlValue = (int) @this;
  setBusContext(getBusNameContext(gFR1BusName));
  switch(controlValue)
  {
     Case(this::ChksHandled) :
        resultValue = EnableCRC("DrvrDesDirSafe", 1); break;
     Case(this::ChksManual) :
        resultValue = EnableCRC("DrvrDesDirSafe", 0); break;
     Default :
        resultValue = -1;
  }
  
}

on sysvar_update sysvar::VDDM::Backbone::SignalGroups::Control::E2E::DrvrDesDirSafeCntr_Control
{
  int controlValue;
  long resultValue;
  
  // --- FR ---
  controlValue = (int) @this;
  setBusContext(getBusNameContext(gFR1BusName));
  switch(controlValue)
  {
     Case(this::CntrHandled) :
        resultValue = EnableCounter ("DrvrDesDirSafe", 1); break;
     Case(this::CntrManual) :
        resultValue = EnableCounter ("DrvrDesDirSafe", 0); break;
     Default :
        resultValue = -1;
  }
  
}

on sysvar_update sysvar::VDDM::Backbone::SignalGroups::Control::E2E::EscStChks_Control
{
  int controlValue;
  long resultValue;
  
  // --- FR ---
  controlValue = (int) @this;
  setBusContext(getBusNameContext(gFR1BusName));
  switch(controlValue)
  {
     Case(this::ChksHandled) :
        resultValue = EnableCRC("EscStGroup", 1); break;
     Case(this::ChksManual) :
        resultValue = EnableCRC("EscStGroup", 0); break;
     Default :
        resultValue = -1;
  }
  
}

on sysvar_update sysvar::VDDM::Backbone::SignalGroups::Control::E2E::EscStCntr_Control
{
  int controlValue;
  long resultValue;
  
  // --- FR ---
  controlValue = (int) @this;
  setBusContext(getBusNameContext(gFR1BusName));
  switch(controlValue)
  {
     Case(this::CntrHandled) :
        resultValue = EnableCounter ("EscStGroup", 1); break;
     Case(this::CntrManual) :
        resultValue = EnableCounter ("EscStGroup", 0); break;
     Default :
        resultValue = -1;
  }
  
}

on sysvar_update sysvar::VDDM::Backbone::SignalGroups::Control::E2E::TrsmParkLockdChks_Control
{
  int controlValue;
  long resultValue;
  
  // --- FR ---
  controlValue = (int) @this;
  setBusContext(getBusNameContext(gFR1BusName));
  switch(controlValue)
  {
     Case(this::ChksHandled) :
        resultValue = EnableCRC("TrsmParkLockdSafe", 1); break;
     Case(this::ChksManual) :
        resultValue = EnableCRC("TrsmParkLockdSafe", 0); break;
     Default :
        resultValue = -1;
  }
  
}

on sysvar_update sysvar::VDDM::Backbone::SignalGroups::Control::E2E::TrsmParkLockdCntr_Control
{
  int controlValue;
  long resultValue;
  
  // --- FR ---
  controlValue = (int) @this;
  setBusContext(getBusNameContext(gFR1BusName));
  switch(controlValue)
  {
     Case(this::CntrHandled) :
        resultValue = EnableCounter ("TrsmParkLockdSafe", 1); break;
     Case(this::CntrManual) :
        resultValue = EnableCounter ("TrsmParkLockdSafe", 0); break;
     Default :
        resultValue = -1;
  }
  
}

on sysvar_update sysvar::VDDM::Backbone::Signals::Control::UB::AsyBrkEnaAckd_UB_Control
{
  long resultValue;
  
  // --- FR ---
  setBusContext(getBusNameContext(gFR1BusName));
  switch(@this)
  {
     Case(this::SignalUBOFF) :
        resultValue = DisturbUB(Backbone::VDDM::VDDMBackBoneSignalIpdu05::AsyBrkEnaAckd_UB,0,-1,0); break;
     Case(this::SignalUBHandled) :
        resultValue = DisturbUB(Backbone::VDDM::VDDMBackBoneSignalIpdu05::AsyBrkEnaAckd_UB,0,0,0); break;
     Case(this::SignalUBON) :
        resultValue = DisturbUB(Backbone::VDDM::VDDMBackBoneSignalIpdu05::AsyBrkEnaAckd_UB,0,-1,1); break;
     Default :
        resultValue = -1;
  }
  
}

on sysvar_update sysvar::VDDM::Backbone::Signals::Control::UB::BrkHptcStsSafeGroup_UB_Control
{
  long resultValue;
  
  // --- FR ---
  setBusContext(getBusNameContext(gFR1BusName));
  switch(@this)
  {
     Case(this::SignalUBOFF) :
        resultValue = DisturbUB(Backbone::VDDM::VDDMBackBoneSignalIpdu05::BrkHptcStsSafeGroup_UB,0,-1,0); break;
     Case(this::SignalUBHandled) :
        resultValue = DisturbUB(Backbone::VDDM::VDDMBackBoneSignalIpdu05::BrkHptcStsSafeGroup_UB,0,0,0); break;
     Case(this::SignalUBON) :
        resultValue = DisturbUB(Backbone::VDDM::VDDMBackBoneSignalIpdu05::BrkHptcStsSafeGroup_UB,0,-1,1); break;
     Default :
        resultValue = -1;
  }
  
}

on sysvar_update sysvar::VDDM::Backbone::Signals::Control::UB::DrvrDesDirSafe_UB_Control
{
  long resultValue;
  
  // --- FR ---
  setBusContext(getBusNameContext(gFR1BusName));
  switch(@this)
  {
     Case(this::SignalUBOFF) :
        resultValue = DisturbUB(Backbone::VDDM::VDDMBackBoneSignalIpdu05::DrvrDesDirSafe_UB,0,-1,0); break;
     Case(this::SignalUBHandled) :
        resultValue = DisturbUB(Backbone::VDDM::VDDMBackBoneSignalIpdu05::DrvrDesDirSafe_UB,0,0,0); break;
     Case(this::SignalUBON) :
        resultValue = DisturbUB(Backbone::VDDM::VDDMBackBoneSignalIpdu05::DrvrDesDirSafe_UB,0,-1,1); break;
     Default :
        resultValue = -1;
  }
  
}

on sysvar_update sysvar::VDDM::Backbone::Signals::Control::UB::EscStGroup_UB_Control
{
  long resultValue;
  
  // --- FR ---
  setBusContext(getBusNameContext(gFR1BusName));
  switch(@this)
  {
     Case(this::SignalUBOFF) :
        resultValue = DisturbUB(Backbone::VDDM::VDDMBackBoneSignalIpdu05::EscStGroup_UB,0,-1,0); break;
     Case(this::SignalUBHandled) :
        resultValue = DisturbUB(Backbone::VDDM::VDDMBackBoneSignalIpdu05::EscStGroup_UB,0,0,0); break;
     Case(this::SignalUBON) :
        resultValue = DisturbUB(Backbone::VDDM::VDDMBackBoneSignalIpdu05::EscStGroup_UB,0,-1,1); break;
     Default :
        resultValue = -1;
  }
  
}

on sysvar_update sysvar::VDDM::Backbone::Signals::Control::UB::HybErrIndcnReq_UB_Control
{
  long resultValue;
  
  // --- FR ---
  setBusContext(getBusNameContext(gFR1BusName));
  switch(@this)
  {
     Case(this::SignalUBOFF) :
        resultValue = DisturbUB(Backbone::VDDM::VDDMBackBoneSignalIpdu05::HybErrIndcnReq_UB,0,-1,0); break;
     Case(this::SignalUBHandled) :
        resultValue = DisturbUB(Backbone::VDDM::VDDMBackBoneSignalIpdu05::HybErrIndcnReq_UB,0,0,0); break;
     Case(this::SignalUBON) :
        resultValue = DisturbUB(Backbone::VDDM::VDDMBackBoneSignalIpdu05::HybErrIndcnReq_UB,0,-1,1); break;
     Default :
        resultValue = -1;
  }
  
}

on sysvar_update sysvar::VDDM::Backbone::Signals::Control::UB::ImobEngChk3_UB_Control
{
  long resultValue;
  
  // --- FR ---
  setBusContext(getBusNameContext(gFR1BusName));
  switch(@this)
  {
     Case(this::SignalUBOFF) :
        resultValue = DisturbUB(Backbone::VDDM::VDDMBackBoneSignalIpdu05::ImobEngChk3_UB,0,-1,0); break;
     Case(this::SignalUBHandled) :
        resultValue = DisturbUB(Backbone::VDDM::VDDMBackBoneSignalIpdu05::ImobEngChk3_UB,0,0,0); break;
     Case(this::SignalUBON) :
        resultValue = DisturbUB(Backbone::VDDM::VDDMBackBoneSignalIpdu05::ImobEngChk3_UB,0,-1,1); break;
     Default :
        resultValue = -1;
  }
  
}

on sysvar_update sysvar::VDDM::Backbone::Signals::Control::UB::RoadInclnGroup_UB_Control
{
  long resultValue;
  
  // --- FR ---
  setBusContext(getBusNameContext(gFR1BusName));
  switch(@this)
  {
     Case(this::SignalUBOFF) :
        resultValue = DisturbUB(Backbone::VDDM::VDDMBackBoneSignalIpdu05::RoadInclnGroup_UB,0,-1,0); break;
     Case(this::SignalUBHandled) :
        resultValue = DisturbUB(Backbone::VDDM::VDDMBackBoneSignalIpdu05::RoadInclnGroup_UB,0,0,0); break;
     Case(this::SignalUBON) :
        resultValue = DisturbUB(Backbone::VDDM::VDDMBackBoneSignalIpdu05::RoadInclnGroup_UB,0,-1,1); break;
     Default :
        resultValue = -1;
  }
  
}

on sysvar_update sysvar::VDDM::Backbone::Signals::Control::UB::RollAgCmp_UB_Control
{
  long resultValue;
  
  // --- FR ---
  setBusContext(getBusNameContext(gFR1BusName));
  switch(@this)
  {
     Case(this::SignalUBOFF) :
        resultValue = DisturbUB(Backbone::VDDM::VDDMBackBoneSignalIpdu05::RollAgCmp_UB,0,-1,0); break;
     Case(this::SignalUBHandled) :
        resultValue = DisturbUB(Backbone::VDDM::VDDMBackBoneSignalIpdu05::RollAgCmp_UB,0,0,0); break;
     Case(this::SignalUBON) :
        resultValue = DisturbUB(Backbone::VDDM::VDDMBackBoneSignalIpdu05::RollAgCmp_UB,0,-1,1); break;
     Default :
        resultValue = -1;
  }
  
}

on sysvar_update sysvar::VDDM::Backbone::Signals::Control::UB::TrsmParkLockdSafe_UB_Control
{
  long resultValue;
  
  // --- FR ---
  setBusContext(getBusNameContext(gFR1BusName));
  switch(@this)
  {
     Case(this::SignalUBOFF) :
        resultValue = DisturbUB(Backbone::VDDM::VDDMBackBoneSignalIpdu05::TrsmParkLockdSafe_UB,0,-1,0); break;
     Case(this::SignalUBHandled) :
        resultValue = DisturbUB(Backbone::VDDM::VDDMBackBoneSignalIpdu05::TrsmParkLockdSafe_UB,0,0,0); break;
     Case(this::SignalUBON) :
        resultValue = DisturbUB(Backbone::VDDM::VDDMBackBoneSignalIpdu05::TrsmParkLockdSafe_UB,0,-1,1); break;
     Default :
        resultValue = -1;
  }
  
}

on sysvar_update sysvar::VDDM::Backbone::Signals::Control::UB::AsyActrActvForLgtCtrl_UB_Control
{
  long resultValue;
  
  // --- FR ---
  setBusContext(getBusNameContext(gFR1BusName));
  switch(@this)
  {
     Case(this::SignalUBOFF) :
        resultValue = DisturbUB(Backbone::VDDM::VDDMBackBoneSignalIpdu05::AsyActrActvForLgtCtrl_UB,0,-1,0); break;
     Case(this::SignalUBHandled) :
        resultValue = DisturbUB(Backbone::VDDM::VDDMBackBoneSignalIpdu05::AsyActrActvForLgtCtrl_UB,0,0,0); break;
     Case(this::SignalUBON) :
        resultValue = DisturbUB(Backbone::VDDM::VDDMBackBoneSignalIpdu05::AsyActrActvForLgtCtrl_UB,0,-1,1); break;
     Default :
        resultValue = -1;
  }
  
}

on sysvar_update sysvar::VDDM::Backbone::Signals::Control::UB::AsyEngBrkMaxForCmft_UB_Control
{
  long resultValue;
  
  // --- FR ---
  setBusContext(getBusNameContext(gFR1BusName));
  switch(@this)
  {
     Case(this::SignalUBOFF) :
        resultValue = DisturbUB(Backbone::VDDM::VDDMBackBoneSignalIpdu05::AsyEngBrkMaxForCmft_UB,0,-1,0); break;
     Case(this::SignalUBHandled) :
        resultValue = DisturbUB(Backbone::VDDM::VDDMBackBoneSignalIpdu05::AsyEngBrkMaxForCmft_UB,0,0,0); break;
     Case(this::SignalUBON) :
        resultValue = DisturbUB(Backbone::VDDM::VDDMBackBoneSignalIpdu05::AsyEngBrkMaxForCmft_UB,0,-1,1); break;
     Default :
        resultValue = -1;
  }
  
}

on sysvar_update sysvar::VDDM::Backbone::Signals::Control::UB::AsySftyBrkDlyEstimd_UB_Control
{
  long resultValue;
  
  // --- FR ---
  setBusContext(getBusNameContext(gFR1BusName));
  switch(@this)
  {
     Case(this::SignalUBOFF) :
        resultValue = DisturbUB(Backbone::VDDM::VDDMBackBoneSignalIpdu05::AsySftyBrkDlyEstimd_UB,0,-1,0); break;
     Case(this::SignalUBHandled) :
        resultValue = DisturbUB(Backbone::VDDM::VDDMBackBoneSignalIpdu05::AsySftyBrkDlyEstimd_UB,0,0,0); break;
     Case(this::SignalUBON) :
        resultValue = DisturbUB(Backbone::VDDM::VDDMBackBoneSignalIpdu05::AsySftyBrkDlyEstimd_UB,0,-1,1); break;
     Default :
        resultValue = -1;
  }
  
}

on sysvar_update sysvar::VDDM::Backbone::Signals::Control::UB::AsySftyDecelEnadByVehDyn_UB_Control
{
  long resultValue;
  
  // --- FR ---
  setBusContext(getBusNameContext(gFR1BusName));
  switch(@this)
  {
     Case(this::SignalUBOFF) :
        resultValue = DisturbUB(Backbone::VDDM::VDDMBackBoneSignalIpdu05::AsySftyDecelEnadByVehDyn_UB,0,-1,0); break;
     Case(this::SignalUBHandled) :
        resultValue = DisturbUB(Backbone::VDDM::VDDMBackBoneSignalIpdu05::AsySftyDecelEnadByVehDyn_UB,0,0,0); break;
     Case(this::SignalUBON) :
        resultValue = DisturbUB(Backbone::VDDM::VDDMBackBoneSignalIpdu05::AsySftyDecelEnadByVehDyn_UB,0,-1,1); break;
     Default :
        resultValue = -1;
  }
  
}

on sysvar_update sysvar::VDDM::Backbone::Signals::Control::UB::ChrgnTyp_UB_Control
{
  long resultValue;
  
  // --- FR ---
  setBusContext(getBusNameContext(gFR1BusName));
  switch(@this)
  {
     Case(this::SignalUBOFF) :
        resultValue = DisturbUB(Backbone::VDDM::VDDMBackBoneSignalIpdu05::ChrgnTyp_UB,0,-1,0); break;
     Case(this::SignalUBHandled) :
        resultValue = DisturbUB(Backbone::VDDM::VDDMBackBoneSignalIpdu05::ChrgnTyp_UB,0,0,0); break;
     Case(this::SignalUBON) :
        resultValue = DisturbUB(Backbone::VDDM::VDDMBackBoneSignalIpdu05::ChrgnTyp_UB,0,-1,1); break;
     Default :
        resultValue = -1;
  }
  
}

on sysvar_update sysvar::VDDM::Backbone::Signals::Control::UB::DispOfPrpsnMod_UB_Control
{
  long resultValue;
  
  // --- FR ---
  setBusContext(getBusNameContext(gFR1BusName));
  switch(@this)
  {
     Case(this::SignalUBOFF) :
        resultValue = DisturbUB(Backbone::VDDM::VDDMBackBoneSignalIpdu05::DispOfPrpsnMod_UB,0,-1,0); break;
     Case(this::SignalUBHandled) :
        resultValue = DisturbUB(Backbone::VDDM::VDDMBackBoneSignalIpdu05::DispOfPrpsnMod_UB,0,0,0); break;
     Case(this::SignalUBON) :
        resultValue = DisturbUB(Backbone::VDDM::VDDMBackBoneSignalIpdu05::DispOfPrpsnMod_UB,0,-1,1); break;
     Default :
        resultValue = -1;
  }
  
}

on sysvar_update sysvar::VDDM::Backbone::Signals::Control::UB::EmgyBrkLiReq_UB_Control
{
  long resultValue;
  
  // --- FR ---
  setBusContext(getBusNameContext(gFR1BusName));
  switch(@this)
  {
     Case(this::SignalUBOFF) :
        resultValue = DisturbUB(Backbone::VDDM::VDDMBackBoneSignalIpdu05::EmgyBrkLiReq_UB,0,-1,0); break;
     Case(this::SignalUBHandled) :
        resultValue = DisturbUB(Backbone::VDDM::VDDMBackBoneSignalIpdu05::EmgyBrkLiReq_UB,0,0,0); break;
     Case(this::SignalUBON) :
        resultValue = DisturbUB(Backbone::VDDM::VDDMBackBoneSignalIpdu05::EmgyBrkLiReq_UB,0,-1,1); break;
     Default :
        resultValue = -1;
  }
  
}

on sysvar_update sysvar::VDDM::Backbone::Signals::Control::UB::EmgyBrkParkAutResp_UB_Control
{
  long resultValue;
  
  // --- FR ---
  setBusContext(getBusNameContext(gFR1BusName));
  switch(@this)
  {
     Case(this::SignalUBOFF) :
        resultValue = DisturbUB(Backbone::VDDM::VDDMBackBoneSignalIpdu05::EmgyBrkParkAutResp_UB,0,-1,0); break;
     Case(this::SignalUBHandled) :
        resultValue = DisturbUB(Backbone::VDDM::VDDMBackBoneSignalIpdu05::EmgyBrkParkAutResp_UB,0,0,0); break;
     Case(this::SignalUBON) :
        resultValue = DisturbUB(Backbone::VDDM::VDDMBackBoneSignalIpdu05::EmgyBrkParkAutResp_UB,0,-1,1); break;
     Default :
        resultValue = -1;
  }
  
}

on sysvar_update sysvar::VDDM::Backbone::Signals::Control::UB::EscActvCtrlIndcdToDrvr_UB_Control
{
  long resultValue;
  
  // --- FR ---
  setBusContext(getBusNameContext(gFR1BusName));
  switch(@this)
  {
     Case(this::SignalUBOFF) :
        resultValue = DisturbUB(Backbone::VDDM::VDDMBackBoneSignalIpdu05::EscActvCtrlIndcdToDrvr_UB,0,-1,0); break;
     Case(this::SignalUBHandled) :
        resultValue = DisturbUB(Backbone::VDDM::VDDMBackBoneSignalIpdu05::EscActvCtrlIndcdToDrvr_UB,0,0,0); break;
     Case(this::SignalUBON) :
        resultValue = DisturbUB(Backbone::VDDM::VDDMBackBoneSignalIpdu05::EscActvCtrlIndcdToDrvr_UB,0,-1,1); break;
     Default :
        resultValue = -1;
  }
  
}

on sysvar_update sysvar::VDDM::Backbone::Signals::Control::UB::HmiEngHybSts_UB_Control
{
  long resultValue;
  
  // --- FR ---
  setBusContext(getBusNameContext(gFR1BusName));
  switch(@this)
  {
     Case(this::SignalUBOFF) :
        resultValue = DisturbUB(Backbone::VDDM::VDDMBackBoneSignalIpdu05::HmiEngHybSts_UB,0,-1,0); break;
     Case(this::SignalUBHandled) :
        resultValue = DisturbUB(Backbone::VDDM::VDDMBackBoneSignalIpdu05::HmiEngHybSts_UB,0,0,0); break;
     Case(this::SignalUBON) :
        resultValue = DisturbUB(Backbone::VDDM::VDDMBackBoneSignalIpdu05::HmiEngHybSts_UB,0,-1,1); break;
     Default :
        resultValue = -1;
  }
  
}

on sysvar_update sysvar::VDDM::Backbone::Signals::Control::UB::HmiFuLidNotClsd_UB_Control
{
  long resultValue;
  
  // --- FR ---
  setBusContext(getBusNameContext(gFR1BusName));
  switch(@this)
  {
     Case(this::SignalUBOFF) :
        resultValue = DisturbUB(Backbone::VDDM::VDDMBackBoneSignalIpdu05::HmiFuLidNotClsd_UB,0,-1,0); break;
     Case(this::SignalUBHandled) :
        resultValue = DisturbUB(Backbone::VDDM::VDDMBackBoneSignalIpdu05::HmiFuLidNotClsd_UB,0,0,0); break;
     Case(this::SignalUBON) :
        resultValue = DisturbUB(Backbone::VDDM::VDDMBackBoneSignalIpdu05::HmiFuLidNotClsd_UB,0,-1,1); break;
     Default :
        resultValue = -1;
  }
  
}

on sysvar_update sysvar::VDDM::Backbone::Signals::Control::UB::HmiFuTankRdy_UB_Control
{
  long resultValue;
  
  // --- FR ---
  setBusContext(getBusNameContext(gFR1BusName));
  switch(@this)
  {
     Case(this::SignalUBOFF) :
        resultValue = DisturbUB(Backbone::VDDM::VDDMBackBoneSignalIpdu05::HmiFuTankRdy_UB,0,-1,0); break;
     Case(this::SignalUBHandled) :
        resultValue = DisturbUB(Backbone::VDDM::VDDMBackBoneSignalIpdu05::HmiFuTankRdy_UB,0,0,0); break;
     Case(this::SignalUBON) :
        resultValue = DisturbUB(Backbone::VDDM::VDDMBackBoneSignalIpdu05::HmiFuTankRdy_UB,0,-1,1); break;
     Default :
        resultValue = -1;
  }
  
}

on sysvar_update sysvar::VDDM::Backbone::Signals::Control::UB::HvBattSmtActv_UB_Control
{
  long resultValue;
  
  // --- FR ---
  setBusContext(getBusNameContext(gFR1BusName));
  switch(@this)
  {
     Case(this::SignalUBOFF) :
        resultValue = DisturbUB(Backbone::VDDM::VDDMBackBoneSignalIpdu05::HvBattSmtActv_UB,0,-1,0); break;
     Case(this::SignalUBHandled) :
        resultValue = DisturbUB(Backbone::VDDM::VDDMBackBoneSignalIpdu05::HvBattSmtActv_UB,0,0,0); break;
     Case(this::SignalUBON) :
        resultValue = DisturbUB(Backbone::VDDM::VDDMBackBoneSignalIpdu05::HvBattSmtActv_UB,0,-1,1); break;
     Default :
        resultValue = -1;
  }
  
}

on sysvar_update sysvar::VDDM::Backbone::Signals::Control::UB::HvPwrAvlForClimaEstimd_UB_Control
{
  long resultValue;
  
  // --- FR ---
  setBusContext(getBusNameContext(gFR1BusName));
  switch(@this)
  {
     Case(this::SignalUBOFF) :
        resultValue = DisturbUB(Backbone::VDDM::VDDMBackBoneSignalIpdu05::HvPwrAvlForClimaEstimd_UB,0,-1,0); break;
     Case(this::SignalUBHandled) :
        resultValue = DisturbUB(Backbone::VDDM::VDDMBackBoneSignalIpdu05::HvPwrAvlForClimaEstimd_UB,0,0,0); break;
     Case(this::SignalUBON) :
        resultValue = DisturbUB(Backbone::VDDM::VDDMBackBoneSignalIpdu05::HvPwrAvlForClimaEstimd_UB,0,-1,1); break;
     Default :
        resultValue = -1;
  }
  
}

on sysvar_update sysvar::VDDM::Backbone::Signals::Control::UB::InhbOfAsySftyDecelByVehDyn_UB_Control
{
  long resultValue;
  
  // --- FR ---
  setBusContext(getBusNameContext(gFR1BusName));
  switch(@this)
  {
     Case(this::SignalUBOFF) :
        resultValue = DisturbUB(Backbone::VDDM::VDDMBackBoneSignalIpdu05::InhbOfAsySftyDecelByVehDyn_UB,0,-1,0); break;
     Case(this::SignalUBHandled) :
        resultValue = DisturbUB(Backbone::VDDM::VDDMBackBoneSignalIpdu05::InhbOfAsySftyDecelByVehDyn_UB,0,0,0); break;
     Case(this::SignalUBON) :
        resultValue = DisturbUB(Backbone::VDDM::VDDMBackBoneSignalIpdu05::InhbOfAsySftyDecelByVehDyn_UB,0,-1,1); break;
     Default :
        resultValue = -1;
  }
  
}

on sysvar_update sysvar::VDDM::Backbone::Signals::Control::UB::PrpsnHvBattUsgModAct_UB_Control
{
  long resultValue;
  
  // --- FR ---
  setBusContext(getBusNameContext(gFR1BusName));
  switch(@this)
  {
     Case(this::SignalUBOFF) :
        resultValue = DisturbUB(Backbone::VDDM::VDDMBackBoneSignalIpdu05::PrpsnHvBattUsgModAct_UB,0,-1,0); break;
     Case(this::SignalUBHandled) :
        resultValue = DisturbUB(Backbone::VDDM::VDDMBackBoneSignalIpdu05::PrpsnHvBattUsgModAct_UB,0,0,0); break;
     Case(this::SignalUBON) :
        resultValue = DisturbUB(Backbone::VDDM::VDDMBackBoneSignalIpdu05::PrpsnHvBattUsgModAct_UB,0,-1,1); break;
     Default :
        resultValue = -1;
  }
  
}

on sysvar_update sysvar::VDDM::Backbone::SignalGroups::Control::E2E::BrkAndAbsWarnIndcnReqChks_Control
{
  int controlValue;
  long resultValue;
  
  // --- FR ---
  controlValue = (int) @this;
  setBusContext(getBusNameContext(gFR1BusName));
  switch(controlValue)
  {
     Case(this::ChksHandled) :
        resultValue = EnableCRC("BrkAndAbsWarnIndcnReqGroup", 1); break;
     Case(this::ChksManual) :
        resultValue = EnableCRC("BrkAndAbsWarnIndcnReqGroup", 0); break;
     Default :
        resultValue = -1;
  }
  
}

on sysvar_update sysvar::VDDM::Backbone::SignalGroups::Control::E2E::BrkAndAbsWarnIndcnReqCntr_Control
{
  int controlValue;
  long resultValue;
  
  // --- FR ---
  controlValue = (int) @this;
  setBusContext(getBusNameContext(gFR1BusName));
  switch(controlValue)
  {
     Case(this::CntrHandled) :
        resultValue = EnableCounter ("BrkAndAbsWarnIndcnReqGroup", 1); break;
     Case(this::CntrManual) :
        resultValue = EnableCounter ("BrkAndAbsWarnIndcnReqGroup", 0); break;
     Default :
        resultValue = -1;
  }
  
}

on sysvar_update sysvar::VDDM::Backbone::SignalGroups::Control::E2E::BrkLiOnReqChks_Control
{
  int controlValue;
  long resultValue;
  
  // --- FR ---
  controlValue = (int) @this;
  setBusContext(getBusNameContext(gFR1BusName));
  switch(controlValue)
  {
     Case(this::ChksHandled) :
        resultValue = EnableCRC("BrkLiOnReq", 1); break;
     Case(this::ChksManual) :
        resultValue = EnableCRC("BrkLiOnReq", 0); break;
     Default :
        resultValue = -1;
  }
  
}

on sysvar_update sysvar::VDDM::Backbone::SignalGroups::Control::E2E::BrkLiOnReqCntr_Control
{
  int controlValue;
  long resultValue;
  
  // --- FR ---
  controlValue = (int) @this;
  setBusContext(getBusNameContext(gFR1BusName));
  switch(controlValue)
  {
     Case(this::CntrHandled) :
        resultValue = EnableCounter ("BrkLiOnReq", 1); break;
     Case(this::CntrManual) :
        resultValue = EnableCounter ("BrkLiOnReq", 0); break;
     Default :
        resultValue = -1;
  }
  
}

on sysvar_update sysvar::VDDM::Backbone::SignalGroups::Control::E2E::OvrdDecelByDrvrOvrdDecelByDrvrChks_Control
{
  int controlValue;
  long resultValue;
  
  // --- FR ---
  controlValue = (int) @this;
  setBusContext(getBusNameContext(gFR1BusName));
  switch(controlValue)
  {
     Case(this::ChksHandled) :
        resultValue = EnableCRC("OvrdDecelByDrvr", 1); break;
     Case(this::ChksManual) :
        resultValue = EnableCRC("OvrdDecelByDrvr", 0); break;
     Default :
        resultValue = -1;
  }
  
}

on sysvar_update sysvar::VDDM::Backbone::SignalGroups::Control::E2E::OvrdDecelByDrvrOvrdDecelByDrvrCntr_Control
{
  int controlValue;
  long resultValue;
  
  // --- FR ---
  controlValue = (int) @this;
  setBusContext(getBusNameContext(gFR1BusName));
  switch(controlValue)
  {
     Case(this::CntrHandled) :
        resultValue = EnableCounter ("OvrdDecelByDrvr", 1); break;
     Case(this::CntrManual) :
        resultValue = EnableCounter ("OvrdDecelByDrvr", 0); break;
     Default :
        resultValue = -1;
  }
  
}

on sysvar_update sysvar::VDDM::Backbone::SignalGroups::Control::E2E::VehDynCtrlStsChks_Control
{
  int controlValue;
  long resultValue;
  
  // --- FR ---
  controlValue = (int) @this;
  setBusContext(getBusNameContext(gFR1BusName));
  switch(controlValue)
  {
     Case(this::ChksHandled) :
        resultValue = EnableCRC("VehDynCtrlStsForALgtCmft", 1); break;
     Case(this::ChksManual) :
        resultValue = EnableCRC("VehDynCtrlStsForALgtCmft", 0); break;
     Default :
        resultValue = -1;
  }
  
}

on sysvar_update sysvar::VDDM::Backbone::SignalGroups::Control::E2E::VehDynCtrlStsCntr_Control
{
  int controlValue;
  long resultValue;
  
  // --- FR ---
  controlValue = (int) @this;
  setBusContext(getBusNameContext(gFR1BusName));
  switch(controlValue)
  {
     Case(this::CntrHandled) :
        resultValue = EnableCounter ("VehDynCtrlStsForALgtCmft", 1); break;
     Case(this::CntrManual) :
        resultValue = EnableCounter ("VehDynCtrlStsForALgtCmft", 0); break;
     Default :
        resultValue = -1;
  }
  
}

on sysvar_update sysvar::VDDM::Backbone::Signals::Control::UB::BrkAndAbsWarnIndcnReqGroup_UB_Control
{
  long resultValue;
  
  // --- FR ---
  setBusContext(getBusNameContext(gFR1BusName));
  switch(@this)
  {
     Case(this::SignalUBOFF) :
        resultValue = DisturbUB(Backbone::VDDM::VDDMBackBoneSignalIpdu06::BrkAndAbsWarnIndcnReqGroup_UB,0,-1,0); break;
     Case(this::SignalUBHandled) :
        resultValue = DisturbUB(Backbone::VDDM::VDDMBackBoneSignalIpdu06::BrkAndAbsWarnIndcnReqGroup_UB,0,0,0); break;
     Case(this::SignalUBON) :
        resultValue = DisturbUB(Backbone::VDDM::VDDMBackBoneSignalIpdu06::BrkAndAbsWarnIndcnReqGroup_UB,0,-1,1); break;
     Default :
        resultValue = -1;
  }
  
}

on sysvar_update sysvar::VDDM::Backbone::Signals::Control::UB::BrkLiOnReq_UB_Control
{
  long resultValue;
  
  // --- FR ---
  setBusContext(getBusNameContext(gFR1BusName));
  switch(@this)
  {
     Case(this::SignalUBOFF) :
        resultValue = DisturbUB(Backbone::VDDM::VDDMBackBoneSignalIpdu06::BrkLiOnReq_UB,0,-1,0); break;
     Case(this::SignalUBHandled) :
        resultValue = DisturbUB(Backbone::VDDM::VDDMBackBoneSignalIpdu06::BrkLiOnReq_UB,0,0,0); break;
     Case(this::SignalUBON) :
        resultValue = DisturbUB(Backbone::VDDM::VDDMBackBoneSignalIpdu06::BrkLiOnReq_UB,0,-1,1); break;
     Default :
        resultValue = -1;
  }
  
}

on sysvar_update sysvar::VDDM::Backbone::Signals::Control::UB::ImobEngChk1_UB_Control
{
  long resultValue;
  
  // --- FR ---
  setBusContext(getBusNameContext(gFR1BusName));
  switch(@this)
  {
     Case(this::SignalUBOFF) :
        resultValue = DisturbUB(Backbone::VDDM::VDDMBackBoneSignalIpdu06::ImobEngChk1_UB,0,-1,0); break;
     Case(this::SignalUBHandled) :
        resultValue = DisturbUB(Backbone::VDDM::VDDMBackBoneSignalIpdu06::ImobEngChk1_UB,0,0,0); break;
     Case(this::SignalUBON) :
        resultValue = DisturbUB(Backbone::VDDM::VDDMBackBoneSignalIpdu06::ImobEngChk1_UB,0,-1,1); break;
     Default :
        resultValue = -1;
  }
  
}

on sysvar_update sysvar::VDDM::Backbone::Signals::Control::UB::ImobEngChk2_UB_Control
{
  long resultValue;
  
  // --- FR ---
  setBusContext(getBusNameContext(gFR1BusName));
  switch(@this)
  {
     Case(this::SignalUBOFF) :
        resultValue = DisturbUB(Backbone::VDDM::VDDMBackBoneSignalIpdu06::ImobEngChk2_UB,0,-1,0); break;
     Case(this::SignalUBHandled) :
        resultValue = DisturbUB(Backbone::VDDM::VDDMBackBoneSignalIpdu06::ImobEngChk2_UB,0,0,0); break;
     Case(this::SignalUBON) :
        resultValue = DisturbUB(Backbone::VDDM::VDDMBackBoneSignalIpdu06::ImobEngChk2_UB,0,-1,1); break;
     Default :
        resultValue = -1;
  }
  
}

on sysvar_update sysvar::VDDM::Backbone::Signals::Control::UB::OvrdDecelByDrvr_UB_Control
{
  long resultValue;
  
  // --- FR ---
  setBusContext(getBusNameContext(gFR1BusName));
  switch(@this)
  {
     Case(this::SignalUBOFF) :
        resultValue = DisturbUB(Backbone::VDDM::VDDMBackBoneSignalIpdu06::OvrdDecelByDrvr_UB,0,-1,0); break;
     Case(this::SignalUBHandled) :
        resultValue = DisturbUB(Backbone::VDDM::VDDMBackBoneSignalIpdu06::OvrdDecelByDrvr_UB,0,0,0); break;
     Case(this::SignalUBON) :
        resultValue = DisturbUB(Backbone::VDDM::VDDMBackBoneSignalIpdu06::OvrdDecelByDrvr_UB,0,-1,1); break;
     Default :
        resultValue = -1;
  }
  
}

on sysvar_update sysvar::VDDM::Backbone::Signals::Control::UB::VehDynCtrlStsForALgtCmft_UB_Control
{
  long resultValue;
  
  // --- FR ---
  setBusContext(getBusNameContext(gFR1BusName));
  switch(@this)
  {
     Case(this::SignalUBOFF) :
        resultValue = DisturbUB(Backbone::VDDM::VDDMBackBoneSignalIpdu06::VehDynCtrlStsForALgtCmft_UB,0,-1,0); break;
     Case(this::SignalUBHandled) :
        resultValue = DisturbUB(Backbone::VDDM::VDDMBackBoneSignalIpdu06::VehDynCtrlStsForALgtCmft_UB,0,0,0); break;
     Case(this::SignalUBON) :
        resultValue = DisturbUB(Backbone::VDDM::VDDMBackBoneSignalIpdu06::VehDynCtrlStsForALgtCmft_UB,0,-1,1); break;
     Default :
        resultValue = -1;
  }
  
}

on sysvar_update sysvar::VDDM::Backbone::Signals::Control::UB::VehMGroup_UB_Control
{
  long resultValue;
  
  // --- FR ---
  setBusContext(getBusNameContext(gFR1BusName));
  switch(@this)
  {
     Case(this::SignalUBOFF) :
        resultValue = DisturbUB(Backbone::VDDM::VDDMBackBoneSignalIpdu06::VehMGroup_UB,0,-1,0); break;
     Case(this::SignalUBHandled) :
        resultValue = DisturbUB(Backbone::VDDM::VDDMBackBoneSignalIpdu06::VehMGroup_UB,0,0,0); break;
     Case(this::SignalUBON) :
        resultValue = DisturbUB(Backbone::VDDM::VDDMBackBoneSignalIpdu06::VehMGroup_UB,0,-1,1); break;
     Default :
        resultValue = -1;
  }
  
}

on sysvar_update sysvar::VDDM::Backbone::Signals::Control::UB::EngCooltIndcnReq_UB_Control
{
  long resultValue;
  
  // --- FR ---
  setBusContext(getBusNameContext(gFR1BusName));
  switch(@this)
  {
     Case(this::SignalUBOFF) :
        resultValue = DisturbUB(Backbone::VDDM::VDDMBackBoneSignalIpdu06::EngCooltIndcnReq_UB,0,-1,0); break;
     Case(this::SignalUBHandled) :
        resultValue = DisturbUB(Backbone::VDDM::VDDMBackBoneSignalIpdu06::EngCooltIndcnReq_UB,0,0,0); break;
     Case(this::SignalUBON) :
        resultValue = DisturbUB(Backbone::VDDM::VDDMBackBoneSignalIpdu06::EngCooltIndcnReq_UB,0,-1,1); break;
     Default :
        resultValue = -1;
  }
  
}

on sysvar_update sysvar::VDDM::Backbone::Signals::Control::UB::EngCooltLvl_UB_Control
{
  long resultValue;
  
  // --- FR ---
  setBusContext(getBusNameContext(gFR1BusName));
  switch(@this)
  {
     Case(this::SignalUBOFF) :
        resultValue = DisturbUB(Backbone::VDDM::VDDMBackBoneSignalIpdu06::EngCooltLvl_UB,0,-1,0); break;
     Case(this::SignalUBHandled) :
        resultValue = DisturbUB(Backbone::VDDM::VDDMBackBoneSignalIpdu06::EngCooltLvl_UB,0,0,0); break;
     Case(this::SignalUBON) :
        resultValue = DisturbUB(Backbone::VDDM::VDDMBackBoneSignalIpdu06::EngCooltLvl_UB,0,-1,1); break;
     Default :
        resultValue = -1;
  }
  
}

on sysvar_update sysvar::VDDM::Backbone::Signals::Control::UB::EngFuCns_UB_Control
{
  long resultValue;
  
  // --- FR ---
  setBusContext(getBusNameContext(gFR1BusName));
  switch(@this)
  {
     Case(this::SignalUBOFF) :
        resultValue = DisturbUB(Backbone::VDDM::VDDMBackBoneSignalIpdu06::EngFuCns_UB,0,-1,0); break;
     Case(this::SignalUBHandled) :
        resultValue = DisturbUB(Backbone::VDDM::VDDMBackBoneSignalIpdu06::EngFuCns_UB,0,0,0); break;
     Case(this::SignalUBON) :
        resultValue = DisturbUB(Backbone::VDDM::VDDMBackBoneSignalIpdu06::EngFuCns_UB,0,-1,1); break;
     Default :
        resultValue = -1;
  }
  
}

on sysvar_update sysvar::VDDM::Backbone::Signals::Control::UB::EngLoadReqElec_UB_Control
{
  long resultValue;
  
  // --- FR ---
  setBusContext(getBusNameContext(gFR1BusName));
  switch(@this)
  {
     Case(this::SignalUBOFF) :
        resultValue = DisturbUB(Backbone::VDDM::VDDMBackBoneSignalIpdu06::EngLoadReqElec_UB,0,-1,0); break;
     Case(this::SignalUBHandled) :
        resultValue = DisturbUB(Backbone::VDDM::VDDMBackBoneSignalIpdu06::EngLoadReqElec_UB,0,0,0); break;
     Case(this::SignalUBON) :
        resultValue = DisturbUB(Backbone::VDDM::VDDMBackBoneSignalIpdu06::EngLoadReqElec_UB,0,-1,1); break;
     Default :
        resultValue = -1;
  }
  
}

on sysvar_update sysvar::VDDM::Backbone::Signals::Control::UB::EngSpdMaxDispd_UB_Control
{
  long resultValue;
  
  // --- FR ---
  setBusContext(getBusNameContext(gFR1BusName));
  switch(@this)
  {
     Case(this::SignalUBOFF) :
        resultValue = DisturbUB(Backbone::VDDM::VDDMBackBoneSignalIpdu06::EngSpdMaxDispd_UB,0,-1,0); break;
     Case(this::SignalUBHandled) :
        resultValue = DisturbUB(Backbone::VDDM::VDDMBackBoneSignalIpdu06::EngSpdMaxDispd_UB,0,0,0); break;
     Case(this::SignalUBON) :
        resultValue = DisturbUB(Backbone::VDDM::VDDMBackBoneSignalIpdu06::EngSpdMaxDispd_UB,0,-1,1); break;
     Default :
        resultValue = -1;
  }
  
}

on sysvar_update sysvar::VDDM::Backbone::Signals::Control::UB::HmiFuLidOpenSts_UB_Control
{
  long resultValue;
  
  // --- FR ---
  setBusContext(getBusNameContext(gFR1BusName));
  switch(@this)
  {
     Case(this::SignalUBOFF) :
        resultValue = DisturbUB(Backbone::VDDM::VDDMBackBoneSignalIpdu06::HmiFuLidOpenSts_UB,0,-1,0); break;
     Case(this::SignalUBHandled) :
        resultValue = DisturbUB(Backbone::VDDM::VDDMBackBoneSignalIpdu06::HmiFuLidOpenSts_UB,0,0,0); break;
     Case(this::SignalUBON) :
        resultValue = DisturbUB(Backbone::VDDM::VDDMBackBoneSignalIpdu06::HmiFuLidOpenSts_UB,0,-1,1); break;
     Default :
        resultValue = -1;
  }
  
}

on sysvar_update sysvar::VDDM::Backbone::Signals::Control::UB::ImobEngSts1_UB_Control
{
  long resultValue;
  
  // --- FR ---
  setBusContext(getBusNameContext(gFR1BusName));
  switch(@this)
  {
     Case(this::SignalUBOFF) :
        resultValue = DisturbUB(Backbone::VDDM::VDDMBackBoneSignalIpdu06::ImobEngSts1_UB,0,-1,0); break;
     Case(this::SignalUBHandled) :
        resultValue = DisturbUB(Backbone::VDDM::VDDMBackBoneSignalIpdu06::ImobEngSts1_UB,0,0,0); break;
     Case(this::SignalUBON) :
        resultValue = DisturbUB(Backbone::VDDM::VDDMBackBoneSignalIpdu06::ImobEngSts1_UB,0,-1,1); break;
     Default :
        resultValue = -1;
  }
  
}

on sysvar_update sysvar::VDDM::Backbone::Signals::Control::UB::SteerServoSts_UB_Control
{
  long resultValue;
  
  // --- FR ---
  setBusContext(getBusNameContext(gFR1BusName));
  switch(@this)
  {
     Case(this::SignalUBOFF) :
        resultValue = DisturbUB(Backbone::VDDM::VDDMBackBoneSignalIpdu06::SteerServoSts_UB,0,-1,0); break;
     Case(this::SignalUBHandled) :
        resultValue = DisturbUB(Backbone::VDDM::VDDMBackBoneSignalIpdu06::SteerServoSts_UB,0,0,0); break;
     Case(this::SignalUBON) :
        resultValue = DisturbUB(Backbone::VDDM::VDDMBackBoneSignalIpdu06::SteerServoSts_UB,0,-1,1); break;
     Default :
        resultValue = -1;
  }
  
}

on sysvar_update sysvar::VDDM::Backbone::SignalGroups::Control::E2E::EpbLampReqChks_Control
{
  int controlValue;
  long resultValue;
  
  // --- FR ---
  controlValue = (int) @this;
  setBusContext(getBusNameContext(gFR1BusName));
  switch(controlValue)
  {
     Case(this::ChksHandled) :
        resultValue = EnableCRC("EpbLampReqGroup", 1); break;
     Case(this::ChksManual) :
        resultValue = EnableCRC("EpbLampReqGroup", 0); break;
     Default :
        resultValue = -1;
  }
  
}

on sysvar_update sysvar::VDDM::Backbone::SignalGroups::Control::E2E::EpbLampReqCntr_Control
{
  int controlValue;
  long resultValue;
  
  // --- FR ---
  controlValue = (int) @this;
  setBusContext(getBusNameContext(gFR1BusName));
  switch(controlValue)
  {
     Case(this::CntrHandled) :
        resultValue = EnableCounter ("EpbLampReqGroup", 1); break;
     Case(this::CntrManual) :
        resultValue = EnableCounter ("EpbLampReqGroup", 0); break;
     Default :
        resultValue = -1;
  }
  
}

on sysvar_update sysvar::VDDM::Backbone::SignalGroups::Control::E2E::EscWarnIndcnReqChks_Control
{
  int controlValue;
  long resultValue;
  
  // --- FR ---
  controlValue = (int) @this;
  setBusContext(getBusNameContext(gFR1BusName));
  switch(controlValue)
  {
     Case(this::ChksHandled) :
        resultValue = EnableCRC("EscWarnIndcnReqGroup", 1); break;
     Case(this::ChksManual) :
        resultValue = EnableCRC("EscWarnIndcnReqGroup", 0); break;
     Default :
        resultValue = -1;
  }
  
}

on sysvar_update sysvar::VDDM::Backbone::SignalGroups::Control::E2E::EscWarnIndcnReqCntr_Control
{
  int controlValue;
  long resultValue;
  
  // --- FR ---
  controlValue = (int) @this;
  setBusContext(getBusNameContext(gFR1BusName));
  switch(controlValue)
  {
     Case(this::CntrHandled) :
        resultValue = EnableCounter ("EscWarnIndcnReqGroup", 1); break;
     Case(this::CntrManual) :
        resultValue = EnableCounter ("EscWarnIndcnReqGroup", 0); break;
     Default :
        resultValue = -1;
  }
  
}

on sysvar_update sysvar::VDDM::Backbone::Signals::Control::UB::EpbLampReqGroup_UB_Control
{
  long resultValue;
  
  // --- FR ---
  setBusContext(getBusNameContext(gFR1BusName));
  switch(@this)
  {
     Case(this::SignalUBOFF) :
        resultValue = DisturbUB(Backbone::VDDM::VDDMBackBoneSignalIpdu07::EpbLampReqGroup_UB,0,-1,0); break;
     Case(this::SignalUBHandled) :
        resultValue = DisturbUB(Backbone::VDDM::VDDMBackBoneSignalIpdu07::EpbLampReqGroup_UB,0,0,0); break;
     Case(this::SignalUBON) :
        resultValue = DisturbUB(Backbone::VDDM::VDDMBackBoneSignalIpdu07::EpbLampReqGroup_UB,0,-1,1); break;
     Default :
        resultValue = -1;
  }
  
}

on sysvar_update sysvar::VDDM::Backbone::Signals::Control::UB::EscWarnIndcnReqGroup_UB_Control
{
  long resultValue;
  
  // --- FR ---
  setBusContext(getBusNameContext(gFR1BusName));
  switch(@this)
  {
     Case(this::SignalUBOFF) :
        resultValue = DisturbUB(Backbone::VDDM::VDDMBackBoneSignalIpdu07::EscWarnIndcnReqGroup_UB,0,-1,0); break;
     Case(this::SignalUBHandled) :
        resultValue = DisturbUB(Backbone::VDDM::VDDMBackBoneSignalIpdu07::EscWarnIndcnReqGroup_UB,0,0,0); break;
     Case(this::SignalUBON) :
        resultValue = DisturbUB(Backbone::VDDM::VDDMBackBoneSignalIpdu07::EscWarnIndcnReqGroup_UB,0,-1,1); break;
     Default :
        resultValue = -1;
  }
  
}

on sysvar_update sysvar::VDDM::Backbone::Signals::Control::UB::FricEstimnFromVehDynGroup_UB_Control
{
  long resultValue;
  
  // --- FR ---
  setBusContext(getBusNameContext(gFR1BusName));
  switch(@this)
  {
     Case(this::SignalUBOFF) :
        resultValue = DisturbUB(Backbone::VDDM::VDDMBackBoneSignalIpdu07::FricEstimnFromVehDynGroup_UB,0,-1,0); break;
     Case(this::SignalUBHandled) :
        resultValue = DisturbUB(Backbone::VDDM::VDDMBackBoneSignalIpdu07::FricEstimnFromVehDynGroup_UB,0,0,0); break;
     Case(this::SignalUBON) :
        resultValue = DisturbUB(Backbone::VDDM::VDDMBackBoneSignalIpdu07::FricEstimnFromVehDynGroup_UB,0,-1,1); break;
     Default :
        resultValue = -1;
  }
  
}

on sysvar_update sysvar::VDDM::Backbone::Signals::Control::UB::SteerLockSts_UB_Control
{
  long resultValue;
  
  // --- FR ---
  setBusContext(getBusNameContext(gFR1BusName));
  switch(@this)
  {
     Case(this::SignalUBOFF) :
        resultValue = DisturbUB(Backbone::VDDM::VDDMBackBoneSignalIpdu07::SteerLockSts_UB,0,-1,0); break;
     Case(this::SignalUBHandled) :
        resultValue = DisturbUB(Backbone::VDDM::VDDMBackBoneSignalIpdu07::SteerLockSts_UB,0,0,0); break;
     Case(this::SignalUBON) :
        resultValue = DisturbUB(Backbone::VDDM::VDDMBackBoneSignalIpdu07::SteerLockSts_UB,0,-1,1); break;
     Default :
        resultValue = -1;
  }
  
}

on sysvar_update sysvar::VDDM::Backbone::Signals::Control::UB::AltI_UB_Control
{
  long resultValue;
  
  // --- FR ---
  setBusContext(getBusNameContext(gFR1BusName));
  switch(@this)
  {
     Case(this::SignalUBOFF) :
        resultValue = DisturbUB(Backbone::VDDM::VDDMBackBoneSignalIpdu07::AltI_UB,0,-1,0); break;
     Case(this::SignalUBHandled) :
        resultValue = DisturbUB(Backbone::VDDM::VDDMBackBoneSignalIpdu07::AltI_UB,0,0,0); break;
     Case(this::SignalUBON) :
        resultValue = DisturbUB(Backbone::VDDM::VDDMBackBoneSignalIpdu07::AltI_UB,0,-1,1); break;
     Default :
        resultValue = -1;
  }
  
}

on sysvar_update sysvar::VDDM::Backbone::Signals::Control::UB::AltIAvl_UB_Control
{
  long resultValue;
  
  // --- FR ---
  setBusContext(getBusNameContext(gFR1BusName));
  switch(@this)
  {
     Case(this::SignalUBOFF) :
        resultValue = DisturbUB(Backbone::VDDM::VDDMBackBoneSignalIpdu07::AltIAvl_UB,0,-1,0); break;
     Case(this::SignalUBHandled) :
        resultValue = DisturbUB(Backbone::VDDM::VDDMBackBoneSignalIpdu07::AltIAvl_UB,0,0,0); break;
     Case(this::SignalUBON) :
        resultValue = DisturbUB(Backbone::VDDM::VDDMBackBoneSignalIpdu07::AltIAvl_UB,0,-1,1); break;
     Default :
        resultValue = -1;
  }
  
}

on sysvar_update sysvar::VDDM::Backbone::Signals::Control::UB::AltIAvlAtIdle_UB_Control
{
  long resultValue;
  
  // --- FR ---
  setBusContext(getBusNameContext(gFR1BusName));
  switch(@this)
  {
     Case(this::SignalUBOFF) :
        resultValue = DisturbUB(Backbone::VDDM::VDDMBackBoneSignalIpdu07::AltIAvlAtIdle_UB,0,-1,0); break;
     Case(this::SignalUBHandled) :
        resultValue = DisturbUB(Backbone::VDDM::VDDMBackBoneSignalIpdu07::AltIAvlAtIdle_UB,0,0,0); break;
     Case(this::SignalUBON) :
        resultValue = DisturbUB(Backbone::VDDM::VDDMBackBoneSignalIpdu07::AltIAvlAtIdle_UB,0,-1,1); break;
     Default :
        resultValue = -1;
  }
  
}

on sysvar_update sysvar::VDDM::Backbone::Signals::Control::UB::BrkByWireWarnIndcn_UB_Control
{
  long resultValue;
  
  // --- FR ---
  setBusContext(getBusNameContext(gFR1BusName));
  switch(@this)
  {
     Case(this::SignalUBOFF) :
        resultValue = DisturbUB(Backbone::VDDM::VDDMBackBoneSignalIpdu07::BrkByWireWarnIndcn_UB,0,-1,0); break;
     Case(this::SignalUBHandled) :
        resultValue = DisturbUB(Backbone::VDDM::VDDMBackBoneSignalIpdu07::BrkByWireWarnIndcn_UB,0,0,0); break;
     Case(this::SignalUBON) :
        resultValue = DisturbUB(Backbone::VDDM::VDDMBackBoneSignalIpdu07::BrkByWireWarnIndcn_UB,0,-1,1); break;
     Default :
        resultValue = -1;
  }
  
}

on sysvar_update sysvar::VDDM::Backbone::Signals::Control::UB::BrkFldLvl_UB_Control
{
  long resultValue;
  
  // --- FR ---
  setBusContext(getBusNameContext(gFR1BusName));
  switch(@this)
  {
     Case(this::SignalUBOFF) :
        resultValue = DisturbUB(Backbone::VDDM::VDDMBackBoneSignalIpdu07::BrkFldLvl_UB,0,-1,0); break;
     Case(this::SignalUBHandled) :
        resultValue = DisturbUB(Backbone::VDDM::VDDMBackBoneSignalIpdu07::BrkFldLvl_UB,0,0,0); break;
     Case(this::SignalUBON) :
        resultValue = DisturbUB(Backbone::VDDM::VDDMBackBoneSignalIpdu07::BrkFldLvl_UB,0,-1,1); break;
     Default :
        resultValue = -1;
  }
  
}

on sysvar_update sysvar::VDDM::Backbone::Signals::Control::UB::BrkMsgForHybWarnReq_UB_Control
{
  long resultValue;
  
  // --- FR ---
  setBusContext(getBusNameContext(gFR1BusName));
  switch(@this)
  {
     Case(this::SignalUBOFF) :
        resultValue = DisturbUB(Backbone::VDDM::VDDMBackBoneSignalIpdu07::BrkMsgForHybWarnReq_UB,0,-1,0); break;
     Case(this::SignalUBHandled) :
        resultValue = DisturbUB(Backbone::VDDM::VDDMBackBoneSignalIpdu07::BrkMsgForHybWarnReq_UB,0,0,0); break;
     Case(this::SignalUBON) :
        resultValue = DisturbUB(Backbone::VDDM::VDDMBackBoneSignalIpdu07::BrkMsgForHybWarnReq_UB,0,-1,1); break;
     Default :
        resultValue = -1;
  }
  
}

on sysvar_update sysvar::VDDM::Backbone::Signals::Control::UB::BrkMsgForLoVacReqd_UB_Control
{
  long resultValue;
  
  // --- FR ---
  setBusContext(getBusNameContext(gFR1BusName));
  switch(@this)
  {
     Case(this::SignalUBOFF) :
        resultValue = DisturbUB(Backbone::VDDM::VDDMBackBoneSignalIpdu07::BrkMsgForLoVacReqd_UB,0,-1,0); break;
     Case(this::SignalUBHandled) :
        resultValue = DisturbUB(Backbone::VDDM::VDDMBackBoneSignalIpdu07::BrkMsgForLoVacReqd_UB,0,0,0); break;
     Case(this::SignalUBON) :
        resultValue = DisturbUB(Backbone::VDDM::VDDMBackBoneSignalIpdu07::BrkMsgForLoVacReqd_UB,0,-1,1); break;
     Default :
        resultValue = -1;
  }
  
}

on sysvar_update sysvar::VDDM::Backbone::Signals::Control::UB::BrkMsgWarnReq_UB_Control
{
  long resultValue;
  
  // --- FR ---
  setBusContext(getBusNameContext(gFR1BusName));
  switch(@this)
  {
     Case(this::SignalUBOFF) :
        resultValue = DisturbUB(Backbone::VDDM::VDDMBackBoneSignalIpdu07::BrkMsgWarnReq_UB,0,-1,0); break;
     Case(this::SignalUBHandled) :
        resultValue = DisturbUB(Backbone::VDDM::VDDMBackBoneSignalIpdu07::BrkMsgWarnReq_UB,0,0,0); break;
     Case(this::SignalUBON) :
        resultValue = DisturbUB(Backbone::VDDM::VDDMBackBoneSignalIpdu07::BrkMsgWarnReq_UB,0,-1,1); break;
     Default :
        resultValue = -1;
  }
  
}

on sysvar_update sysvar::VDDM::Backbone::Signals::Control::UB::ChrgrSt_UB_Control
{
  long resultValue;
  
  // --- FR ---
  setBusContext(getBusNameContext(gFR1BusName));
  switch(@this)
  {
     Case(this::SignalUBOFF) :
        resultValue = DisturbUB(Backbone::VDDM::VDDMBackBoneSignalIpdu07::ChrgrSt_UB,0,-1,0); break;
     Case(this::SignalUBHandled) :
        resultValue = DisturbUB(Backbone::VDDM::VDDMBackBoneSignalIpdu07::ChrgrSt_UB,0,0,0); break;
     Case(this::SignalUBON) :
        resultValue = DisturbUB(Backbone::VDDM::VDDMBackBoneSignalIpdu07::ChrgrSt_UB,0,-1,1); break;
     Default :
        resultValue = -1;
  }
  
}

on sysvar_update sysvar::VDDM::Backbone::Signals::Control::UB::DcDcActvd_UB_Control
{
  long resultValue;
  
  // --- FR ---
  setBusContext(getBusNameContext(gFR1BusName));
  switch(@this)
  {
     Case(this::SignalUBOFF) :
        resultValue = DisturbUB(Backbone::VDDM::VDDMBackBoneSignalIpdu07::DcDcActvd_UB,0,-1,0); break;
     Case(this::SignalUBHandled) :
        resultValue = DisturbUB(Backbone::VDDM::VDDMBackBoneSignalIpdu07::DcDcActvd_UB,0,0,0); break;
     Case(this::SignalUBON) :
        resultValue = DisturbUB(Backbone::VDDM::VDDMBackBoneSignalIpdu07::DcDcActvd_UB,0,-1,1); break;
     Default :
        resultValue = -1;
  }
  
}

on sysvar_update sysvar::VDDM::Backbone::Signals::Control::UB::DftlFltIndcn_UB_Control
{
  long resultValue;
  
  // --- FR ---
  setBusContext(getBusNameContext(gFR1BusName));
  switch(@this)
  {
     Case(this::SignalUBOFF) :
        resultValue = DisturbUB(Backbone::VDDM::VDDMBackBoneSignalIpdu07::DftlFltIndcn_UB,0,-1,0); break;
     Case(this::SignalUBHandled) :
        resultValue = DisturbUB(Backbone::VDDM::VDDMBackBoneSignalIpdu07::DftlFltIndcn_UB,0,0,0); break;
     Case(this::SignalUBON) :
        resultValue = DisturbUB(Backbone::VDDM::VDDMBackBoneSignalIpdu07::DftlFltIndcn_UB,0,-1,1); break;
     Default :
        resultValue = -1;
  }
  
}

on sysvar_update sysvar::VDDM::Backbone::Signals::Control::UB::DispHvBattLvlOfChrg_UB_Control
{
  long resultValue;
  
  // --- FR ---
  setBusContext(getBusNameContext(gFR1BusName));
  switch(@this)
  {
     Case(this::SignalUBOFF) :
        resultValue = DisturbUB(Backbone::VDDM::VDDMBackBoneSignalIpdu07::DispHvBattLvlOfChrg_UB,0,-1,0); break;
     Case(this::SignalUBHandled) :
        resultValue = DisturbUB(Backbone::VDDM::VDDMBackBoneSignalIpdu07::DispHvBattLvlOfChrg_UB,0,0,0); break;
     Case(this::SignalUBON) :
        resultValue = DisturbUB(Backbone::VDDM::VDDMBackBoneSignalIpdu07::DispHvBattLvlOfChrg_UB,0,-1,1); break;
     Default :
        resultValue = -1;
  }
  
}

on sysvar_update sysvar::VDDM::Backbone::Signals::Control::UB::DispMsgByVehHld_UB_Control
{
  long resultValue;
  
  // --- FR ---
  setBusContext(getBusNameContext(gFR1BusName));
  switch(@this)
  {
     Case(this::SignalUBOFF) :
        resultValue = DisturbUB(Backbone::VDDM::VDDMBackBoneSignalIpdu07::DispMsgByVehHld_UB,0,-1,0); break;
     Case(this::SignalUBHandled) :
        resultValue = DisturbUB(Backbone::VDDM::VDDMBackBoneSignalIpdu07::DispMsgByVehHld_UB,0,0,0); break;
     Case(this::SignalUBON) :
        resultValue = DisturbUB(Backbone::VDDM::VDDMBackBoneSignalIpdu07::DispMsgByVehHld_UB,0,-1,1); break;
     Default :
        resultValue = -1;
  }
  
}

on sysvar_update sysvar::VDDM::Backbone::Signals::Control::UB::DstTrvldVldFromBrkBkp_UB_Control
{
  long resultValue;
  
  // --- FR ---
  setBusContext(getBusNameContext(gFR1BusName));
  switch(@this)
  {
     Case(this::SignalUBOFF) :
        resultValue = DisturbUB(Backbone::VDDM::VDDMBackBoneSignalIpdu07::DstTrvldVldFromBrkBkp_UB,0,-1,0); break;
     Case(this::SignalUBHandled) :
        resultValue = DisturbUB(Backbone::VDDM::VDDMBackBoneSignalIpdu07::DstTrvldVldFromBrkBkp_UB,0,0,0); break;
     Case(this::SignalUBON) :
        resultValue = DisturbUB(Backbone::VDDM::VDDMBackBoneSignalIpdu07::DstTrvldVldFromBrkBkp_UB,0,-1,1); break;
     Default :
        resultValue = -1;
  }
  
}

on sysvar_update sysvar::VDDM::Backbone::Signals::Control::UB::EngEffSts_UB_Control
{
  long resultValue;
  
  // --- FR ---
  setBusContext(getBusNameContext(gFR1BusName));
  switch(@this)
  {
     Case(this::SignalUBOFF) :
        resultValue = DisturbUB(Backbone::VDDM::VDDMBackBoneSignalIpdu07::EngEffSts_UB,0,-1,0); break;
     Case(this::SignalUBHandled) :
        resultValue = DisturbUB(Backbone::VDDM::VDDMBackBoneSignalIpdu07::EngEffSts_UB,0,0,0); break;
     Case(this::SignalUBON) :
        resultValue = DisturbUB(Backbone::VDDM::VDDMBackBoneSignalIpdu07::EngEffSts_UB,0,-1,1); break;
     Default :
        resultValue = -1;
  }
  
}

on sysvar_update sysvar::VDDM::Backbone::Signals::Control::UB::EngEgyEffElec_UB_Control
{
  long resultValue;
  
  // --- FR ---
  setBusContext(getBusNameContext(gFR1BusName));
  switch(@this)
  {
     Case(this::SignalUBOFF) :
        resultValue = DisturbUB(Backbone::VDDM::VDDMBackBoneSignalIpdu07::EngEgyEffElec_UB,0,-1,0); break;
     Case(this::SignalUBHandled) :
        resultValue = DisturbUB(Backbone::VDDM::VDDMBackBoneSignalIpdu07::EngEgyEffElec_UB,0,0,0); break;
     Case(this::SignalUBON) :
        resultValue = DisturbUB(Backbone::VDDM::VDDMBackBoneSignalIpdu07::EngEgyEffElec_UB,0,-1,1); break;
     Default :
        resultValue = -1;
  }
  
}

on sysvar_update sysvar::VDDM::Backbone::Signals::Control::UB::EngOilPWarn_UB_Control
{
  long resultValue;
  
  // --- FR ---
  setBusContext(getBusNameContext(gFR1BusName));
  switch(@this)
  {
     Case(this::SignalUBOFF) :
        resultValue = DisturbUB(Backbone::VDDM::VDDMBackBoneSignalIpdu07::EngOilPWarn_UB,0,-1,0); break;
     Case(this::SignalUBHandled) :
        resultValue = DisturbUB(Backbone::VDDM::VDDMBackBoneSignalIpdu07::EngOilPWarn_UB,0,0,0); break;
     Case(this::SignalUBON) :
        resultValue = DisturbUB(Backbone::VDDM::VDDMBackBoneSignalIpdu07::EngOilPWarn_UB,0,-1,1); break;
     Default :
        resultValue = -1;
  }
  
}

on sysvar_update sysvar::VDDM::Backbone::Signals::Control::UB::EngPAmbAir1_UB_Control
{
  long resultValue;
  
  // --- FR ---
  setBusContext(getBusNameContext(gFR1BusName));
  switch(@this)
  {
     Case(this::SignalUBOFF) :
        resultValue = DisturbUB(Backbone::VDDM::VDDMBackBoneSignalIpdu07::EngPAmbAir1_UB,0,-1,0); break;
     Case(this::SignalUBHandled) :
        resultValue = DisturbUB(Backbone::VDDM::VDDMBackBoneSignalIpdu07::EngPAmbAir1_UB,0,0,0); break;
     Case(this::SignalUBON) :
        resultValue = DisturbUB(Backbone::VDDM::VDDMBackBoneSignalIpdu07::EngPAmbAir1_UB,0,-1,1); break;
     Default :
        resultValue = -1;
  }
  
}

on sysvar_update sysvar::VDDM::Backbone::Signals::Control::UB::EngPwrCns_UB_Control
{
  long resultValue;
  
  // --- FR ---
  setBusContext(getBusNameContext(gFR1BusName));
  switch(@this)
  {
     Case(this::SignalUBOFF) :
        resultValue = DisturbUB(Backbone::VDDM::VDDMBackBoneSignalIpdu07::EngPwrCns_UB,0,-1,0); break;
     Case(this::SignalUBHandled) :
        resultValue = DisturbUB(Backbone::VDDM::VDDMBackBoneSignalIpdu07::EngPwrCns_UB,0,0,0); break;
     Case(this::SignalUBON) :
        resultValue = DisturbUB(Backbone::VDDM::VDDMBackBoneSignalIpdu07::EngPwrCns_UB,0,-1,1); break;
     Default :
        resultValue = -1;
  }
  
}

on sysvar_update sysvar::VDDM::Backbone::Signals::Control::UB::EngPwrCritDes_UB_Control
{
  long resultValue;
  
  // --- FR ---
  setBusContext(getBusNameContext(gFR1BusName));
  switch(@this)
  {
     Case(this::SignalUBOFF) :
        resultValue = DisturbUB(Backbone::VDDM::VDDMBackBoneSignalIpdu07::EngPwrCritDes_UB,0,-1,0); break;
     Case(this::SignalUBHandled) :
        resultValue = DisturbUB(Backbone::VDDM::VDDMBackBoneSignalIpdu07::EngPwrCritDes_UB,0,0,0); break;
     Case(this::SignalUBON) :
        resultValue = DisturbUB(Backbone::VDDM::VDDMBackBoneSignalIpdu07::EngPwrCritDes_UB,0,-1,1); break;
     Default :
        resultValue = -1;
  }
  
}

on sysvar_update sysvar::VDDM::Backbone::Signals::Control::UB::EngPwrNormDes_UB_Control
{
  long resultValue;
  
  // --- FR ---
  setBusContext(getBusNameContext(gFR1BusName));
  switch(@this)
  {
     Case(this::SignalUBOFF) :
        resultValue = DisturbUB(Backbone::VDDM::VDDMBackBoneSignalIpdu07::EngPwrNormDes_UB,0,-1,0); break;
     Case(this::SignalUBHandled) :
        resultValue = DisturbUB(Backbone::VDDM::VDDMBackBoneSignalIpdu07::EngPwrNormDes_UB,0,0,0); break;
     Case(this::SignalUBON) :
        resultValue = DisturbUB(Backbone::VDDM::VDDMBackBoneSignalIpdu07::EngPwrNormDes_UB,0,-1,1); break;
     Default :
        resultValue = -1;
  }
  
}

on sysvar_update sysvar::VDDM::Backbone::Signals::Control::UB::EngStallMsgToModMngt_UB_Control
{
  long resultValue;
  
  // --- FR ---
  setBusContext(getBusNameContext(gFR1BusName));
  switch(@this)
  {
     Case(this::SignalUBOFF) :
        resultValue = DisturbUB(Backbone::VDDM::VDDMBackBoneSignalIpdu07::EngStallMsgToModMngt_UB,0,-1,0); break;
     Case(this::SignalUBHandled) :
        resultValue = DisturbUB(Backbone::VDDM::VDDMBackBoneSignalIpdu07::EngStallMsgToModMngt_UB,0,0,0); break;
     Case(this::SignalUBON) :
        resultValue = DisturbUB(Backbone::VDDM::VDDMBackBoneSignalIpdu07::EngStallMsgToModMngt_UB,0,-1,1); break;
     Default :
        resultValue = -1;
  }
  
}

on sysvar_update sysvar::VDDM::Backbone::Signals::Control::UB::EpbDrvrDisp_UB_Control
{
  long resultValue;
  
  // --- FR ---
  setBusContext(getBusNameContext(gFR1BusName));
  switch(@this)
  {
     Case(this::SignalUBOFF) :
        resultValue = DisturbUB(Backbone::VDDM::VDDMBackBoneSignalIpdu07::EpbDrvrDisp_UB,0,-1,0); break;
     Case(this::SignalUBHandled) :
        resultValue = DisturbUB(Backbone::VDDM::VDDMBackBoneSignalIpdu07::EpbDrvrDisp_UB,0,0,0); break;
     Case(this::SignalUBON) :
        resultValue = DisturbUB(Backbone::VDDM::VDDMBackBoneSignalIpdu07::EpbDrvrDisp_UB,0,-1,1); break;
     Default :
        resultValue = -1;
  }
  
}

on sysvar_update sysvar::VDDM::Backbone::Signals::Control::UB::HvacCooltFlowAct_UB_Control
{
  long resultValue;
  
  // --- FR ---
  setBusContext(getBusNameContext(gFR1BusName));
  switch(@this)
  {
     Case(this::SignalUBOFF) :
        resultValue = DisturbUB(Backbone::VDDM::VDDMBackBoneSignalIpdu07::HvacCooltFlowAct_UB,0,-1,0); break;
     Case(this::SignalUBHandled) :
        resultValue = DisturbUB(Backbone::VDDM::VDDMBackBoneSignalIpdu07::HvacCooltFlowAct_UB,0,0,0); break;
     Case(this::SignalUBON) :
        resultValue = DisturbUB(Backbone::VDDM::VDDMBackBoneSignalIpdu07::HvacCooltFlowAct_UB,0,-1,1); break;
     Default :
        resultValue = -1;
  }
  
}

on sysvar_update sysvar::VDDM::Backbone::Signals::Control::UB::HvClimaCmd_UB_Control
{
  long resultValue;
  
  // --- FR ---
  setBusContext(getBusNameContext(gFR1BusName));
  switch(@this)
  {
     Case(this::SignalUBOFF) :
        resultValue = DisturbUB(Backbone::VDDM::VDDMBackBoneSignalIpdu07::HvClimaCmd_UB,0,-1,0); break;
     Case(this::SignalUBHandled) :
        resultValue = DisturbUB(Backbone::VDDM::VDDMBackBoneSignalIpdu07::HvClimaCmd_UB,0,0,0); break;
     Case(this::SignalUBON) :
        resultValue = DisturbUB(Backbone::VDDM::VDDMBackBoneSignalIpdu07::HvClimaCmd_UB,0,-1,1); break;
     Default :
        resultValue = -1;
  }
  
}

on sysvar_update sysvar::VDDM::Backbone::Signals::Control::UB::IndcnToDrvrPostImpctCtrl_UB_Control
{
  long resultValue;
  
  // --- FR ---
  setBusContext(getBusNameContext(gFR1BusName));
  switch(@this)
  {
     Case(this::SignalUBOFF) :
        resultValue = DisturbUB(Backbone::VDDM::VDDMBackBoneSignalIpdu07::IndcnToDrvrPostImpctCtrl_UB,0,-1,0); break;
     Case(this::SignalUBHandled) :
        resultValue = DisturbUB(Backbone::VDDM::VDDMBackBoneSignalIpdu07::IndcnToDrvrPostImpctCtrl_UB,0,0,0); break;
     Case(this::SignalUBON) :
        resultValue = DisturbUB(Backbone::VDDM::VDDMBackBoneSignalIpdu07::IndcnToDrvrPostImpctCtrl_UB,0,-1,1); break;
     Default :
        resultValue = -1;
  }
  
}

on sysvar_update sysvar::VDDM::Backbone::Signals::Control::UB::LampReqByVehHld_UB_Control
{
  long resultValue;
  
  // --- FR ---
  setBusContext(getBusNameContext(gFR1BusName));
  switch(@this)
  {
     Case(this::SignalUBOFF) :
        resultValue = DisturbUB(Backbone::VDDM::VDDMBackBoneSignalIpdu07::LampReqByVehHld_UB,0,-1,0); break;
     Case(this::SignalUBHandled) :
        resultValue = DisturbUB(Backbone::VDDM::VDDMBackBoneSignalIpdu07::LampReqByVehHld_UB,0,0,0); break;
     Case(this::SignalUBON) :
        resultValue = DisturbUB(Backbone::VDDM::VDDMBackBoneSignalIpdu07::LampReqByVehHld_UB,0,-1,1); break;
     Default :
        resultValue = -1;
  }
  
}

on sysvar_update sysvar::VDDM::Backbone::Signals::Control::UB::MsgReqByHillDwnCtrl_UB_Control
{
  long resultValue;
  
  // --- FR ---
  setBusContext(getBusNameContext(gFR1BusName));
  switch(@this)
  {
     Case(this::SignalUBOFF) :
        resultValue = DisturbUB(Backbone::VDDM::VDDMBackBoneSignalIpdu07::MsgReqByHillDwnCtrl_UB,0,-1,0); break;
     Case(this::SignalUBHandled) :
        resultValue = DisturbUB(Backbone::VDDM::VDDMBackBoneSignalIpdu07::MsgReqByHillDwnCtrl_UB,0,0,0); break;
     Case(this::SignalUBON) :
        resultValue = DisturbUB(Backbone::VDDM::VDDMBackBoneSignalIpdu07::MsgReqByHillDwnCtrl_UB,0,-1,1); break;
     Default :
        resultValue = -1;
  }
  
}

on sysvar_update sysvar::VDDM::Backbone::Signals::Control::UB::OnBdChrgrHndlSts_UB_Control
{
  long resultValue;
  
  // --- FR ---
  setBusContext(getBusNameContext(gFR1BusName));
  switch(@this)
  {
     Case(this::SignalUBOFF) :
        resultValue = DisturbUB(Backbone::VDDM::VDDMBackBoneSignalIpdu07::OnBdChrgrHndlSts_UB,0,-1,0); break;
     Case(this::SignalUBHandled) :
        resultValue = DisturbUB(Backbone::VDDM::VDDMBackBoneSignalIpdu07::OnBdChrgrHndlSts_UB,0,0,0); break;
     Case(this::SignalUBON) :
        resultValue = DisturbUB(Backbone::VDDM::VDDMBackBoneSignalIpdu07::OnBdChrgrHndlSts_UB,0,-1,1); break;
     Default :
        resultValue = -1;
  }
  
}

on sysvar_update sysvar::VDDM::Backbone::Signals::Control::UB::PrpsnErrIndcnReq_UB_Control
{
  long resultValue;
  
  // --- FR ---
  setBusContext(getBusNameContext(gFR1BusName));
  switch(@this)
  {
     Case(this::SignalUBOFF) :
        resultValue = DisturbUB(Backbone::VDDM::VDDMBackBoneSignalIpdu07::PrpsnErrIndcnReq_UB,0,-1,0); break;
     Case(this::SignalUBHandled) :
        resultValue = DisturbUB(Backbone::VDDM::VDDMBackBoneSignalIpdu07::PrpsnErrIndcnReq_UB,0,0,0); break;
     Case(this::SignalUBON) :
        resultValue = DisturbUB(Backbone::VDDM::VDDMBackBoneSignalIpdu07::PrpsnErrIndcnReq_UB,0,-1,1); break;
     Default :
        resultValue = -1;
  }
  
}

on sysvar_update sysvar::VDDM::Backbone::Signals::Control::UB::PrpsnModElecDrvBlkd_UB_Control
{
  long resultValue;
  
  // --- FR ---
  setBusContext(getBusNameContext(gFR1BusName));
  switch(@this)
  {
     Case(this::SignalUBOFF) :
        resultValue = DisturbUB(Backbone::VDDM::VDDMBackBoneSignalIpdu07::PrpsnModElecDrvBlkd_UB,0,-1,0); break;
     Case(this::SignalUBHandled) :
        resultValue = DisturbUB(Backbone::VDDM::VDDMBackBoneSignalIpdu07::PrpsnModElecDrvBlkd_UB,0,0,0); break;
     Case(this::SignalUBON) :
        resultValue = DisturbUB(Backbone::VDDM::VDDMBackBoneSignalIpdu07::PrpsnModElecDrvBlkd_UB,0,-1,1); break;
     Default :
        resultValue = -1;
  }
  
}

on sysvar_update sysvar::VDDM::Backbone::Signals::Control::UB::PrpsnModOfSaveBlkd_UB_Control
{
  long resultValue;
  
  // --- FR ---
  setBusContext(getBusNameContext(gFR1BusName));
  switch(@this)
  {
     Case(this::SignalUBOFF) :
        resultValue = DisturbUB(Backbone::VDDM::VDDMBackBoneSignalIpdu07::PrpsnModOfSaveBlkd_UB,0,-1,0); break;
     Case(this::SignalUBHandled) :
        resultValue = DisturbUB(Backbone::VDDM::VDDMBackBoneSignalIpdu07::PrpsnModOfSaveBlkd_UB,0,0,0); break;
     Case(this::SignalUBON) :
        resultValue = DisturbUB(Backbone::VDDM::VDDMBackBoneSignalIpdu07::PrpsnModOfSaveBlkd_UB,0,-1,1); break;
     Default :
        resultValue = -1;
  }
  
}

on sysvar_update sysvar::VDDM::Backbone::Signals::Control::UB::PrpsnModOfTracBlkd_UB_Control
{
  long resultValue;
  
  // --- FR ---
  setBusContext(getBusNameContext(gFR1BusName));
  switch(@this)
  {
     Case(this::SignalUBOFF) :
        resultValue = DisturbUB(Backbone::VDDM::VDDMBackBoneSignalIpdu07::PrpsnModOfTracBlkd_UB,0,-1,0); break;
     Case(this::SignalUBHandled) :
        resultValue = DisturbUB(Backbone::VDDM::VDDMBackBoneSignalIpdu07::PrpsnModOfTracBlkd_UB,0,0,0); break;
     Case(this::SignalUBON) :
        resultValue = DisturbUB(Backbone::VDDM::VDDMBackBoneSignalIpdu07::PrpsnModOfTracBlkd_UB,0,-1,1); break;
     Default :
        resultValue = -1;
  }
  
}

on sysvar_update sysvar::VDDM::Backbone::Signals::Control::UB::PrpsnModSptBlkd_UB_Control
{
  long resultValue;
  
  // --- FR ---
  setBusContext(getBusNameContext(gFR1BusName));
  switch(@this)
  {
     Case(this::SignalUBOFF) :
        resultValue = DisturbUB(Backbone::VDDM::VDDMBackBoneSignalIpdu07::PrpsnModSptBlkd_UB,0,-1,0); break;
     Case(this::SignalUBHandled) :
        resultValue = DisturbUB(Backbone::VDDM::VDDMBackBoneSignalIpdu07::PrpsnModSptBlkd_UB,0,0,0); break;
     Case(this::SignalUBON) :
        resultValue = DisturbUB(Backbone::VDDM::VDDMBackBoneSignalIpdu07::PrpsnModSptBlkd_UB,0,-1,1); break;
     Default :
        resultValue = -1;
  }
  
}

on sysvar_update sysvar::VDDM::Backbone::Signals::Control::UB::PtGearTar_UB_Control
{
  long resultValue;
  
  // --- FR ---
  setBusContext(getBusNameContext(gFR1BusName));
  switch(@this)
  {
     Case(this::SignalUBOFF) :
        resultValue = DisturbUB(Backbone::VDDM::VDDMBackBoneSignalIpdu07::PtGearTar_UB,0,-1,0); break;
     Case(this::SignalUBHandled) :
        resultValue = DisturbUB(Backbone::VDDM::VDDMBackBoneSignalIpdu07::PtGearTar_UB,0,0,0); break;
     Case(this::SignalUBON) :
        resultValue = DisturbUB(Backbone::VDDM::VDDMBackBoneSignalIpdu07::PtGearTar_UB,0,-1,1); break;
     Default :
        resultValue = -1;
  }
  
}

on sysvar_update sysvar::VDDM::Backbone::Signals::Control::UB::SteerLockWarnIndcn_UB_Control
{
  long resultValue;
  
  // --- FR ---
  setBusContext(getBusNameContext(gFR1BusName));
  switch(@this)
  {
     Case(this::SignalUBOFF) :
        resultValue = DisturbUB(Backbone::VDDM::VDDMBackBoneSignalIpdu07::SteerLockWarnIndcn_UB,0,-1,0); break;
     Case(this::SignalUBHandled) :
        resultValue = DisturbUB(Backbone::VDDM::VDDMBackBoneSignalIpdu07::SteerLockWarnIndcn_UB,0,0,0); break;
     Case(this::SignalUBON) :
        resultValue = DisturbUB(Backbone::VDDM::VDDMBackBoneSignalIpdu07::SteerLockWarnIndcn_UB,0,-1,1); break;
     Default :
        resultValue = -1;
  }
  
}

on sysvar_update sysvar::VDDM::Backbone::Signals::Control::UB::SuspCnseEgy_UB_Control
{
  long resultValue;
  
  // --- FR ---
  setBusContext(getBusNameContext(gFR1BusName));
  switch(@this)
  {
     Case(this::SignalUBOFF) :
        resultValue = DisturbUB(Backbone::VDDM::VDDMBackBoneSignalIpdu07::SuspCnseEgy_UB,0,-1,0); break;
     Case(this::SignalUBHandled) :
        resultValue = DisturbUB(Backbone::VDDM::VDDMBackBoneSignalIpdu07::SuspCnseEgy_UB,0,0,0); break;
     Case(this::SignalUBON) :
        resultValue = DisturbUB(Backbone::VDDM::VDDMBackBoneSignalIpdu07::SuspCnseEgy_UB,0,-1,1); break;
     Default :
        resultValue = -1;
  }
  
}

on sysvar_update sysvar::VDDM::Backbone::Signals::Control::UB::TrsmFltIndcn_UB_Control
{
  long resultValue;
  
  // --- FR ---
  setBusContext(getBusNameContext(gFR1BusName));
  switch(@this)
  {
     Case(this::SignalUBOFF) :
        resultValue = DisturbUB(Backbone::VDDM::VDDMBackBoneSignalIpdu07::TrsmFltIndcn_UB,0,-1,0); break;
     Case(this::SignalUBHandled) :
        resultValue = DisturbUB(Backbone::VDDM::VDDMBackBoneSignalIpdu07::TrsmFltIndcn_UB,0,0,0); break;
     Case(this::SignalUBON) :
        resultValue = DisturbUB(Backbone::VDDM::VDDMBackBoneSignalIpdu07::TrsmFltIndcn_UB,0,-1,1); break;
     Default :
        resultValue = -1;
  }
  
}

on sysvar_update sysvar::VDDM::Backbone::Signals::Control::UB::WhlRotCntrFrnt_UB_Control
{
  long resultValue;
  
  // --- FR ---
  setBusContext(getBusNameContext(gFR1BusName));
  switch(@this)
  {
     Case(this::SignalUBOFF) :
        resultValue = DisturbUB(Backbone::VDDM::VDDMBackBoneSignalIpdu07::WhlRotCntrFrnt_UB,0,-1,0); break;
     Case(this::SignalUBHandled) :
        resultValue = DisturbUB(Backbone::VDDM::VDDMBackBoneSignalIpdu07::WhlRotCntrFrnt_UB,0,0,0); break;
     Case(this::SignalUBON) :
        resultValue = DisturbUB(Backbone::VDDM::VDDMBackBoneSignalIpdu07::WhlRotCntrFrnt_UB,0,-1,1); break;
     Default :
        resultValue = -1;
  }
  
}

on sysvar_update sysvar::VDDM::Backbone::Signals::Control::UB::CoolgLoadGroup_UB_Control
{
  long resultValue;
  
  // --- FR ---
  setBusContext(getBusNameContext(gFR1BusName));
  switch(@this)
  {
     Case(this::SignalUBOFF) :
        resultValue = DisturbUB(Backbone::VDDM::VDDMBackBoneSignalIpdu08::CoolgLoadGroup_UB,0,-1,0); break;
     Case(this::SignalUBHandled) :
        resultValue = DisturbUB(Backbone::VDDM::VDDMBackBoneSignalIpdu08::CoolgLoadGroup_UB,0,0,0); break;
     Case(this::SignalUBON) :
        resultValue = DisturbUB(Backbone::VDDM::VDDMBackBoneSignalIpdu08::CoolgLoadGroup_UB,0,-1,1); break;
     Default :
        resultValue = -1;
  }
  
}

on sysvar_update sysvar::VDDM::Backbone::Signals::Control::UB::CrsSetSpdEco_UB_Control
{
  long resultValue;
  
  // --- FR ---
  setBusContext(getBusNameContext(gFR1BusName));
  switch(@this)
  {
     Case(this::SignalUBOFF) :
        resultValue = DisturbUB(Backbone::VDDM::VDDMBackBoneSignalIpdu08::CrsSetSpdEco_UB,0,-1,0); break;
     Case(this::SignalUBHandled) :
        resultValue = DisturbUB(Backbone::VDDM::VDDMBackBoneSignalIpdu08::CrsSetSpdEco_UB,0,0,0); break;
     Case(this::SignalUBON) :
        resultValue = DisturbUB(Backbone::VDDM::VDDMBackBoneSignalIpdu08::CrsSetSpdEco_UB,0,-1,1); break;
     Default :
        resultValue = -1;
  }
  
}

on sysvar_update sysvar::VDDM::Backbone::Signals::Control::UB::EngFltIndcn_UB_Control
{
  long resultValue;
  
  // --- FR ---
  setBusContext(getBusNameContext(gFR1BusName));
  switch(@this)
  {
     Case(this::SignalUBOFF) :
        resultValue = DisturbUB(Backbone::VDDM::VDDMBackBoneSignalIpdu08::EngFltIndcn_UB,0,-1,0); break;
     Case(this::SignalUBHandled) :
        resultValue = DisturbUB(Backbone::VDDM::VDDMBackBoneSignalIpdu08::EngFltIndcn_UB,0,0,0); break;
     Case(this::SignalUBON) :
        resultValue = DisturbUB(Backbone::VDDM::VDDMBackBoneSignalIpdu08::EngFltIndcn_UB,0,-1,1); break;
     Default :
        resultValue = -1;
  }
  
}

on sysvar_update sysvar::VDDM::Backbone::Signals::Control::UB::EngTGrp_UB_Control
{
  long resultValue;
  
  // --- FR ---
  setBusContext(getBusNameContext(gFR1BusName));
  switch(@this)
  {
     Case(this::SignalUBOFF) :
        resultValue = DisturbUB(Backbone::VDDM::VDDMBackBoneSignalIpdu08::EngTGrp_UB,0,-1,0); break;
     Case(this::SignalUBHandled) :
        resultValue = DisturbUB(Backbone::VDDM::VDDMBackBoneSignalIpdu08::EngTGrp_UB,0,0,0); break;
     Case(this::SignalUBON) :
        resultValue = DisturbUB(Backbone::VDDM::VDDMBackBoneSignalIpdu08::EngTGrp_UB,0,-1,1); break;
     Default :
        resultValue = -1;
  }
  
}

on sysvar_update sysvar::VDDM::Backbone::Signals::Control::UB::AltBoostIndcn_UB_Control
{
  long resultValue;
  
  // --- FR ---
  setBusContext(getBusNameContext(gFR1BusName));
  switch(@this)
  {
     Case(this::SignalUBOFF) :
        resultValue = DisturbUB(Backbone::VDDM::VDDMBackBoneSignalIpdu08::AltBoostIndcn_UB,0,-1,0); break;
     Case(this::SignalUBHandled) :
        resultValue = DisturbUB(Backbone::VDDM::VDDMBackBoneSignalIpdu08::AltBoostIndcn_UB,0,0,0); break;
     Case(this::SignalUBON) :
        resultValue = DisturbUB(Backbone::VDDM::VDDMBackBoneSignalIpdu08::AltBoostIndcn_UB,0,-1,1); break;
     Default :
        resultValue = -1;
  }
  
}

on sysvar_update sysvar::VDDM::Backbone::Signals::Control::UB::AltFltElec_UB_Control
{
  long resultValue;
  
  // --- FR ---
  setBusContext(getBusNameContext(gFR1BusName));
  switch(@this)
  {
     Case(this::SignalUBOFF) :
        resultValue = DisturbUB(Backbone::VDDM::VDDMBackBoneSignalIpdu08::AltFltElec_UB,0,-1,0); break;
     Case(this::SignalUBHandled) :
        resultValue = DisturbUB(Backbone::VDDM::VDDMBackBoneSignalIpdu08::AltFltElec_UB,0,0,0); break;
     Case(this::SignalUBON) :
        resultValue = DisturbUB(Backbone::VDDM::VDDMBackBoneSignalIpdu08::AltFltElec_UB,0,-1,1); break;
     Default :
        resultValue = -1;
  }
  
}

on sysvar_update sysvar::VDDM::Backbone::Signals::Control::UB::AltFltMecl_UB_Control
{
  long resultValue;
  
  // --- FR ---
  setBusContext(getBusNameContext(gFR1BusName));
  switch(@this)
  {
     Case(this::SignalUBOFF) :
        resultValue = DisturbUB(Backbone::VDDM::VDDMBackBoneSignalIpdu08::AltFltMecl_UB,0,-1,0); break;
     Case(this::SignalUBHandled) :
        resultValue = DisturbUB(Backbone::VDDM::VDDMBackBoneSignalIpdu08::AltFltMecl_UB,0,0,0); break;
     Case(this::SignalUBON) :
        resultValue = DisturbUB(Backbone::VDDM::VDDMBackBoneSignalIpdu08::AltFltMecl_UB,0,-1,1); break;
     Default :
        resultValue = -1;
  }
  
}

on sysvar_update sysvar::VDDM::Backbone::Signals::Control::UB::AltFltT_UB_Control
{
  long resultValue;
  
  // --- FR ---
  setBusContext(getBusNameContext(gFR1BusName));
  switch(@this)
  {
     Case(this::SignalUBOFF) :
        resultValue = DisturbUB(Backbone::VDDM::VDDMBackBoneSignalIpdu08::AltFltT_UB,0,-1,0); break;
     Case(this::SignalUBHandled) :
        resultValue = DisturbUB(Backbone::VDDM::VDDMBackBoneSignalIpdu08::AltFltT_UB,0,0,0); break;
     Case(this::SignalUBON) :
        resultValue = DisturbUB(Backbone::VDDM::VDDMBackBoneSignalIpdu08::AltFltT_UB,0,-1,1); break;
     Default :
        resultValue = -1;
  }
  
}

on sysvar_update sysvar::VDDM::Backbone::Signals::Control::UB::AltNoResp_UB_Control
{
  long resultValue;
  
  // --- FR ---
  setBusContext(getBusNameContext(gFR1BusName));
  switch(@this)
  {
     Case(this::SignalUBOFF) :
        resultValue = DisturbUB(Backbone::VDDM::VDDMBackBoneSignalIpdu08::AltNoResp_UB,0,-1,0); break;
     Case(this::SignalUBHandled) :
        resultValue = DisturbUB(Backbone::VDDM::VDDMBackBoneSignalIpdu08::AltNoResp_UB,0,0,0); break;
     Case(this::SignalUBON) :
        resultValue = DisturbUB(Backbone::VDDM::VDDMBackBoneSignalIpdu08::AltNoResp_UB,0,-1,1); break;
     Default :
        resultValue = -1;
  }
  
}

on sysvar_update sysvar::VDDM::Backbone::Signals::Control::UB::BattRlyFlt_UB_Control
{
  long resultValue;
  
  // --- FR ---
  setBusContext(getBusNameContext(gFR1BusName));
  switch(@this)
  {
     Case(this::SignalUBOFF) :
        resultValue = DisturbUB(Backbone::VDDM::VDDMBackBoneSignalIpdu08::BattRlyFlt_UB,0,-1,0); break;
     Case(this::SignalUBHandled) :
        resultValue = DisturbUB(Backbone::VDDM::VDDMBackBoneSignalIpdu08::BattRlyFlt_UB,0,0,0); break;
     Case(this::SignalUBON) :
        resultValue = DisturbUB(Backbone::VDDM::VDDMBackBoneSignalIpdu08::BattRlyFlt_UB,0,-1,1); break;
     Default :
        resultValue = -1;
  }
  
}

on sysvar_update sysvar::VDDM::Backbone::Signals::Control::UB::ChrgnTiEstimd_UB_Control
{
  long resultValue;
  
  // --- FR ---
  setBusContext(getBusNameContext(gFR1BusName));
  switch(@this)
  {
     Case(this::SignalUBOFF) :
        resultValue = DisturbUB(Backbone::VDDM::VDDMBackBoneSignalIpdu08::ChrgnTiEstimd_UB,0,-1,0); break;
     Case(this::SignalUBHandled) :
        resultValue = DisturbUB(Backbone::VDDM::VDDMBackBoneSignalIpdu08::ChrgnTiEstimd_UB,0,0,0); break;
     Case(this::SignalUBON) :
        resultValue = DisturbUB(Backbone::VDDM::VDDMBackBoneSignalIpdu08::ChrgnTiEstimd_UB,0,-1,1); break;
     Default :
        resultValue = -1;
  }
  
}

on sysvar_update sysvar::VDDM::Backbone::Signals::Control::UB::CmptmtCoolgSts_UB_Control
{
  long resultValue;
  
  // --- FR ---
  setBusContext(getBusNameContext(gFR1BusName));
  switch(@this)
  {
     Case(this::SignalUBOFF) :
        resultValue = DisturbUB(Backbone::VDDM::VDDMBackBoneSignalIpdu08::CmptmtCoolgSts_UB,0,-1,0); break;
     Case(this::SignalUBHandled) :
        resultValue = DisturbUB(Backbone::VDDM::VDDMBackBoneSignalIpdu08::CmptmtCoolgSts_UB,0,0,0); break;
     Case(this::SignalUBON) :
        resultValue = DisturbUB(Backbone::VDDM::VDDMBackBoneSignalIpdu08::CmptmtCoolgSts_UB,0,-1,1); break;
     Default :
        resultValue = -1;
  }
  
}

on sysvar_update sysvar::VDDM::Backbone::Signals::Control::UB::CoastAPhaIndcn_UB_Control
{
  long resultValue;
  
  // --- FR ---
  setBusContext(getBusNameContext(gFR1BusName));
  switch(@this)
  {
     Case(this::SignalUBOFF) :
        resultValue = DisturbUB(Backbone::VDDM::VDDMBackBoneSignalIpdu08::CoastAPhaIndcn_UB,0,-1,0); break;
     Case(this::SignalUBHandled) :
        resultValue = DisturbUB(Backbone::VDDM::VDDMBackBoneSignalIpdu08::CoastAPhaIndcn_UB,0,0,0); break;
     Case(this::SignalUBON) :
        resultValue = DisturbUB(Backbone::VDDM::VDDMBackBoneSignalIpdu08::CoastAPhaIndcn_UB,0,-1,1); break;
     Default :
        resultValue = -1;
  }
  
}

on sysvar_update sysvar::VDDM::Backbone::Signals::Control::UB::CoastIdleActv_UB_Control
{
  long resultValue;
  
  // --- FR ---
  setBusContext(getBusNameContext(gFR1BusName));
  switch(@this)
  {
     Case(this::SignalUBOFF) :
        resultValue = DisturbUB(Backbone::VDDM::VDDMBackBoneSignalIpdu08::CoastIdleActv_UB,0,-1,0); break;
     Case(this::SignalUBHandled) :
        resultValue = DisturbUB(Backbone::VDDM::VDDMBackBoneSignalIpdu08::CoastIdleActv_UB,0,0,0); break;
     Case(this::SignalUBON) :
        resultValue = DisturbUB(Backbone::VDDM::VDDMBackBoneSignalIpdu08::CoastIdleActv_UB,0,-1,1); break;
     Default :
        resultValue = -1;
  }
  
}

on sysvar_update sysvar::VDDM::Backbone::Signals::Control::UB::CoastIdlePhaIndcn_UB_Control
{
  long resultValue;
  
  // --- FR ---
  setBusContext(getBusNameContext(gFR1BusName));
  switch(@this)
  {
     Case(this::SignalUBOFF) :
        resultValue = DisturbUB(Backbone::VDDM::VDDMBackBoneSignalIpdu08::CoastIdlePhaIndcn_UB,0,-1,0); break;
     Case(this::SignalUBHandled) :
        resultValue = DisturbUB(Backbone::VDDM::VDDMBackBoneSignalIpdu08::CoastIdlePhaIndcn_UB,0,0,0); break;
     Case(this::SignalUBON) :
        resultValue = DisturbUB(Backbone::VDDM::VDDMBackBoneSignalIpdu08::CoastIdlePhaIndcn_UB,0,-1,1); break;
     Default :
        resultValue = -1;
  }
  
}

on sysvar_update sysvar::VDDM::Backbone::Signals::Control::UB::ComLostExtrSound_UB_Control
{
  long resultValue;
  
  // --- FR ---
  setBusContext(getBusNameContext(gFR1BusName));
  switch(@this)
  {
     Case(this::SignalUBOFF) :
        resultValue = DisturbUB(Backbone::VDDM::VDDMBackBoneSignalIpdu08::ComLostExtrSound_UB,0,-1,0); break;
     Case(this::SignalUBHandled) :
        resultValue = DisturbUB(Backbone::VDDM::VDDMBackBoneSignalIpdu08::ComLostExtrSound_UB,0,0,0); break;
     Case(this::SignalUBON) :
        resultValue = DisturbUB(Backbone::VDDM::VDDMBackBoneSignalIpdu08::ComLostExtrSound_UB,0,-1,1); break;
     Default :
        resultValue = -1;
  }
  
}

on sysvar_update sysvar::VDDM::Backbone::Signals::Control::UB::CrsEcoActv_UB_Control
{
  long resultValue;
  
  // --- FR ---
  setBusContext(getBusNameContext(gFR1BusName));
  switch(@this)
  {
     Case(this::SignalUBOFF) :
        resultValue = DisturbUB(Backbone::VDDM::VDDMBackBoneSignalIpdu08::CrsEcoActv_UB,0,-1,0); break;
     Case(this::SignalUBHandled) :
        resultValue = DisturbUB(Backbone::VDDM::VDDMBackBoneSignalIpdu08::CrsEcoActv_UB,0,0,0); break;
     Case(this::SignalUBON) :
        resultValue = DisturbUB(Backbone::VDDM::VDDMBackBoneSignalIpdu08::CrsEcoActv_UB,0,-1,1); break;
     Default :
        resultValue = -1;
  }
  
}

on sysvar_update sysvar::VDDM::Backbone::Signals::Control::UB::DispBattEgyIn_UB_Control
{
  long resultValue;
  
  // --- FR ---
  setBusContext(getBusNameContext(gFR1BusName));
  switch(@this)
  {
     Case(this::SignalUBOFF) :
        resultValue = DisturbUB(Backbone::VDDM::VDDMBackBoneSignalIpdu08::DispBattEgyIn_UB,0,-1,0); break;
     Case(this::SignalUBHandled) :
        resultValue = DisturbUB(Backbone::VDDM::VDDMBackBoneSignalIpdu08::DispBattEgyIn_UB,0,0,0); break;
     Case(this::SignalUBON) :
        resultValue = DisturbUB(Backbone::VDDM::VDDMBackBoneSignalIpdu08::DispBattEgyIn_UB,0,-1,1); break;
     Default :
        resultValue = -1;
  }
  
}

on sysvar_update sysvar::VDDM::Backbone::Signals::Control::UB::DispBattEgyOut_UB_Control
{
  long resultValue;
  
  // --- FR ---
  setBusContext(getBusNameContext(gFR1BusName));
  switch(@this)
  {
     Case(this::SignalUBOFF) :
        resultValue = DisturbUB(Backbone::VDDM::VDDMBackBoneSignalIpdu08::DispBattEgyOut_UB,0,-1,0); break;
     Case(this::SignalUBHandled) :
        resultValue = DisturbUB(Backbone::VDDM::VDDMBackBoneSignalIpdu08::DispBattEgyOut_UB,0,0,0); break;
     Case(this::SignalUBON) :
        resultValue = DisturbUB(Backbone::VDDM::VDDMBackBoneSignalIpdu08::DispBattEgyOut_UB,0,-1,1); break;
     Default :
        resultValue = -1;
  }
  
}

on sysvar_update sysvar::VDDM::Backbone::Signals::Control::UB::DstEstimdToEmptyForDrvgElec_UB_Control
{
  long resultValue;
  
  // --- FR ---
  setBusContext(getBusNameContext(gFR1BusName));
  switch(@this)
  {
     Case(this::SignalUBOFF) :
        resultValue = DisturbUB(Backbone::VDDM::VDDMBackBoneSignalIpdu08::DstEstimdToEmptyForDrvgElec_UB,0,-1,0); break;
     Case(this::SignalUBHandled) :
        resultValue = DisturbUB(Backbone::VDDM::VDDMBackBoneSignalIpdu08::DstEstimdToEmptyForDrvgElec_UB,0,0,0); break;
     Case(this::SignalUBON) :
        resultValue = DisturbUB(Backbone::VDDM::VDDMBackBoneSignalIpdu08::DstEstimdToEmptyForDrvgElec_UB,0,-1,1); break;
     Default :
        resultValue = -1;
  }
  
}

on sysvar_update sysvar::VDDM::Backbone::Signals::Control::UB::DstTrvldFromBrkBkp_UB_Control
{
  long resultValue;
  
  // --- FR ---
  setBusContext(getBusNameContext(gFR1BusName));
  switch(@this)
  {
     Case(this::SignalUBOFF) :
        resultValue = DisturbUB(Backbone::VDDM::VDDMBackBoneSignalIpdu08::DstTrvldFromBrkBkp_UB,0,-1,0); break;
     Case(this::SignalUBHandled) :
        resultValue = DisturbUB(Backbone::VDDM::VDDMBackBoneSignalIpdu08::DstTrvldFromBrkBkp_UB,0,0,0); break;
     Case(this::SignalUBON) :
        resultValue = DisturbUB(Backbone::VDDM::VDDMBackBoneSignalIpdu08::DstTrvldFromBrkBkp_UB,0,-1,1); break;
     Default :
        resultValue = -1;
  }
  
}

on sysvar_update sysvar::VDDM::Backbone::Signals::Control::UB::EngCooltInhbFlow_UB_Control
{
  long resultValue;
  
  // --- FR ---
  setBusContext(getBusNameContext(gFR1BusName));
  switch(@this)
  {
     Case(this::SignalUBOFF) :
        resultValue = DisturbUB(Backbone::VDDM::VDDMBackBoneSignalIpdu08::EngCooltInhbFlow_UB,0,-1,0); break;
     Case(this::SignalUBHandled) :
        resultValue = DisturbUB(Backbone::VDDM::VDDMBackBoneSignalIpdu08::EngCooltInhbFlow_UB,0,0,0); break;
     Case(this::SignalUBON) :
        resultValue = DisturbUB(Backbone::VDDM::VDDMBackBoneSignalIpdu08::EngCooltInhbFlow_UB,0,-1,1); break;
     Default :
        resultValue = -1;
  }
  
}

on sysvar_update sysvar::VDDM::Backbone::Signals::Control::UB::EngCooltLoFlowReq_UB_Control
{
  long resultValue;
  
  // --- FR ---
  setBusContext(getBusNameContext(gFR1BusName));
  switch(@this)
  {
     Case(this::SignalUBOFF) :
        resultValue = DisturbUB(Backbone::VDDM::VDDMBackBoneSignalIpdu08::EngCooltLoFlowReq_UB,0,-1,0); break;
     Case(this::SignalUBHandled) :
        resultValue = DisturbUB(Backbone::VDDM::VDDMBackBoneSignalIpdu08::EngCooltLoFlowReq_UB,0,0,0); break;
     Case(this::SignalUBON) :
        resultValue = DisturbUB(Backbone::VDDM::VDDMBackBoneSignalIpdu08::EngCooltLoFlowReq_UB,0,-1,1); break;
     Default :
        resultValue = -1;
  }
  
}

on sysvar_update sysvar::VDDM::Backbone::Signals::Control::UB::EngCooltTPercForDisp_UB_Control
{
  long resultValue;
  
  // --- FR ---
  setBusContext(getBusNameContext(gFR1BusName));
  switch(@this)
  {
     Case(this::SignalUBOFF) :
        resultValue = DisturbUB(Backbone::VDDM::VDDMBackBoneSignalIpdu08::EngCooltTPercForDisp_UB,0,-1,0); break;
     Case(this::SignalUBHandled) :
        resultValue = DisturbUB(Backbone::VDDM::VDDMBackBoneSignalIpdu08::EngCooltTPercForDisp_UB,0,0,0); break;
     Case(this::SignalUBON) :
        resultValue = DisturbUB(Backbone::VDDM::VDDMBackBoneSignalIpdu08::EngCooltTPercForDisp_UB,0,-1,1); break;
     Default :
        resultValue = -1;
  }
  
}

on sysvar_update sysvar::VDDM::Backbone::Signals::Control::UB::EngCrashFb_UB_Control
{
  long resultValue;
  
  // --- FR ---
  setBusContext(getBusNameContext(gFR1BusName));
  switch(@this)
  {
     Case(this::SignalUBOFF) :
        resultValue = DisturbUB(Backbone::VDDM::VDDMBackBoneSignalIpdu08::EngCrashFb_UB,0,-1,0); break;
     Case(this::SignalUBHandled) :
        resultValue = DisturbUB(Backbone::VDDM::VDDMBackBoneSignalIpdu08::EngCrashFb_UB,0,0,0); break;
     Case(this::SignalUBON) :
        resultValue = DisturbUB(Backbone::VDDM::VDDMBackBoneSignalIpdu08::EngCrashFb_UB,0,-1,1); break;
     Default :
        resultValue = -1;
  }
  
}

on sysvar_update sysvar::VDDM::Backbone::Signals::Control::UB::EngOilLvl_UB_Control
{
  long resultValue;
  
  // --- FR ---
  setBusContext(getBusNameContext(gFR1BusName));
  switch(@this)
  {
     Case(this::SignalUBOFF) :
        resultValue = DisturbUB(Backbone::VDDM::VDDMBackBoneSignalIpdu08::EngOilLvl_UB,0,-1,0); break;
     Case(this::SignalUBHandled) :
        resultValue = DisturbUB(Backbone::VDDM::VDDMBackBoneSignalIpdu08::EngOilLvl_UB,0,0,0); break;
     Case(this::SignalUBON) :
        resultValue = DisturbUB(Backbone::VDDM::VDDMBackBoneSignalIpdu08::EngOilLvl_UB,0,-1,1); break;
     Default :
        resultValue = -1;
  }
  
}

on sysvar_update sysvar::VDDM::Backbone::Signals::Control::UB::EngOilLvlSts_UB_Control
{
  long resultValue;
  
  // --- FR ---
  setBusContext(getBusNameContext(gFR1BusName));
  switch(@this)
  {
     Case(this::SignalUBOFF) :
        resultValue = DisturbUB(Backbone::VDDM::VDDMBackBoneSignalIpdu08::EngOilLvlSts_UB,0,-1,0); break;
     Case(this::SignalUBHandled) :
        resultValue = DisturbUB(Backbone::VDDM::VDDMBackBoneSignalIpdu08::EngOilLvlSts_UB,0,0,0); break;
     Case(this::SignalUBON) :
        resultValue = DisturbUB(Backbone::VDDM::VDDMBackBoneSignalIpdu08::EngOilLvlSts_UB,0,-1,1); break;
     Default :
        resultValue = -1;
  }
  
}

on sysvar_update sysvar::VDDM::Backbone::Signals::Control::UB::EpbBtnCtrlSt_UB_Control
{
  long resultValue;
  
  // --- FR ---
  setBusContext(getBusNameContext(gFR1BusName));
  switch(@this)
  {
     Case(this::SignalUBOFF) :
        resultValue = DisturbUB(Backbone::VDDM::VDDMBackBoneSignalIpdu08::EpbBtnCtrlSt_UB,0,-1,0); break;
     Case(this::SignalUBHandled) :
        resultValue = DisturbUB(Backbone::VDDM::VDDMBackBoneSignalIpdu08::EpbBtnCtrlSt_UB,0,0,0); break;
     Case(this::SignalUBON) :
        resultValue = DisturbUB(Backbone::VDDM::VDDMBackBoneSignalIpdu08::EpbBtnCtrlSt_UB,0,-1,1); break;
     Default :
        resultValue = -1;
  }
  
}

on sysvar_update sysvar::VDDM::Backbone::Signals::Control::UB::EvaprVlvReqRe_UB_Control
{
  long resultValue;
  
  // --- FR ---
  setBusContext(getBusNameContext(gFR1BusName));
  switch(@this)
  {
     Case(this::SignalUBOFF) :
        resultValue = DisturbUB(Backbone::VDDM::VDDMBackBoneSignalIpdu08::EvaprVlvReqRe_UB,0,-1,0); break;
     Case(this::SignalUBHandled) :
        resultValue = DisturbUB(Backbone::VDDM::VDDMBackBoneSignalIpdu08::EvaprVlvReqRe_UB,0,0,0); break;
     Case(this::SignalUBON) :
        resultValue = DisturbUB(Backbone::VDDM::VDDMBackBoneSignalIpdu08::EvaprVlvReqRe_UB,0,-1,1); break;
     Default :
        resultValue = -1;
  }
  
}

on sysvar_update sysvar::VDDM::Backbone::Signals::Control::UB::FltCrkIndcn_UB_Control
{
  long resultValue;
  
  // --- FR ---
  setBusContext(getBusNameContext(gFR1BusName));
  switch(@this)
  {
     Case(this::SignalUBOFF) :
        resultValue = DisturbUB(Backbone::VDDM::VDDMBackBoneSignalIpdu08::FltCrkIndcn_UB,0,-1,0); break;
     Case(this::SignalUBHandled) :
        resultValue = DisturbUB(Backbone::VDDM::VDDMBackBoneSignalIpdu08::FltCrkIndcn_UB,0,0,0); break;
     Case(this::SignalUBON) :
        resultValue = DisturbUB(Backbone::VDDM::VDDMBackBoneSignalIpdu08::FltCrkIndcn_UB,0,-1,1); break;
     Default :
        resultValue = -1;
  }
  
}

on sysvar_update sysvar::VDDM::Backbone::Signals::Control::UB::FuTankPOkForFuHeatr_UB_Control
{
  long resultValue;
  
  // --- FR ---
  setBusContext(getBusNameContext(gFR1BusName));
  switch(@this)
  {
     Case(this::SignalUBOFF) :
        resultValue = DisturbUB(Backbone::VDDM::VDDMBackBoneSignalIpdu08::FuTankPOkForFuHeatr_UB,0,-1,0); break;
     Case(this::SignalUBHandled) :
        resultValue = DisturbUB(Backbone::VDDM::VDDMBackBoneSignalIpdu08::FuTankPOkForFuHeatr_UB,0,0,0); break;
     Case(this::SignalUBON) :
        resultValue = DisturbUB(Backbone::VDDM::VDDMBackBoneSignalIpdu08::FuTankPOkForFuHeatr_UB,0,-1,1); break;
     Default :
        resultValue = -1;
  }
  
}

on sysvar_update sysvar::VDDM::Backbone::Signals::Control::UB::HvEgyLoadFctReq_UB_Control
{
  long resultValue;
  
  // --- FR ---
  setBusContext(getBusNameContext(gFR1BusName));
  switch(@this)
  {
     Case(this::SignalUBOFF) :
        resultValue = DisturbUB(Backbone::VDDM::VDDMBackBoneSignalIpdu08::HvEgyLoadFctReq_UB,0,-1,0); break;
     Case(this::SignalUBHandled) :
        resultValue = DisturbUB(Backbone::VDDM::VDDMBackBoneSignalIpdu08::HvEgyLoadFctReq_UB,0,0,0); break;
     Case(this::SignalUBON) :
        resultValue = DisturbUB(Backbone::VDDM::VDDMBackBoneSignalIpdu08::HvEgyLoadFctReq_UB,0,-1,1); break;
     Default :
        resultValue = -1;
  }
  
}

on sysvar_update sysvar::VDDM::Backbone::Signals::Control::UB::HvHeatgPwrAllwd_UB_Control
{
  long resultValue;
  
  // --- FR ---
  setBusContext(getBusNameContext(gFR1BusName));
  switch(@this)
  {
     Case(this::SignalUBOFF) :
        resultValue = DisturbUB(Backbone::VDDM::VDDMBackBoneSignalIpdu08::HvHeatgPwrAllwd_UB,0,-1,0); break;
     Case(this::SignalUBHandled) :
        resultValue = DisturbUB(Backbone::VDDM::VDDMBackBoneSignalIpdu08::HvHeatgPwrAllwd_UB,0,0,0); break;
     Case(this::SignalUBON) :
        resultValue = DisturbUB(Backbone::VDDM::VDDMBackBoneSignalIpdu08::HvHeatgPwrAllwd_UB,0,-1,1); break;
     Default :
        resultValue = -1;
  }
  
}

on sysvar_update sysvar::VDDM::Backbone::Signals::Control::UB::HvPwrEgyPrio_UB_Control
{
  long resultValue;
  
  // --- FR ---
  setBusContext(getBusNameContext(gFR1BusName));
  switch(@this)
  {
     Case(this::SignalUBOFF) :
        resultValue = DisturbUB(Backbone::VDDM::VDDMBackBoneSignalIpdu08::HvPwrEgyPrio_UB,0,-1,0); break;
     Case(this::SignalUBHandled) :
        resultValue = DisturbUB(Backbone::VDDM::VDDMBackBoneSignalIpdu08::HvPwrEgyPrio_UB,0,0,0); break;
     Case(this::SignalUBON) :
        resultValue = DisturbUB(Backbone::VDDM::VDDMBackBoneSignalIpdu08::HvPwrEgyPrio_UB,0,-1,1); break;
     Default :
        resultValue = -1;
  }
  
}

on sysvar_update sysvar::VDDM::Backbone::Signals::Control::UB::HvSysCrashFb_UB_Control
{
  long resultValue;
  
  // --- FR ---
  setBusContext(getBusNameContext(gFR1BusName));
  switch(@this)
  {
     Case(this::SignalUBOFF) :
        resultValue = DisturbUB(Backbone::VDDM::VDDMBackBoneSignalIpdu08::HvSysCrashFb_UB,0,-1,0); break;
     Case(this::SignalUBHandled) :
        resultValue = DisturbUB(Backbone::VDDM::VDDMBackBoneSignalIpdu08::HvSysCrashFb_UB,0,0,0); break;
     Case(this::SignalUBON) :
        resultValue = DisturbUB(Backbone::VDDM::VDDMBackBoneSignalIpdu08::HvSysCrashFb_UB,0,-1,1); break;
     Default :
        resultValue = -1;
  }
  
}

on sysvar_update sysvar::VDDM::Backbone::Signals::Control::UB::LeakDetdActv_UB_Control
{
  long resultValue;
  
  // --- FR ---
  setBusContext(getBusNameContext(gFR1BusName));
  switch(@this)
  {
     Case(this::SignalUBOFF) :
        resultValue = DisturbUB(Backbone::VDDM::VDDMBackBoneSignalIpdu08::LeakDetdActv_UB,0,-1,0); break;
     Case(this::SignalUBHandled) :
        resultValue = DisturbUB(Backbone::VDDM::VDDMBackBoneSignalIpdu08::LeakDetdActv_UB,0,0,0); break;
     Case(this::SignalUBON) :
        resultValue = DisturbUB(Backbone::VDDM::VDDMBackBoneSignalIpdu08::LeakDetdActv_UB,0,-1,1); break;
     Default :
        resultValue = -1;
  }
  
}

on sysvar_update sysvar::VDDM::Backbone::Signals::Control::UB::PrpsnModOffroadBlkd_UB_Control
{
  long resultValue;
  
  // --- FR ---
  setBusContext(getBusNameContext(gFR1BusName));
  switch(@this)
  {
     Case(this::SignalUBOFF) :
        resultValue = DisturbUB(Backbone::VDDM::VDDMBackBoneSignalIpdu08::PrpsnModOffroadBlkd_UB,0,-1,0); break;
     Case(this::SignalUBHandled) :
        resultValue = DisturbUB(Backbone::VDDM::VDDMBackBoneSignalIpdu08::PrpsnModOffroadBlkd_UB,0,0,0); break;
     Case(this::SignalUBON) :
        resultValue = DisturbUB(Backbone::VDDM::VDDMBackBoneSignalIpdu08::PrpsnModOffroadBlkd_UB,0,-1,1); break;
     Default :
        resultValue = -1;
  }
  
}

on sysvar_update sysvar::VDDM::Backbone::Signals::Control::UB::RcwmBrkActvd_UB_Control
{
  long resultValue;
  
  // --- FR ---
  setBusContext(getBusNameContext(gFR1BusName));
  switch(@this)
  {
     Case(this::SignalUBOFF) :
        resultValue = DisturbUB(Backbone::VDDM::VDDMBackBoneSignalIpdu08::RcwmBrkActvd_UB,0,-1,0); break;
     Case(this::SignalUBHandled) :
        resultValue = DisturbUB(Backbone::VDDM::VDDMBackBoneSignalIpdu08::RcwmBrkActvd_UB,0,0,0); break;
     Case(this::SignalUBON) :
        resultValue = DisturbUB(Backbone::VDDM::VDDMBackBoneSignalIpdu08::RcwmBrkActvd_UB,0,-1,1); break;
     Default :
        resultValue = -1;
  }
  
}

on sysvar_update sysvar::VDDM::Backbone::Signals::Control::UB::RngExtd_UB_Control
{
  long resultValue;
  
  // --- FR ---
  setBusContext(getBusNameContext(gFR1BusName));
  switch(@this)
  {
     Case(this::SignalUBOFF) :
        resultValue = DisturbUB(Backbone::VDDM::VDDMBackBoneSignalIpdu08::RngExtd_UB,0,-1,0); break;
     Case(this::SignalUBHandled) :
        resultValue = DisturbUB(Backbone::VDDM::VDDMBackBoneSignalIpdu08::RngExtd_UB,0,0,0); break;
     Case(this::SignalUBON) :
        resultValue = DisturbUB(Backbone::VDDM::VDDMBackBoneSignalIpdu08::RngExtd_UB,0,-1,1); break;
     Default :
        resultValue = -1;
  }
  
}

on sysvar_update sysvar::VDDM::Backbone::Signals::Control::UB::StopStrtStbIndcn_UB_Control
{
  long resultValue;
  
  // --- FR ---
  setBusContext(getBusNameContext(gFR1BusName));
  switch(@this)
  {
     Case(this::SignalUBOFF) :
        resultValue = DisturbUB(Backbone::VDDM::VDDMBackBoneSignalIpdu08::StopStrtStbIndcn_UB,0,-1,0); break;
     Case(this::SignalUBHandled) :
        resultValue = DisturbUB(Backbone::VDDM::VDDMBackBoneSignalIpdu08::StopStrtStbIndcn_UB,0,0,0); break;
     Case(this::SignalUBON) :
        resultValue = DisturbUB(Backbone::VDDM::VDDMBackBoneSignalIpdu08::StopStrtStbIndcn_UB,0,-1,1); break;
     Default :
        resultValue = -1;
  }
  
}

on sysvar_update sysvar::VDDM::Backbone::Signals::Control::UB::SumActv_UB_Control
{
  long resultValue;
  
  // --- FR ---
  setBusContext(getBusNameContext(gFR1BusName));
  switch(@this)
  {
     Case(this::SignalUBOFF) :
        resultValue = DisturbUB(Backbone::VDDM::VDDMBackBoneSignalIpdu08::SumActv_UB,0,-1,0); break;
     Case(this::SignalUBHandled) :
        resultValue = DisturbUB(Backbone::VDDM::VDDMBackBoneSignalIpdu08::SumActv_UB,0,0,0); break;
     Case(this::SignalUBON) :
        resultValue = DisturbUB(Backbone::VDDM::VDDMBackBoneSignalIpdu08::SumActv_UB,0,-1,1); break;
     Default :
        resultValue = -1;
  }
  
}

on sysvar_update sysvar::VDDM::Backbone::Signals::Control::UB::UBoostReqByPt_UB_Control
{
  long resultValue;
  
  // --- FR ---
  setBusContext(getBusNameContext(gFR1BusName));
  switch(@this)
  {
     Case(this::SignalUBOFF) :
        resultValue = DisturbUB(Backbone::VDDM::VDDMBackBoneSignalIpdu08::UBoostReqByPt_UB,0,-1,0); break;
     Case(this::SignalUBHandled) :
        resultValue = DisturbUB(Backbone::VDDM::VDDMBackBoneSignalIpdu08::UBoostReqByPt_UB,0,0,0); break;
     Case(this::SignalUBON) :
        resultValue = DisturbUB(Backbone::VDDM::VDDMBackBoneSignalIpdu08::UBoostReqByPt_UB,0,-1,1); break;
     Default :
        resultValue = -1;
  }
  
}

on sysvar_update sysvar::VDDM::Backbone::SignalGroups::Control::E2E::BrkSysWarnIndcnReqBrkSysWarnIndcnReqChks_Control
{
  int controlValue;
  long resultValue;
  
  // --- FR ---
  controlValue = (int) @this;
  setBusContext(getBusNameContext(gFR1BusName));
  switch(controlValue)
  {
     Case(this::ChksHandled) :
        resultValue = EnableCRC("BrkSysWarnIndcnReq", 1); break;
     Case(this::ChksManual) :
        resultValue = EnableCRC("BrkSysWarnIndcnReq", 0); break;
     Default :
        resultValue = -1;
  }
  
}

on sysvar_update sysvar::VDDM::Backbone::SignalGroups::Control::E2E::BrkSysWarnIndcnReqBrkSysWarnIndcnReqCntr_Control
{
  int controlValue;
  long resultValue;
  
  // --- FR ---
  controlValue = (int) @this;
  setBusContext(getBusNameContext(gFR1BusName));
  switch(controlValue)
  {
     Case(this::CntrHandled) :
        resultValue = EnableCounter ("BrkSysWarnIndcnReq", 1); break;
     Case(this::CntrManual) :
        resultValue = EnableCounter ("BrkSysWarnIndcnReq", 0); break;
     Default :
        resultValue = -1;
  }
  
}

on sysvar_update sysvar::VDDM::Backbone::SignalGroups::Control::E2E::DrvrGearShiftDirReq1Chks_Control
{
  int controlValue;
  long resultValue;
  
  // --- FR ---
  controlValue = (int) @this;
  setBusContext(getBusNameContext(gFR1BusName));
  switch(controlValue)
  {
     Case(this::ChksHandled) :
        resultValue = EnableCRC("DrvrGearShiftDirReqSafe1", 1); break;
     Case(this::ChksManual) :
        resultValue = EnableCRC("DrvrGearShiftDirReqSafe1", 0); break;
     Default :
        resultValue = -1;
  }
  
}

on sysvar_update sysvar::VDDM::Backbone::SignalGroups::Control::E2E::DrvrGearShiftDirReq1Cntr_Control
{
  int controlValue;
  long resultValue;
  
  // --- FR ---
  controlValue = (int) @this;
  setBusContext(getBusNameContext(gFR1BusName));
  switch(controlValue)
  {
     Case(this::CntrHandled) :
        resultValue = EnableCounter ("DrvrGearShiftDirReqSafe1", 1); break;
     Case(this::CntrManual) :
        resultValue = EnableCounter ("DrvrGearShiftDirReqSafe1", 0); break;
     Default :
        resultValue = -1;
  }
  
}

on sysvar_update sysvar::VDDM::Backbone::SignalGroups::Control::E2E::SuspFailrStsSuspFailrStsChks_Control
{
  int controlValue;
  long resultValue;
  
  // --- FR ---
  controlValue = (int) @this;
  setBusContext(getBusNameContext(gFR1BusName));
  switch(controlValue)
  {
     Case(this::ChksHandled) :
        resultValue = EnableCRC("SuspFailrSts", 1); break;
     Case(this::ChksManual) :
        resultValue = EnableCRC("SuspFailrSts", 0); break;
     Default :
        resultValue = -1;
  }
  
}

on sysvar_update sysvar::VDDM::Backbone::SignalGroups::Control::E2E::SuspFailrStsSuspFailrStsCntr_Control
{
  int controlValue;
  long resultValue;
  
  // --- FR ---
  controlValue = (int) @this;
  setBusContext(getBusNameContext(gFR1BusName));
  switch(controlValue)
  {
     Case(this::CntrHandled) :
        resultValue = EnableCounter ("SuspFailrSts", 1); break;
     Case(this::CntrManual) :
        resultValue = EnableCounter ("SuspFailrSts", 0); break;
     Default :
        resultValue = -1;
  }
  
}

on sysvar_update sysvar::VDDM::Backbone::Signals::Control::UB::BrkSysWarnIndcnReq_UB_Control
{
  long resultValue;
  
  // --- FR ---
  setBusContext(getBusNameContext(gFR1BusName));
  switch(@this)
  {
     Case(this::SignalUBOFF) :
        resultValue = DisturbUB(Backbone::VDDM::VDDMBackBoneSignalIpdu09::BrkSysWarnIndcnReq_UB,0,-1,0); break;
     Case(this::SignalUBHandled) :
        resultValue = DisturbUB(Backbone::VDDM::VDDMBackBoneSignalIpdu09::BrkSysWarnIndcnReq_UB,0,0,0); break;
     Case(this::SignalUBON) :
        resultValue = DisturbUB(Backbone::VDDM::VDDMBackBoneSignalIpdu09::BrkSysWarnIndcnReq_UB,0,-1,1); break;
     Default :
        resultValue = -1;
  }
  
}

on sysvar_update sysvar::VDDM::Backbone::Signals::Control::UB::DrvrGearShiftDirReqSafe1_UB_Control
{
  long resultValue;
  
  // --- FR ---
  setBusContext(getBusNameContext(gFR1BusName));
  switch(@this)
  {
     Case(this::SignalUBOFF) :
        resultValue = DisturbUB(Backbone::VDDM::VDDMBackBoneSignalIpdu09::DrvrGearShiftDirReqSafe1_UB,0,-1,0); break;
     Case(this::SignalUBHandled) :
        resultValue = DisturbUB(Backbone::VDDM::VDDMBackBoneSignalIpdu09::DrvrGearShiftDirReqSafe1_UB,0,0,0); break;
     Case(this::SignalUBON) :
        resultValue = DisturbUB(Backbone::VDDM::VDDMBackBoneSignalIpdu09::DrvrGearShiftDirReqSafe1_UB,0,-1,1); break;
     Default :
        resultValue = -1;
  }
  
}

on sysvar_update sysvar::VDDM::Backbone::Signals::Control::UB::SteerLockChk_UB_Control
{
  long resultValue;
  
  // --- FR ---
  setBusContext(getBusNameContext(gFR1BusName));
  switch(@this)
  {
     Case(this::SignalUBOFF) :
        resultValue = DisturbUB(Backbone::VDDM::VDDMBackBoneSignalIpdu09::SteerLockChk_UB,0,-1,0); break;
     Case(this::SignalUBHandled) :
        resultValue = DisturbUB(Backbone::VDDM::VDDMBackBoneSignalIpdu09::SteerLockChk_UB,0,0,0); break;
     Case(this::SignalUBON) :
        resultValue = DisturbUB(Backbone::VDDM::VDDMBackBoneSignalIpdu09::SteerLockChk_UB,0,-1,1); break;
     Default :
        resultValue = -1;
  }
  
}

on sysvar_update sysvar::VDDM::Backbone::Signals::Control::UB::SuspFailrSts_UB_Control
{
  long resultValue;
  
  // --- FR ---
  setBusContext(getBusNameContext(gFR1BusName));
  switch(@this)
  {
     Case(this::SignalUBOFF) :
        resultValue = DisturbUB(Backbone::VDDM::VDDMBackBoneSignalIpdu09::SuspFailrSts_UB,0,-1,0); break;
     Case(this::SignalUBHandled) :
        resultValue = DisturbUB(Backbone::VDDM::VDDMBackBoneSignalIpdu09::SuspFailrSts_UB,0,0,0); break;
     Case(this::SignalUBON) :
        resultValue = DisturbUB(Backbone::VDDM::VDDMBackBoneSignalIpdu09::SuspFailrSts_UB,0,-1,1); break;
     Default :
        resultValue = -1;
  }
  
}

on sysvar_update sysvar::VDDM::Backbone::Signals::Control::UB::TrsmLockChk_UB_Control
{
  long resultValue;
  
  // --- FR ---
  setBusContext(getBusNameContext(gFR1BusName));
  switch(@this)
  {
     Case(this::SignalUBOFF) :
        resultValue = DisturbUB(Backbone::VDDM::VDDMBackBoneSignalIpdu09::TrsmLockChk_UB,0,-1,0); break;
     Case(this::SignalUBHandled) :
        resultValue = DisturbUB(Backbone::VDDM::VDDMBackBoneSignalIpdu09::TrsmLockChk_UB,0,0,0); break;
     Case(this::SignalUBON) :
        resultValue = DisturbUB(Backbone::VDDM::VDDMBackBoneSignalIpdu09::TrsmLockChk_UB,0,-1,1); break;
     Default :
        resultValue = -1;
  }
  
}

on sysvar_update sysvar::VDDM::Backbone::Signals::Control::UB::BodyHei_UB_Control
{
  long resultValue;
  
  // --- FR ---
  setBusContext(getBusNameContext(gFR1BusName));
  switch(@this)
  {
     Case(this::SignalUBOFF) :
        resultValue = DisturbUB(Backbone::VDDM::VDDMBackBoneSignalIpdu09::BodyHei_UB,0,-1,0); break;
     Case(this::SignalUBHandled) :
        resultValue = DisturbUB(Backbone::VDDM::VDDMBackBoneSignalIpdu09::BodyHei_UB,0,0,0); break;
     Case(this::SignalUBON) :
        resultValue = DisturbUB(Backbone::VDDM::VDDMBackBoneSignalIpdu09::BodyHei_UB,0,-1,1); break;
     Default :
        resultValue = -1;
  }
  
}

on sysvar_update sysvar::VDDM::Backbone::Signals::Control::UB::EngFuCnsFild_UB_Control
{
  long resultValue;
  
  // --- FR ---
  setBusContext(getBusNameContext(gFR1BusName));
  switch(@this)
  {
     Case(this::SignalUBOFF) :
        resultValue = DisturbUB(Backbone::VDDM::VDDMBackBoneSignalIpdu09::EngFuCnsFild_UB,0,-1,0); break;
     Case(this::SignalUBHandled) :
        resultValue = DisturbUB(Backbone::VDDM::VDDMBackBoneSignalIpdu09::EngFuCnsFild_UB,0,0,0); break;
     Case(this::SignalUBON) :
        resultValue = DisturbUB(Backbone::VDDM::VDDMBackBoneSignalIpdu09::EngFuCnsFild_UB,0,-1,1); break;
     Default :
        resultValue = -1;
  }
  
}

on sysvar_update sysvar::VDDM::Backbone::Signals::Control::UB::EngStbActI_UB_Control
{
  long resultValue;
  
  // --- FR ---
  setBusContext(getBusNameContext(gFR1BusName));
  switch(@this)
  {
     Case(this::SignalUBOFF) :
        resultValue = DisturbUB(Backbone::VDDM::VDDMBackBoneSignalIpdu09::EngStbActI_UB,0,-1,0); break;
     Case(this::SignalUBHandled) :
        resultValue = DisturbUB(Backbone::VDDM::VDDMBackBoneSignalIpdu09::EngStbActI_UB,0,0,0); break;
     Case(this::SignalUBON) :
        resultValue = DisturbUB(Backbone::VDDM::VDDMBackBoneSignalIpdu09::EngStbActI_UB,0,-1,1); break;
     Default :
        resultValue = -1;
  }
  
}

on sysvar_update sysvar::VDDM::Backbone::Signals::Control::UB::HvBattHeatgReq_UB_Control
{
  long resultValue;
  
  // --- FR ---
  setBusContext(getBusNameContext(gFR1BusName));
  switch(@this)
  {
     Case(this::SignalUBOFF) :
        resultValue = DisturbUB(Backbone::VDDM::VDDMBackBoneSignalIpdu09::HvBattHeatgReq_UB,0,-1,0); break;
     Case(this::SignalUBHandled) :
        resultValue = DisturbUB(Backbone::VDDM::VDDMBackBoneSignalIpdu09::HvBattHeatgReq_UB,0,0,0); break;
     Case(this::SignalUBON) :
        resultValue = DisturbUB(Backbone::VDDM::VDDMBackBoneSignalIpdu09::HvBattHeatgReq_UB,0,-1,1); break;
     Default :
        resultValue = -1;
  }
  
}

on sysvar_update sysvar::VDDM::Backbone::Signals::Control::UB::HvBattHeatrVlvPosn_UB_Control
{
  long resultValue;
  
  // --- FR ---
  setBusContext(getBusNameContext(gFR1BusName));
  switch(@this)
  {
     Case(this::SignalUBOFF) :
        resultValue = DisturbUB(Backbone::VDDM::VDDMBackBoneSignalIpdu09::HvBattHeatrVlvPosn_UB,0,-1,0); break;
     Case(this::SignalUBHandled) :
        resultValue = DisturbUB(Backbone::VDDM::VDDMBackBoneSignalIpdu09::HvBattHeatrVlvPosn_UB,0,0,0); break;
     Case(this::SignalUBON) :
        resultValue = DisturbUB(Backbone::VDDM::VDDMBackBoneSignalIpdu09::HvBattHeatrVlvPosn_UB,0,-1,1); break;
     Default :
        resultValue = -1;
  }
  
}

on sysvar_update sysvar::VDDM::Backbone::Signals::Control::UB::HvEgyCnsAllwdForClima_UB_Control
{
  long resultValue;
  
  // --- FR ---
  setBusContext(getBusNameContext(gFR1BusName));
  switch(@this)
  {
     Case(this::SignalUBOFF) :
        resultValue = DisturbUB(Backbone::VDDM::VDDMBackBoneSignalIpdu09::HvEgyCnsAllwdForClima_UB,0,-1,0); break;
     Case(this::SignalUBHandled) :
        resultValue = DisturbUB(Backbone::VDDM::VDDMBackBoneSignalIpdu09::HvEgyCnsAllwdForClima_UB,0,0,0); break;
     Case(this::SignalUBON) :
        resultValue = DisturbUB(Backbone::VDDM::VDDMBackBoneSignalIpdu09::HvEgyCnsAllwdForClima_UB,0,-1,1); break;
     Default :
        resultValue = -1;
  }
  
}

on sysvar_update sysvar::VDDM::Backbone::Signals::Control::UB::ImobEngSts2_UB_Control
{
  long resultValue;
  
  // --- FR ---
  setBusContext(getBusNameContext(gFR1BusName));
  switch(@this)
  {
     Case(this::SignalUBOFF) :
        resultValue = DisturbUB(Backbone::VDDM::VDDMBackBoneSignalIpdu09::ImobEngSts2_UB,0,-1,0); break;
     Case(this::SignalUBHandled) :
        resultValue = DisturbUB(Backbone::VDDM::VDDMBackBoneSignalIpdu09::ImobEngSts2_UB,0,0,0); break;
     Case(this::SignalUBON) :
        resultValue = DisturbUB(Backbone::VDDM::VDDMBackBoneSignalIpdu09::ImobEngSts2_UB,0,-1,1); break;
     Default :
        resultValue = -1;
  }
  
}

on sysvar_update sysvar::VDDM::Backbone::Signals::Control::UB::ImobEngSts3_UB_Control
{
  long resultValue;
  
  // --- FR ---
  setBusContext(getBusNameContext(gFR1BusName));
  switch(@this)
  {
     Case(this::SignalUBOFF) :
        resultValue = DisturbUB(Backbone::VDDM::VDDMBackBoneSignalIpdu09::ImobEngSts3_UB,0,-1,0); break;
     Case(this::SignalUBHandled) :
        resultValue = DisturbUB(Backbone::VDDM::VDDMBackBoneSignalIpdu09::ImobEngSts3_UB,0,0,0); break;
     Case(this::SignalUBON) :
        resultValue = DisturbUB(Backbone::VDDM::VDDMBackBoneSignalIpdu09::ImobEngSts3_UB,0,-1,1); break;
     Default :
        resultValue = -1;
  }
  
}

on sysvar_update sysvar::VDDM::Backbone::Signals::Control::UB::LvlgDirMovmtIndcr_UB_Control
{
  long resultValue;
  
  // --- FR ---
  setBusContext(getBusNameContext(gFR1BusName));
  switch(@this)
  {
     Case(this::SignalUBOFF) :
        resultValue = DisturbUB(Backbone::VDDM::VDDMBackBoneSignalIpdu09::LvlgDirMovmtIndcr_UB,0,-1,0); break;
     Case(this::SignalUBHandled) :
        resultValue = DisturbUB(Backbone::VDDM::VDDMBackBoneSignalIpdu09::LvlgDirMovmtIndcr_UB,0,0,0); break;
     Case(this::SignalUBON) :
        resultValue = DisturbUB(Backbone::VDDM::VDDMBackBoneSignalIpdu09::LvlgDirMovmtIndcr_UB,0,-1,1); break;
     Default :
        resultValue = -1;
  }
  
}

on sysvar_update sysvar::VDDM::Backbone::Signals::Control::UB::PinionSteerAgMax1_UB_Control
{
  long resultValue;
  
  // --- FR ---
  setBusContext(getBusNameContext(gFR1BusName));
  switch(@this)
  {
     Case(this::SignalUBOFF) :
        resultValue = DisturbUB(Backbone::VDDM::VDDMBackBoneSignalIpdu09::PinionSteerAgMax1_UB,0,-1,0); break;
     Case(this::SignalUBHandled) :
        resultValue = DisturbUB(Backbone::VDDM::VDDMBackBoneSignalIpdu09::PinionSteerAgMax1_UB,0,0,0); break;
     Case(this::SignalUBON) :
        resultValue = DisturbUB(Backbone::VDDM::VDDMBackBoneSignalIpdu09::PinionSteerAgMax1_UB,0,-1,1); break;
     Default :
        resultValue = -1;
  }
  
}

on sysvar_update sysvar::VDDM::Backbone::Signals::Control::UB::StrtMsgToModMngt_UB_Control
{
  long resultValue;
  
  // --- FR ---
  setBusContext(getBusNameContext(gFR1BusName));
  switch(@this)
  {
     Case(this::SignalUBOFF) :
        resultValue = DisturbUB(Backbone::VDDM::VDDMBackBoneSignalIpdu09::StrtMsgToModMngt_UB,0,-1,0); break;
     Case(this::SignalUBHandled) :
        resultValue = DisturbUB(Backbone::VDDM::VDDMBackBoneSignalIpdu09::StrtMsgToModMngt_UB,0,0,0); break;
     Case(this::SignalUBON) :
        resultValue = DisturbUB(Backbone::VDDM::VDDMBackBoneSignalIpdu09::StrtMsgToModMngt_UB,0,-1,1); break;
     Default :
        resultValue = -1;
  }
  
}

on sysvar_update sysvar::VDDM::Backbone::Signals::Control::UB::TankFlapLockUnlckReq_UB_Control
{
  long resultValue;
  
  // --- FR ---
  setBusContext(getBusNameContext(gFR1BusName));
  switch(@this)
  {
     Case(this::SignalUBOFF) :
        resultValue = DisturbUB(Backbone::VDDM::VDDMBackBoneSignalIpdu09::TankFlapLockUnlckReq_UB,0,-1,0); break;
     Case(this::SignalUBHandled) :
        resultValue = DisturbUB(Backbone::VDDM::VDDMBackBoneSignalIpdu09::TankFlapLockUnlckReq_UB,0,0,0); break;
     Case(this::SignalUBON) :
        resultValue = DisturbUB(Backbone::VDDM::VDDMBackBoneSignalIpdu09::TankFlapLockUnlckReq_UB,0,-1,1); break;
     Default :
        resultValue = -1;
  }
  
}

on sysvar_update sysvar::VDDM::Backbone::Signals::Control::UB::TrsmLockSts_UB_Control
{
  long resultValue;
  
  // --- FR ---
  setBusContext(getBusNameContext(gFR1BusName));
  switch(@this)
  {
     Case(this::SignalUBOFF) :
        resultValue = DisturbUB(Backbone::VDDM::VDDMBackBoneSignalIpdu09::TrsmLockSts_UB,0,-1,0); break;
     Case(this::SignalUBHandled) :
        resultValue = DisturbUB(Backbone::VDDM::VDDMBackBoneSignalIpdu09::TrsmLockSts_UB,0,0,0); break;
     Case(this::SignalUBON) :
        resultValue = DisturbUB(Backbone::VDDM::VDDMBackBoneSignalIpdu09::TrsmLockSts_UB,0,-1,1); break;
     Default :
        resultValue = -1;
  }
  
}

on sysvar_update sysvar::VDDM::Backbone::Signals::Control::UB::TrsmParkAutRdy_UB_Control
{
  long resultValue;
  
  // --- FR ---
  setBusContext(getBusNameContext(gFR1BusName));
  switch(@this)
  {
     Case(this::SignalUBOFF) :
        resultValue = DisturbUB(Backbone::VDDM::VDDMBackBoneSignalIpdu09::TrsmParkAutRdy_UB,0,-1,0); break;
     Case(this::SignalUBHandled) :
        resultValue = DisturbUB(Backbone::VDDM::VDDMBackBoneSignalIpdu09::TrsmParkAutRdy_UB,0,0,0); break;
     Case(this::SignalUBON) :
        resultValue = DisturbUB(Backbone::VDDM::VDDMBackBoneSignalIpdu09::TrsmParkAutRdy_UB,0,-1,1); break;
     Default :
        resultValue = -1;
  }
  
}

on sysvar_update sysvar::VDDM::Backbone::SignalGroups::Control::E2E::BrkFricTqTotAtWhlsActBrkFricTqTotAtWhlsActChks_Control
{
  int controlValue;
  long resultValue;
  
  // --- FR ---
  controlValue = (int) @this;
  setBusContext(getBusNameContext(gFR1BusName));
  switch(controlValue)
  {
     Case(this::ChksHandled) :
        resultValue = EnableCRC("BrkFricTqTotAtWhlsAct", 1); break;
     Case(this::ChksManual) :
        resultValue = EnableCRC("BrkFricTqTotAtWhlsAct", 0); break;
     Default :
        resultValue = -1;
  }
  
}

on sysvar_update sysvar::VDDM::Backbone::SignalGroups::Control::E2E::BrkFricTqTotAtWhlsActBrkFricTqTotAtWhlsActCntr_Control
{
  int controlValue;
  long resultValue;
  
  // --- FR ---
  controlValue = (int) @this;
  setBusContext(getBusNameContext(gFR1BusName));
  switch(controlValue)
  {
     Case(this::CntrHandled) :
        resultValue = EnableCounter ("BrkFricTqTotAtWhlsAct", 1); break;
     Case(this::CntrManual) :
        resultValue = EnableCounter ("BrkFricTqTotAtWhlsAct", 0); break;
     Default :
        resultValue = -1;
  }
  
}

on sysvar_update sysvar::VDDM::Backbone::Signals::Control::UB::BrkFricTqAtWhlAct_UB_Control
{
  long resultValue;
  
  // --- FR ---
  setBusContext(getBusNameContext(gFR1BusName));
  switch(@this)
  {
     Case(this::SignalUBOFF) :
        resultValue = DisturbUB(Backbone::VDDM::VDDMBackBoneSignalIpdu10::BrkFricTqAtWhlAct_UB,0,-1,0); break;
     Case(this::SignalUBHandled) :
        resultValue = DisturbUB(Backbone::VDDM::VDDMBackBoneSignalIpdu10::BrkFricTqAtWhlAct_UB,0,0,0); break;
     Case(this::SignalUBON) :
        resultValue = DisturbUB(Backbone::VDDM::VDDMBackBoneSignalIpdu10::BrkFricTqAtWhlAct_UB,0,-1,1); break;
     Default :
        resultValue = -1;
  }
  
}

on sysvar_update sysvar::VDDM::Backbone::Signals::Control::UB::BrkFricTqTotAtWhlsAct_UB_Control
{
  long resultValue;
  
  // --- FR ---
  setBusContext(getBusNameContext(gFR1BusName));
  switch(@this)
  {
     Case(this::SignalUBOFF) :
        resultValue = DisturbUB(Backbone::VDDM::VDDMBackBoneSignalIpdu10::BrkFricTqTotAtWhlsAct_UB,0,-1,0); break;
     Case(this::SignalUBHandled) :
        resultValue = DisturbUB(Backbone::VDDM::VDDMBackBoneSignalIpdu10::BrkFricTqTotAtWhlsAct_UB,0,0,0); break;
     Case(this::SignalUBON) :
        resultValue = DisturbUB(Backbone::VDDM::VDDMBackBoneSignalIpdu10::BrkFricTqTotAtWhlsAct_UB,0,-1,1); break;
     Default :
        resultValue = -1;
  }
  
}

on sysvar_update sysvar::VDDM::Backbone::Signals::Control::UB::PitchAgGlb_UB_Control
{
  long resultValue;
  
  // --- FR ---
  setBusContext(getBusNameContext(gFR1BusName));
  switch(@this)
  {
     Case(this::SignalUBOFF) :
        resultValue = DisturbUB(Backbone::VDDM::VDDMBackBoneSignalIpdu10::PitchAgGlb_UB,0,-1,0); break;
     Case(this::SignalUBHandled) :
        resultValue = DisturbUB(Backbone::VDDM::VDDMBackBoneSignalIpdu10::PitchAgGlb_UB,0,0,0); break;
     Case(this::SignalUBON) :
        resultValue = DisturbUB(Backbone::VDDM::VDDMBackBoneSignalIpdu10::PitchAgGlb_UB,0,-1,1); break;
     Default :
        resultValue = -1;
  }
  
}

on sysvar_update sysvar::VDDM::Backbone::Signals::Control::UB::RollAgGlb_UB_Control
{
  long resultValue;
  
  // --- FR ---
  setBusContext(getBusNameContext(gFR1BusName));
  switch(@this)
  {
     Case(this::SignalUBOFF) :
        resultValue = DisturbUB(Backbone::VDDM::VDDMBackBoneSignalIpdu10::RollAgGlb_UB,0,-1,0); break;
     Case(this::SignalUBHandled) :
        resultValue = DisturbUB(Backbone::VDDM::VDDMBackBoneSignalIpdu10::RollAgGlb_UB,0,0,0); break;
     Case(this::SignalUBON) :
        resultValue = DisturbUB(Backbone::VDDM::VDDMBackBoneSignalIpdu10::RollAgGlb_UB,0,-1,1); break;
     Default :
        resultValue = -1;
  }
  
}

on sysvar_update sysvar::VDDM::Backbone::Signals::Control::UB::BrkTqAtWhlsReq_UB_Control
{
  long resultValue;
  
  // --- FR ---
  setBusContext(getBusNameContext(gFR1BusName));
  switch(@this)
  {
     Case(this::SignalUBOFF) :
        resultValue = DisturbUB(Backbone::VDDM::VDDMBackBoneSignalIpdu10::BrkTqAtWhlsReq_UB,0,-1,0); break;
     Case(this::SignalUBHandled) :
        resultValue = DisturbUB(Backbone::VDDM::VDDMBackBoneSignalIpdu10::BrkTqAtWhlsReq_UB,0,0,0); break;
     Case(this::SignalUBON) :
        resultValue = DisturbUB(Backbone::VDDM::VDDMBackBoneSignalIpdu10::BrkTqAtWhlsReq_UB,0,-1,1); break;
     Default :
        resultValue = -1;
  }
  
}

on sysvar_update sysvar::VDDM::Backbone::Signals::Control::UB::CnclHldChrgReq_UB_Control
{
  long resultValue;
  
  // --- FR ---
  setBusContext(getBusNameContext(gFR1BusName));
  switch(@this)
  {
     Case(this::SignalUBOFF) :
        resultValue = DisturbUB(Backbone::VDDM::VDDMBackBoneSignalIpdu10::CnclHldChrgReq_UB,0,-1,0); break;
     Case(this::SignalUBHandled) :
        resultValue = DisturbUB(Backbone::VDDM::VDDMBackBoneSignalIpdu10::CnclHldChrgReq_UB,0,0,0); break;
     Case(this::SignalUBON) :
        resultValue = DisturbUB(Backbone::VDDM::VDDMBackBoneSignalIpdu10::CnclHldChrgReq_UB,0,-1,1); break;
     Default :
        resultValue = -1;
  }
  
}

on sysvar_update sysvar::VDDM::Backbone::Signals::Control::UB::ElecDrvSysThermLimnLvl_UB_Control
{
  long resultValue;
  
  // --- FR ---
  setBusContext(getBusNameContext(gFR1BusName));
  switch(@this)
  {
     Case(this::SignalUBOFF) :
        resultValue = DisturbUB(Backbone::VDDM::VDDMBackBoneSignalIpdu10::ElecDrvSysThermLimnLvl_UB,0,-1,0); break;
     Case(this::SignalUBHandled) :
        resultValue = DisturbUB(Backbone::VDDM::VDDMBackBoneSignalIpdu10::ElecDrvSysThermLimnLvl_UB,0,0,0); break;
     Case(this::SignalUBON) :
        resultValue = DisturbUB(Backbone::VDDM::VDDMBackBoneSignalIpdu10::ElecDrvSysThermLimnLvl_UB,0,-1,1); break;
     Default :
        resultValue = -1;
  }
  
}

on sysvar_update sysvar::VDDM::Backbone::Signals::Control::UB::EngAmbTCalcd_UB_Control
{
  long resultValue;
  
  // --- FR ---
  setBusContext(getBusNameContext(gFR1BusName));
  switch(@this)
  {
     Case(this::SignalUBOFF) :
        resultValue = DisturbUB(Backbone::VDDM::VDDMBackBoneSignalIpdu10::EngAmbTCalcd_UB,0,-1,0); break;
     Case(this::SignalUBHandled) :
        resultValue = DisturbUB(Backbone::VDDM::VDDMBackBoneSignalIpdu10::EngAmbTCalcd_UB,0,0,0); break;
     Case(this::SignalUBON) :
        resultValue = DisturbUB(Backbone::VDDM::VDDMBackBoneSignalIpdu10::EngAmbTCalcd_UB,0,-1,1); break;
     Default :
        resultValue = -1;
  }
  
}

on sysvar_update sysvar::VDDM::Backbone::Signals::Control::UB::FuAvlForFuHeatr_UB_Control
{
  long resultValue;
  
  // --- FR ---
  setBusContext(getBusNameContext(gFR1BusName));
  switch(@this)
  {
     Case(this::SignalUBOFF) :
        resultValue = DisturbUB(Backbone::VDDM::VDDMBackBoneSignalIpdu10::FuAvlForFuHeatr_UB,0,-1,0); break;
     Case(this::SignalUBHandled) :
        resultValue = DisturbUB(Backbone::VDDM::VDDMBackBoneSignalIpdu10::FuAvlForFuHeatr_UB,0,0,0); break;
     Case(this::SignalUBON) :
        resultValue = DisturbUB(Backbone::VDDM::VDDMBackBoneSignalIpdu10::FuAvlForFuHeatr_UB,0,-1,1); break;
     Default :
        resultValue = -1;
  }
  
}

on sysvar_update sysvar::VDDM::Backbone::Signals::Control::UB::HldChrgnReq_UB_Control
{
  long resultValue;
  
  // --- FR ---
  setBusContext(getBusNameContext(gFR1BusName));
  switch(@this)
  {
     Case(this::SignalUBOFF) :
        resultValue = DisturbUB(Backbone::VDDM::VDDMBackBoneSignalIpdu10::HldChrgnReq_UB,0,-1,0); break;
     Case(this::SignalUBHandled) :
        resultValue = DisturbUB(Backbone::VDDM::VDDMBackBoneSignalIpdu10::HldChrgnReq_UB,0,0,0); break;
     Case(this::SignalUBON) :
        resultValue = DisturbUB(Backbone::VDDM::VDDMBackBoneSignalIpdu10::HldChrgnReq_UB,0,-1,1); break;
     Default :
        resultValue = -1;
  }
  
}

on sysvar_update sysvar::VDDM::Backbone::Signals::Control::UB::HmiVehStopForRefu_UB_Control
{
  long resultValue;
  
  // --- FR ---
  setBusContext(getBusNameContext(gFR1BusName));
  switch(@this)
  {
     Case(this::SignalUBOFF) :
        resultValue = DisturbUB(Backbone::VDDM::VDDMBackBoneSignalIpdu10::HmiVehStopForRefu_UB,0,-1,0); break;
     Case(this::SignalUBHandled) :
        resultValue = DisturbUB(Backbone::VDDM::VDDMBackBoneSignalIpdu10::HmiVehStopForRefu_UB,0,0,0); break;
     Case(this::SignalUBON) :
        resultValue = DisturbUB(Backbone::VDDM::VDDMBackBoneSignalIpdu10::HmiVehStopForRefu_UB,0,-1,1); break;
     Default :
        resultValue = -1;
  }
  
}

on sysvar_update sysvar::VDDM::Backbone::Signals::Control::UB::HznRstExtd_UB_Control
{
  long resultValue;
  
  // --- FR ---
  setBusContext(getBusNameContext(gFR1BusName));
  switch(@this)
  {
     Case(this::SignalUBOFF) :
        resultValue = DisturbUB(Backbone::VDDM::VDDMBackBoneSignalIpdu10::HznRstExtd_UB,0,-1,0); break;
     Case(this::SignalUBHandled) :
        resultValue = DisturbUB(Backbone::VDDM::VDDMBackBoneSignalIpdu10::HznRstExtd_UB,0,0,0); break;
     Case(this::SignalUBON) :
        resultValue = DisturbUB(Backbone::VDDM::VDDMBackBoneSignalIpdu10::HznRstExtd_UB,0,-1,1); break;
     Default :
        resultValue = -1;
  }
  
}

on sysvar_update sysvar::VDDM::Backbone::Signals::Control::UB::iTPMSCalPsbl_UB_Control
{
  long resultValue;
  
  // --- FR ---
  setBusContext(getBusNameContext(gFR1BusName));
  switch(@this)
  {
     Case(this::SignalUBOFF) :
        resultValue = DisturbUB(Backbone::VDDM::VDDMBackBoneSignalIpdu10::iTPMSCalPsbl_UB,0,-1,0); break;
     Case(this::SignalUBHandled) :
        resultValue = DisturbUB(Backbone::VDDM::VDDMBackBoneSignalIpdu10::iTPMSCalPsbl_UB,0,0,0); break;
     Case(this::SignalUBON) :
        resultValue = DisturbUB(Backbone::VDDM::VDDMBackBoneSignalIpdu10::iTPMSCalPsbl_UB,0,-1,1); break;
     Default :
        resultValue = -1;
  }
  
}

on sysvar_update sysvar::VDDM::Backbone::Signals::Control::UB::iTPMSCalSts_UB_Control
{
  long resultValue;
  
  // --- FR ---
  setBusContext(getBusNameContext(gFR1BusName));
  switch(@this)
  {
     Case(this::SignalUBOFF) :
        resultValue = DisturbUB(Backbone::VDDM::VDDMBackBoneSignalIpdu10::iTPMSCalSts_UB,0,-1,0); break;
     Case(this::SignalUBHandled) :
        resultValue = DisturbUB(Backbone::VDDM::VDDMBackBoneSignalIpdu10::iTPMSCalSts_UB,0,0,0); break;
     Case(this::SignalUBON) :
        resultValue = DisturbUB(Backbone::VDDM::VDDMBackBoneSignalIpdu10::iTPMSCalSts_UB,0,-1,1); break;
     Default :
        resultValue = -1;
  }
  
}

on sysvar_update sysvar::VDDM::Backbone::Signals::Control::UB::iTPMSTirePMSts_UB_Control
{
  long resultValue;
  
  // --- FR ---
  setBusContext(getBusNameContext(gFR1BusName));
  switch(@this)
  {
     Case(this::SignalUBOFF) :
        resultValue = DisturbUB(Backbone::VDDM::VDDMBackBoneSignalIpdu10::iTPMSTirePMSts_UB,0,-1,0); break;
     Case(this::SignalUBHandled) :
        resultValue = DisturbUB(Backbone::VDDM::VDDMBackBoneSignalIpdu10::iTPMSTirePMSts_UB,0,0,0); break;
     Case(this::SignalUBON) :
        resultValue = DisturbUB(Backbone::VDDM::VDDMBackBoneSignalIpdu10::iTPMSTirePMSts_UB,0,-1,1); break;
     Default :
        resultValue = -1;
  }
  
}

on sysvar_update sysvar::VDDM::Backbone::Signals::Control::UB::PostImpctBrkgRdy_UB_Control
{
  long resultValue;
  
  // --- FR ---
  setBusContext(getBusNameContext(gFR1BusName));
  switch(@this)
  {
     Case(this::SignalUBOFF) :
        resultValue = DisturbUB(Backbone::VDDM::VDDMBackBoneSignalIpdu10::PostImpctBrkgRdy_UB,0,-1,0); break;
     Case(this::SignalUBHandled) :
        resultValue = DisturbUB(Backbone::VDDM::VDDMBackBoneSignalIpdu10::PostImpctBrkgRdy_UB,0,0,0); break;
     Case(this::SignalUBON) :
        resultValue = DisturbUB(Backbone::VDDM::VDDMBackBoneSignalIpdu10::PostImpctBrkgRdy_UB,0,-1,1); break;
     Default :
        resultValue = -1;
  }
  
}

on sysvar_update sysvar::VDDM::Backbone::Signals::Control::UB::PrpsnHvBattUsgOfChrgBlkd_UB_Control
{
  long resultValue;
  
  // --- FR ---
  setBusContext(getBusNameContext(gFR1BusName));
  switch(@this)
  {
     Case(this::SignalUBOFF) :
        resultValue = DisturbUB(Backbone::VDDM::VDDMBackBoneSignalIpdu10::PrpsnHvBattUsgOfChrgBlkd_UB,0,-1,0); break;
     Case(this::SignalUBHandled) :
        resultValue = DisturbUB(Backbone::VDDM::VDDMBackBoneSignalIpdu10::PrpsnHvBattUsgOfChrgBlkd_UB,0,0,0); break;
     Case(this::SignalUBON) :
        resultValue = DisturbUB(Backbone::VDDM::VDDMBackBoneSignalIpdu10::PrpsnHvBattUsgOfChrgBlkd_UB,0,-1,1); break;
     Default :
        resultValue = -1;
  }
  
}

on sysvar_update sysvar::VDDM::Backbone::Signals::Control::UB::PrpsnHvBattUsgOfChrgBlkd2_UB_Control
{
  long resultValue;
  
  // --- FR ---
  setBusContext(getBusNameContext(gFR1BusName));
  switch(@this)
  {
     Case(this::SignalUBOFF) :
        resultValue = DisturbUB(Backbone::VDDM::VDDMBackBoneSignalIpdu10::PrpsnHvBattUsgOfChrgBlkd2_UB,0,-1,0); break;
     Case(this::SignalUBHandled) :
        resultValue = DisturbUB(Backbone::VDDM::VDDMBackBoneSignalIpdu10::PrpsnHvBattUsgOfChrgBlkd2_UB,0,0,0); break;
     Case(this::SignalUBON) :
        resultValue = DisturbUB(Backbone::VDDM::VDDMBackBoneSignalIpdu10::PrpsnHvBattUsgOfChrgBlkd2_UB,0,-1,1); break;
     Default :
        resultValue = -1;
  }
  
}

on sysvar_update sysvar::VDDM::Backbone::Signals::Control::UB::PrpsnHvBattUsgOfDispSoc_UB_Control
{
  long resultValue;
  
  // --- FR ---
  setBusContext(getBusNameContext(gFR1BusName));
  switch(@this)
  {
     Case(this::SignalUBOFF) :
        resultValue = DisturbUB(Backbone::VDDM::VDDMBackBoneSignalIpdu10::PrpsnHvBattUsgOfDispSoc_UB,0,-1,0); break;
     Case(this::SignalUBHandled) :
        resultValue = DisturbUB(Backbone::VDDM::VDDMBackBoneSignalIpdu10::PrpsnHvBattUsgOfDispSoc_UB,0,0,0); break;
     Case(this::SignalUBON) :
        resultValue = DisturbUB(Backbone::VDDM::VDDMBackBoneSignalIpdu10::PrpsnHvBattUsgOfDispSoc_UB,0,-1,1); break;
     Default :
        resultValue = -1;
  }
  
}

on sysvar_update sysvar::VDDM::Backbone::Signals::Control::UB::PrpsnHvBattUsgOfHldBlkd_UB_Control
{
  long resultValue;
  
  // --- FR ---
  setBusContext(getBusNameContext(gFR1BusName));
  switch(@this)
  {
     Case(this::SignalUBOFF) :
        resultValue = DisturbUB(Backbone::VDDM::VDDMBackBoneSignalIpdu10::PrpsnHvBattUsgOfHldBlkd_UB,0,-1,0); break;
     Case(this::SignalUBHandled) :
        resultValue = DisturbUB(Backbone::VDDM::VDDMBackBoneSignalIpdu10::PrpsnHvBattUsgOfHldBlkd_UB,0,0,0); break;
     Case(this::SignalUBON) :
        resultValue = DisturbUB(Backbone::VDDM::VDDMBackBoneSignalIpdu10::PrpsnHvBattUsgOfHldBlkd_UB,0,-1,1); break;
     Default :
        resultValue = -1;
  }
  
}

on sysvar_update sysvar::VDDM::Backbone::Signals::Control::UB::PrpsnHvBattUsgOfHldBlkd2_UB_Control
{
  long resultValue;
  
  // --- FR ---
  setBusContext(getBusNameContext(gFR1BusName));
  switch(@this)
  {
     Case(this::SignalUBOFF) :
        resultValue = DisturbUB(Backbone::VDDM::VDDMBackBoneSignalIpdu10::PrpsnHvBattUsgOfHldBlkd2_UB,0,-1,0); break;
     Case(this::SignalUBHandled) :
        resultValue = DisturbUB(Backbone::VDDM::VDDMBackBoneSignalIpdu10::PrpsnHvBattUsgOfHldBlkd2_UB,0,0,0); break;
     Case(this::SignalUBON) :
        resultValue = DisturbUB(Backbone::VDDM::VDDMBackBoneSignalIpdu10::PrpsnHvBattUsgOfHldBlkd2_UB,0,-1,1); break;
     Default :
        resultValue = -1;
  }
  
}

on sysvar_update sysvar::VDDM::Backbone::Signals::Control::UB::PrpsnHvBattUsgOfHldSmtBlkd_UB_Control
{
  long resultValue;
  
  // --- FR ---
  setBusContext(getBusNameContext(gFR1BusName));
  switch(@this)
  {
     Case(this::SignalUBOFF) :
        resultValue = DisturbUB(Backbone::VDDM::VDDMBackBoneSignalIpdu10::PrpsnHvBattUsgOfHldSmtBlkd_UB,0,-1,0); break;
     Case(this::SignalUBHandled) :
        resultValue = DisturbUB(Backbone::VDDM::VDDMBackBoneSignalIpdu10::PrpsnHvBattUsgOfHldSmtBlkd_UB,0,0,0); break;
     Case(this::SignalUBON) :
        resultValue = DisturbUB(Backbone::VDDM::VDDMBackBoneSignalIpdu10::PrpsnHvBattUsgOfHldSmtBlkd_UB,0,-1,1); break;
     Default :
        resultValue = -1;
  }
  
}

on sysvar_update sysvar::VDDM::Backbone::Signals::Control::UB::PrpsnHvBattUsgOfHldSmtBlkd2_UB_Control
{
  long resultValue;
  
  // --- FR ---
  setBusContext(getBusNameContext(gFR1BusName));
  switch(@this)
  {
     Case(this::SignalUBOFF) :
        resultValue = DisturbUB(Backbone::VDDM::VDDMBackBoneSignalIpdu10::PrpsnHvBattUsgOfHldSmtBlkd2_UB,0,-1,0); break;
     Case(this::SignalUBHandled) :
        resultValue = DisturbUB(Backbone::VDDM::VDDMBackBoneSignalIpdu10::PrpsnHvBattUsgOfHldSmtBlkd2_UB,0,0,0); break;
     Case(this::SignalUBON) :
        resultValue = DisturbUB(Backbone::VDDM::VDDMBackBoneSignalIpdu10::PrpsnHvBattUsgOfHldSmtBlkd2_UB,0,-1,1); break;
     Default :
        resultValue = -1;
  }
  
}

on sysvar_update sysvar::VDDM::Backbone::Signals::Control::UB::PtCoolgPostRunActv_UB_Control
{
  long resultValue;
  
  // --- FR ---
  setBusContext(getBusNameContext(gFR1BusName));
  switch(@this)
  {
     Case(this::SignalUBOFF) :
        resultValue = DisturbUB(Backbone::VDDM::VDDMBackBoneSignalIpdu10::PtCoolgPostRunActv_UB,0,-1,0); break;
     Case(this::SignalUBHandled) :
        resultValue = DisturbUB(Backbone::VDDM::VDDMBackBoneSignalIpdu10::PtCoolgPostRunActv_UB,0,0,0); break;
     Case(this::SignalUBON) :
        resultValue = DisturbUB(Backbone::VDDM::VDDMBackBoneSignalIpdu10::PtCoolgPostRunActv_UB,0,-1,1); break;
     Default :
        resultValue = -1;
  }
  
}

on sysvar_update sysvar::VDDM::Backbone::Signals::Control::UB::RdyPostImpctBrkg_UB_Control
{
  long resultValue;
  
  // --- FR ---
  setBusContext(getBusNameContext(gFR1BusName));
  switch(@this)
  {
     Case(this::SignalUBOFF) :
        resultValue = DisturbUB(Backbone::VDDM::VDDMBackBoneSignalIpdu10::RdyPostImpctBrkg_UB,0,-1,0); break;
     Case(this::SignalUBHandled) :
        resultValue = DisturbUB(Backbone::VDDM::VDDMBackBoneSignalIpdu10::RdyPostImpctBrkg_UB,0,0,0); break;
     Case(this::SignalUBON) :
        resultValue = DisturbUB(Backbone::VDDM::VDDMBackBoneSignalIpdu10::RdyPostImpctBrkg_UB,0,-1,1); break;
     Default :
        resultValue = -1;
  }
  
}

on sysvar_update sysvar::VDDM::Backbone::Signals::Control::UB::ScrBarVolIndcn_UB_Control
{
  long resultValue;
  
  // --- FR ---
  setBusContext(getBusNameContext(gFR1BusName));
  switch(@this)
  {
     Case(this::SignalUBOFF) :
        resultValue = DisturbUB(Backbone::VDDM::VDDMBackBoneSignalIpdu10::ScrBarVolIndcn_UB,0,-1,0); break;
     Case(this::SignalUBHandled) :
        resultValue = DisturbUB(Backbone::VDDM::VDDMBackBoneSignalIpdu10::ScrBarVolIndcn_UB,0,0,0); break;
     Case(this::SignalUBON) :
        resultValue = DisturbUB(Backbone::VDDM::VDDMBackBoneSignalIpdu10::ScrBarVolIndcn_UB,0,-1,1); break;
     Default :
        resultValue = -1;
  }
  
}

on sysvar_update sysvar::VDDM::Backbone::Signals::Control::UB::ScrDstToEmpty_UB_Control
{
  long resultValue;
  
  // --- FR ---
  setBusContext(getBusNameContext(gFR1BusName));
  switch(@this)
  {
     Case(this::SignalUBOFF) :
        resultValue = DisturbUB(Backbone::VDDM::VDDMBackBoneSignalIpdu10::ScrDstToEmpty_UB,0,-1,0); break;
     Case(this::SignalUBHandled) :
        resultValue = DisturbUB(Backbone::VDDM::VDDMBackBoneSignalIpdu10::ScrDstToEmpty_UB,0,0,0); break;
     Case(this::SignalUBON) :
        resultValue = DisturbUB(Backbone::VDDM::VDDMBackBoneSignalIpdu10::ScrDstToEmpty_UB,0,-1,1); break;
     Default :
        resultValue = -1;
  }
  
}

on sysvar_update sysvar::VDDM::Backbone::Signals::Control::UB::ScrMaxFillgVol_UB_Control
{
  long resultValue;
  
  // --- FR ---
  setBusContext(getBusNameContext(gFR1BusName));
  switch(@this)
  {
     Case(this::SignalUBOFF) :
        resultValue = DisturbUB(Backbone::VDDM::VDDMBackBoneSignalIpdu10::ScrMaxFillgVol_UB,0,-1,0); break;
     Case(this::SignalUBHandled) :
        resultValue = DisturbUB(Backbone::VDDM::VDDMBackBoneSignalIpdu10::ScrMaxFillgVol_UB,0,0,0); break;
     Case(this::SignalUBON) :
        resultValue = DisturbUB(Backbone::VDDM::VDDMBackBoneSignalIpdu10::ScrMaxFillgVol_UB,0,-1,1); break;
     Default :
        resultValue = -1;
  }
  
}

on sysvar_update sysvar::VDDM::Backbone::Signals::Control::UB::ScrReagentTankVol_UB_Control
{
  long resultValue;
  
  // --- FR ---
  setBusContext(getBusNameContext(gFR1BusName));
  switch(@this)
  {
     Case(this::SignalUBOFF) :
        resultValue = DisturbUB(Backbone::VDDM::VDDMBackBoneSignalIpdu10::ScrReagentTankVol_UB,0,-1,0); break;
     Case(this::SignalUBHandled) :
        resultValue = DisturbUB(Backbone::VDDM::VDDMBackBoneSignalIpdu10::ScrReagentTankVol_UB,0,0,0); break;
     Case(this::SignalUBON) :
        resultValue = DisturbUB(Backbone::VDDM::VDDMBackBoneSignalIpdu10::ScrReagentTankVol_UB,0,-1,1); break;
     Default :
        resultValue = -1;
  }
  
}

on sysvar_update sysvar::VDDM::Backbone::Signals::Control::UB::ScrTelltl_UB_Control
{
  long resultValue;
  
  // --- FR ---
  setBusContext(getBusNameContext(gFR1BusName));
  switch(@this)
  {
     Case(this::SignalUBOFF) :
        resultValue = DisturbUB(Backbone::VDDM::VDDMBackBoneSignalIpdu10::ScrTelltl_UB,0,-1,0); break;
     Case(this::SignalUBHandled) :
        resultValue = DisturbUB(Backbone::VDDM::VDDMBackBoneSignalIpdu10::ScrTelltl_UB,0,0,0); break;
     Case(this::SignalUBON) :
        resultValue = DisturbUB(Backbone::VDDM::VDDMBackBoneSignalIpdu10::ScrTelltl_UB,0,-1,1); break;
     Default :
        resultValue = -1;
  }
  
}

on sysvar_update sysvar::VDDM::Backbone::Signals::Control::UB::TrsmGearAct_UB_Control
{
  long resultValue;
  
  // --- FR ---
  setBusContext(getBusNameContext(gFR1BusName));
  switch(@this)
  {
     Case(this::SignalUBOFF) :
        resultValue = DisturbUB(Backbone::VDDM::VDDMBackBoneSignalIpdu10::TrsmGearAct_UB,0,-1,0); break;
     Case(this::SignalUBHandled) :
        resultValue = DisturbUB(Backbone::VDDM::VDDMBackBoneSignalIpdu10::TrsmGearAct_UB,0,0,0); break;
     Case(this::SignalUBON) :
        resultValue = DisturbUB(Backbone::VDDM::VDDMBackBoneSignalIpdu10::TrsmGearAct_UB,0,-1,1); break;
     Default :
        resultValue = -1;
  }
  
}

on sysvar_update sysvar::VDDM::Backbone::SignalGroups::Control::E2E::DrvrGearShiftDirReq2Chks_Control
{
  int controlValue;
  long resultValue;
  
  // --- FR ---
  controlValue = (int) @this;
  setBusContext(getBusNameContext(gFR1BusName));
  switch(controlValue)
  {
     Case(this::ChksHandled) :
        resultValue = EnableCRC("DrvrGearShiftDirReq2", 1); break;
     Case(this::ChksManual) :
        resultValue = EnableCRC("DrvrGearShiftDirReq2", 0); break;
     Default :
        resultValue = -1;
  }
  
}

on sysvar_update sysvar::VDDM::Backbone::SignalGroups::Control::E2E::DrvrGearShiftDirReq2Cntr_Control
{
  int controlValue;
  long resultValue;
  
  // --- FR ---
  controlValue = (int) @this;
  setBusContext(getBusNameContext(gFR1BusName));
  switch(controlValue)
  {
     Case(this::CntrHandled) :
        resultValue = EnableCounter ("DrvrGearShiftDirReq2", 1); break;
     Case(this::CntrManual) :
        resultValue = EnableCounter ("DrvrGearShiftDirReq2", 0); break;
     Default :
        resultValue = -1;
  }
  
}

on sysvar_update sysvar::VDDM::Backbone::Signals::Control::UB::DrvrGearShiftDirReq2_UB_Control
{
  long resultValue;
  
  // --- FR ---
  setBusContext(getBusNameContext(gFR1BusName));
  switch(@this)
  {
     Case(this::SignalUBOFF) :
        resultValue = DisturbUB(Backbone::VDDM::VDDMBackBoneSignalIpdu11::DrvrGearShiftDirReq2_UB,0,-1,0); break;
     Case(this::SignalUBHandled) :
        resultValue = DisturbUB(Backbone::VDDM::VDDMBackBoneSignalIpdu11::DrvrGearShiftDirReq2_UB,0,0,0); break;
     Case(this::SignalUBON) :
        resultValue = DisturbUB(Backbone::VDDM::VDDMBackBoneSignalIpdu11::DrvrGearShiftDirReq2_UB,0,-1,1); break;
     Default :
        resultValue = -1;
  }
  
}

on sysvar_update sysvar::VDDM::Backbone::Signals::Control::UB::ImobEngChk5_UB_Control
{
  long resultValue;
  
  // --- FR ---
  setBusContext(getBusNameContext(gFR1BusName));
  switch(@this)
  {
     Case(this::SignalUBOFF) :
        resultValue = DisturbUB(Backbone::VDDM::VDDMBackBoneSignalIpdu11::ImobEngChk5_UB,0,-1,0); break;
     Case(this::SignalUBHandled) :
        resultValue = DisturbUB(Backbone::VDDM::VDDMBackBoneSignalIpdu11::ImobEngChk5_UB,0,0,0); break;
     Case(this::SignalUBON) :
        resultValue = DisturbUB(Backbone::VDDM::VDDMBackBoneSignalIpdu11::ImobEngChk5_UB,0,-1,1); break;
     Default :
        resultValue = -1;
  }
  
}

on sysvar_update sysvar::VDDM::Backbone::Signals::Control::UB::ImobEngChk6_UB_Control
{
  long resultValue;
  
  // --- FR ---
  setBusContext(getBusNameContext(gFR1BusName));
  switch(@this)
  {
     Case(this::SignalUBOFF) :
        resultValue = DisturbUB(Backbone::VDDM::VDDMBackBoneSignalIpdu11::ImobEngChk6_UB,0,-1,0); break;
     Case(this::SignalUBHandled) :
        resultValue = DisturbUB(Backbone::VDDM::VDDMBackBoneSignalIpdu11::ImobEngChk6_UB,0,0,0); break;
     Case(this::SignalUBON) :
        resultValue = DisturbUB(Backbone::VDDM::VDDMBackBoneSignalIpdu11::ImobEngChk6_UB,0,-1,1); break;
     Default :
        resultValue = -1;
  }
  
}

on sysvar_update sysvar::VDDM::Backbone::Signals::Control::UB::PwrInfo_UB_Control
{
  long resultValue;
  
  // --- FR ---
  setBusContext(getBusNameContext(gFR1BusName));
  switch(@this)
  {
     Case(this::SignalUBOFF) :
        resultValue = DisturbUB(Backbone::VDDM::VDDMBackBoneSignalIpdu11::PwrInfo_UB,0,-1,0); break;
     Case(this::SignalUBHandled) :
        resultValue = DisturbUB(Backbone::VDDM::VDDMBackBoneSignalIpdu11::PwrInfo_UB,0,0,0); break;
     Case(this::SignalUBON) :
        resultValue = DisturbUB(Backbone::VDDM::VDDMBackBoneSignalIpdu11::PwrInfo_UB,0,-1,1); break;
     Default :
        resultValue = -1;
  }
  
}

on sysvar_update sysvar::VDDM::Backbone::Signals::Control::UB::BltReqFromVehDyn_UB_Control
{
  long resultValue;
  
  // --- FR ---
  setBusContext(getBusNameContext(gFR1BusName));
  switch(@this)
  {
     Case(this::SignalUBOFF) :
        resultValue = DisturbUB(Backbone::VDDM::VDDMBackBoneSignalIpdu11::BltReqFromVehDyn_UB,0,-1,0); break;
     Case(this::SignalUBHandled) :
        resultValue = DisturbUB(Backbone::VDDM::VDDMBackBoneSignalIpdu11::BltReqFromVehDyn_UB,0,0,0); break;
     Case(this::SignalUBON) :
        resultValue = DisturbUB(Backbone::VDDM::VDDMBackBoneSignalIpdu11::BltReqFromVehDyn_UB,0,-1,1); break;
     Default :
        resultValue = -1;
  }
  
}

on sysvar_update sysvar::VDDM::Backbone::Signals::Control::UB::PrpsnDrvMod_UB_Control
{
  long resultValue;
  
  // --- FR ---
  setBusContext(getBusNameContext(gFR1BusName));
  switch(@this)
  {
     Case(this::SignalUBOFF) :
        resultValue = DisturbUB(Backbone::VDDM::VDDMBackBoneSignalIpdu11::PrpsnDrvMod_UB,0,-1,0); break;
     Case(this::SignalUBHandled) :
        resultValue = DisturbUB(Backbone::VDDM::VDDMBackBoneSignalIpdu11::PrpsnDrvMod_UB,0,0,0); break;
     Case(this::SignalUBON) :
        resultValue = DisturbUB(Backbone::VDDM::VDDMBackBoneSignalIpdu11::PrpsnDrvMod_UB,0,-1,1); break;
     Default :
        resultValue = -1;
  }
  
}

on sysvar_update sysvar::VDDM::Backbone::Signals::Control::UB::PtTqAtWhlReActGroup_UB_Control
{
  long resultValue;
  
  // --- FR ---
  setBusContext(getBusNameContext(gFR1BusName));
  switch(@this)
  {
     Case(this::SignalUBOFF) :
        resultValue = DisturbUB(Backbone::VDDM::VDDMBackBoneSignalIPdu13::PtTqAtWhlReActGroup_UB,0,-1,0); break;
     Case(this::SignalUBHandled) :
        resultValue = DisturbUB(Backbone::VDDM::VDDMBackBoneSignalIPdu13::PtTqAtWhlReActGroup_UB,0,0,0); break;
     Case(this::SignalUBON) :
        resultValue = DisturbUB(Backbone::VDDM::VDDMBackBoneSignalIPdu13::PtTqAtWhlReActGroup_UB,0,-1,1); break;
     Default :
        resultValue = -1;
  }
  
}

on sysvar_update sysvar::VDDM::Backbone::Signals::Control::UB::CnclWarnForCrsCtrl_UB_Control
{
  long resultValue;
  
  // --- FR ---
  setBusContext(getBusNameContext(gFR1BusName));
  switch(@this)
  {
     Case(this::SignalUBOFF) :
        resultValue = DisturbUB(Backbone::VDDM::VDDMBackBoneSignalIPdu13::CnclWarnForCrsCtrl_UB,0,-1,0); break;
     Case(this::SignalUBHandled) :
        resultValue = DisturbUB(Backbone::VDDM::VDDMBackBoneSignalIPdu13::CnclWarnForCrsCtrl_UB,0,0,0); break;
     Case(this::SignalUBON) :
        resultValue = DisturbUB(Backbone::VDDM::VDDMBackBoneSignalIPdu13::CnclWarnForCrsCtrl_UB,0,-1,1); break;
     Default :
        resultValue = -1;
  }
  
}

on sysvar_update sysvar::VDDM::Backbone::Signals::Control::UB::RoadLoadNom_UB_Control
{
  long resultValue;
  
  // --- FR ---
  setBusContext(getBusNameContext(gFR1BusName));
  switch(@this)
  {
     Case(this::SignalUBOFF) :
        resultValue = DisturbUB(Backbone::VDDM::VDDMBackBoneSignalIPdu14::RoadLoadNom_UB,0,-1,0); break;
     Case(this::SignalUBHandled) :
        resultValue = DisturbUB(Backbone::VDDM::VDDMBackBoneSignalIPdu14::RoadLoadNom_UB,0,0,0); break;
     Case(this::SignalUBON) :
        resultValue = DisturbUB(Backbone::VDDM::VDDMBackBoneSignalIPdu14::RoadLoadNom_UB,0,-1,1); break;
     Default :
        resultValue = -1;
  }
  
}

on sysvar_update sysvar::VDDM::Backbone::Signals::Control::UB::ActvnTiChrgnTmr_UB_Control
{
  long resultValue;
  
  // --- FR ---
  setBusContext(getBusNameContext(gFR1BusName));
  switch(@this)
  {
     Case(this::SignalUBOFF) :
        resultValue = DisturbUB(Backbone::VDDM::VDDMBackBoneSignalIPdu14::ActvnTiChrgnTmr_UB,0,-1,0); break;
     Case(this::SignalUBHandled) :
        resultValue = DisturbUB(Backbone::VDDM::VDDMBackBoneSignalIPdu14::ActvnTiChrgnTmr_UB,0,0,0); break;
     Case(this::SignalUBON) :
        resultValue = DisturbUB(Backbone::VDDM::VDDMBackBoneSignalIPdu14::ActvnTiChrgnTmr_UB,0,-1,1); break;
     Default :
        resultValue = -1;
  }
  
}

on sysvar_update sysvar::VDDM::Backbone::Signals::Control::UB::HznReqFromPosn_UB_Control
{
  long resultValue;
  
  // --- FR ---
  setBusContext(getBusNameContext(gFR1BusName));
  switch(@this)
  {
     Case(this::SignalUBOFF) :
        resultValue = DisturbUB(Backbone::VDDM::VDDMBackBoneSignalIPdu14::HznReqFromPosn_UB,0,-1,0); break;
     Case(this::SignalUBHandled) :
        resultValue = DisturbUB(Backbone::VDDM::VDDMBackBoneSignalIPdu14::HznReqFromPosn_UB,0,0,0); break;
     Case(this::SignalUBON) :
        resultValue = DisturbUB(Backbone::VDDM::VDDMBackBoneSignalIPdu14::HznReqFromPosn_UB,0,-1,1); break;
     Default :
        resultValue = -1;
  }
  
}

on sysvar_update sysvar::VDDM::Backbone::Signals::Control::UB::ImobEngSts5_UB_Control
{
  long resultValue;
  
  // --- FR ---
  setBusContext(getBusNameContext(gFR1BusName));
  switch(@this)
  {
     Case(this::SignalUBOFF) :
        resultValue = DisturbUB(Backbone::VDDM::VDDMBackBoneSignalIPdu14::ImobEngSts5_UB,0,-1,0); break;
     Case(this::SignalUBHandled) :
        resultValue = DisturbUB(Backbone::VDDM::VDDMBackBoneSignalIPdu14::ImobEngSts5_UB,0,0,0); break;
     Case(this::SignalUBON) :
        resultValue = DisturbUB(Backbone::VDDM::VDDMBackBoneSignalIPdu14::ImobEngSts5_UB,0,-1,1); break;
     Default :
        resultValue = -1;
  }
  
}

on sysvar_update sysvar::VDDM::Backbone::Signals::Control::UB::ImobEngSts6_UB_Control
{
  long resultValue;
  
  // --- FR ---
  setBusContext(getBusNameContext(gFR1BusName));
  switch(@this)
  {
     Case(this::SignalUBOFF) :
        resultValue = DisturbUB(Backbone::VDDM::VDDMBackBoneSignalIPdu14::ImobEngSts6_UB,0,-1,0); break;
     Case(this::SignalUBHandled) :
        resultValue = DisturbUB(Backbone::VDDM::VDDMBackBoneSignalIPdu14::ImobEngSts6_UB,0,0,0); break;
     Case(this::SignalUBON) :
        resultValue = DisturbUB(Backbone::VDDM::VDDMBackBoneSignalIPdu14::ImobEngSts6_UB,0,-1,1); break;
     Default :
        resultValue = -1;
  }
  
}

on sysvar_update sysvar::VDDM::Backbone::Signals::Control::UB::BrkPedlrRat_UB_Control
{
  long resultValue;
  
  // --- FR ---
  setBusContext(getBusNameContext(gFR1BusName));
  switch(@this)
  {
     Case(this::SignalUBOFF) :
        resultValue = DisturbUB(Backbone::VDDM::VDDMBackBoneSignalIPdu15::BrkPedlrRat_UB,0,-1,0); break;
     Case(this::SignalUBHandled) :
        resultValue = DisturbUB(Backbone::VDDM::VDDMBackBoneSignalIPdu15::BrkPedlrRat_UB,0,0,0); break;
     Case(this::SignalUBON) :
        resultValue = DisturbUB(Backbone::VDDM::VDDMBackBoneSignalIPdu15::BrkPedlrRat_UB,0,-1,1); break;
     Default :
        resultValue = -1;
  }
  
}

on sysvar_update sysvar::VDDM::Backbone::Signals::Control::UB::DiagcHvacCooltVlvErr_UB_Control
{
  long resultValue;
  
  // --- FR ---
  setBusContext(getBusNameContext(gFR1BusName));
  switch(@this)
  {
     Case(this::SignalUBOFF) :
        resultValue = DisturbUB(Backbone::VDDM::VDDMBackBoneSignalIPdu15::DiagcHvacCooltVlvErr_UB,0,-1,0); break;
     Case(this::SignalUBHandled) :
        resultValue = DisturbUB(Backbone::VDDM::VDDMBackBoneSignalIPdu15::DiagcHvacCooltVlvErr_UB,0,0,0); break;
     Case(this::SignalUBON) :
        resultValue = DisturbUB(Backbone::VDDM::VDDMBackBoneSignalIPdu15::DiagcHvacCooltVlvErr_UB,0,-1,1); break;
     Default :
        resultValue = -1;
  }
  
}

on sysvar_update sysvar::VDDM::Backbone::Signals::Control::UB::StandStillMgrStsForHld_UB_Control
{
  long resultValue;
  
  // --- FR ---
  setBusContext(getBusNameContext(gFR1BusName));
  switch(@this)
  {
     Case(this::SignalUBOFF) :
        resultValue = DisturbUB(Backbone::VDDM::VDDMBackBoneSignalIPdu15::StandStillMgrStsForHld_UB,0,-1,0); break;
     Case(this::SignalUBHandled) :
        resultValue = DisturbUB(Backbone::VDDM::VDDMBackBoneSignalIPdu15::StandStillMgrStsForHld_UB,0,0,0); break;
     Case(this::SignalUBON) :
        resultValue = DisturbUB(Backbone::VDDM::VDDMBackBoneSignalIPdu15::StandStillMgrStsForHld_UB,0,-1,1); break;
     Default :
        resultValue = -1;
  }
  
}

on sysvar_update sysvar::VDDM::Backbone::Signals::Control::UB::DataDistbnReqForEgyPred_UB_Control
{
  long resultValue;
  
  // --- FR ---
  setBusContext(getBusNameContext(gFR1BusName));
  switch(@this)
  {
     Case(this::SignalUBOFF) :
        resultValue = DisturbUB(Backbone::VDDM::VDDMBackBoneSignalIPdu16::DataDistbnReqForEgyPred_UB,0,-1,0); break;
     Case(this::SignalUBHandled) :
        resultValue = DisturbUB(Backbone::VDDM::VDDMBackBoneSignalIPdu16::DataDistbnReqForEgyPred_UB,0,0,0); break;
     Case(this::SignalUBON) :
        resultValue = DisturbUB(Backbone::VDDM::VDDMBackBoneSignalIPdu16::DataDistbnReqForEgyPred_UB,0,-1,1); break;
     Default :
        resultValue = -1;
  }
  
}

on sysvar_update sysvar::VDDM::Backbone::Signals::Control::UB::DestSrcAndCfmRqrd_UB_Control
{
  long resultValue;
  
  // --- FR ---
  setBusContext(getBusNameContext(gFR1BusName));
  switch(@this)
  {
     Case(this::SignalUBOFF) :
        resultValue = DisturbUB(Backbone::VDDM::VDDMBackBoneSignalIPdu16::DestSrcAndCfmRqrd_UB,0,-1,0); break;
     Case(this::SignalUBHandled) :
        resultValue = DisturbUB(Backbone::VDDM::VDDMBackBoneSignalIPdu16::DestSrcAndCfmRqrd_UB,0,0,0); break;
     Case(this::SignalUBON) :
        resultValue = DisturbUB(Backbone::VDDM::VDDMBackBoneSignalIPdu16::DestSrcAndCfmRqrd_UB,0,-1,1); break;
     Default :
        resultValue = -1;
  }
  
}

on sysvar_update sysvar::VDDM::Backbone::Signals::Control::UB::DstEstimdToEmptyForDrvgElecEco_UB_Control
{
  long resultValue;
  
  // --- FR ---
  setBusContext(getBusNameContext(gFR1BusName));
  switch(@this)
  {
     Case(this::SignalUBOFF) :
        resultValue = DisturbUB(Backbone::VDDM::VDDMBackBoneSignalIPdu16::DstEstimdToEmptyForDrvgElecEco_UB,0,-1,0); break;
     Case(this::SignalUBHandled) :
        resultValue = DisturbUB(Backbone::VDDM::VDDMBackBoneSignalIPdu16::DstEstimdToEmptyForDrvgElecEco_UB,0,0,0); break;
     Case(this::SignalUBON) :
        resultValue = DisturbUB(Backbone::VDDM::VDDMBackBoneSignalIPdu16::DstEstimdToEmptyForDrvgElecEco_UB,0,-1,1); break;
     Default :
        resultValue = -1;
  }
  
}

on sysvar_update sysvar::VDDM::Backbone::Signals::Control::UB::TelltlPwrLoss_UB_Control
{
  long resultValue;
  
  // --- FR ---
  setBusContext(getBusNameContext(gFR1BusName));
  switch(@this)
  {
     Case(this::SignalUBOFF) :
        resultValue = DisturbUB(Backbone::VDDM::VDDMBackBoneSignalIPdu16::TelltlPwrLoss_UB,0,-1,0); break;
     Case(this::SignalUBHandled) :
        resultValue = DisturbUB(Backbone::VDDM::VDDMBackBoneSignalIPdu16::TelltlPwrLoss_UB,0,0,0); break;
     Case(this::SignalUBON) :
        resultValue = DisturbUB(Backbone::VDDM::VDDMBackBoneSignalIPdu16::TelltlPwrLoss_UB,0,-1,1); break;
     Default :
        resultValue = -1;
  }
  
}

on sysvar_update sysvar::VDDM::Backbone::Signals::Control::UB::TireRdEstimd_UB_Control
{
  long resultValue;
  
  // --- FR ---
  setBusContext(getBusNameContext(gFR1BusName));
  switch(@this)
  {
     Case(this::SignalUBOFF) :
        resultValue = DisturbUB(Backbone::VDDM::VDDMBackBoneSignalIPdu16::TireRdEstimd_UB,0,-1,0); break;
     Case(this::SignalUBHandled) :
        resultValue = DisturbUB(Backbone::VDDM::VDDMBackBoneSignalIPdu16::TireRdEstimd_UB,0,0,0); break;
     Case(this::SignalUBON) :
        resultValue = DisturbUB(Backbone::VDDM::VDDMBackBoneSignalIPdu16::TireRdEstimd_UB,0,-1,1); break;
     Default :
        resultValue = -1;
  }
  
}

on sysvar_update sysvar::VDDM::Backbone::Signals::Control::UB::TireRdEstimdQly_UB_Control
{
  long resultValue;
  
  // --- FR ---
  setBusContext(getBusNameContext(gFR1BusName));
  switch(@this)
  {
     Case(this::SignalUBOFF) :
        resultValue = DisturbUB(Backbone::VDDM::VDDMBackBoneSignalIPdu16::TireRdEstimdQly_UB,0,-1,0); break;
     Case(this::SignalUBHandled) :
        resultValue = DisturbUB(Backbone::VDDM::VDDMBackBoneSignalIPdu16::TireRdEstimdQly_UB,0,0,0); break;
     Case(this::SignalUBON) :
        resultValue = DisturbUB(Backbone::VDDM::VDDMBackBoneSignalIPdu16::TireRdEstimdQly_UB,0,-1,1); break;
     Default :
        resultValue = -1;
  }
  
}

on sysvar_update sysvar::VDDM::Backbone::Signals::Control::UB::IemGeneric_UB_Control
{
  long resultValue;
  
  // --- FR ---
  setBusContext(getBusNameContext(gFR1BusName));
  switch(@this)
  {
     Case(this::SignalUBOFF) :
        resultValue = DisturbUB(Backbone::VDDM::VDDMBackBoneSignalIPdu17::IemGeneric_UB,0,-1,0); break;
     Case(this::SignalUBHandled) :
        resultValue = DisturbUB(Backbone::VDDM::VDDMBackBoneSignalIPdu17::IemGeneric_UB,0,0,0); break;
     Case(this::SignalUBON) :
        resultValue = DisturbUB(Backbone::VDDM::VDDMBackBoneSignalIPdu17::IemGeneric_UB,0,-1,1); break;
     Default :
        resultValue = -1;
  }
  
}

on sysvar_update sysvar::VDDM::Backbone::Signals::Control::UB::IgmGeneric_UB_Control
{
  long resultValue;
  
  // --- FR ---
  setBusContext(getBusNameContext(gFR1BusName));
  switch(@this)
  {
     Case(this::SignalUBOFF) :
        resultValue = DisturbUB(Backbone::VDDM::VDDMBackBoneSignalIPdu17::IgmGeneric_UB,0,-1,0); break;
     Case(this::SignalUBHandled) :
        resultValue = DisturbUB(Backbone::VDDM::VDDMBackBoneSignalIPdu17::IgmGeneric_UB,0,0,0); break;
     Case(this::SignalUBON) :
        resultValue = DisturbUB(Backbone::VDDM::VDDMBackBoneSignalIPdu17::IgmGeneric_UB,0,-1,1); break;
     Default :
        resultValue = -1;
  }
  
}

on sysvar_update sysvar::IL_FR1::NODES::N_VDDM::EnableNode
{
  ILFR1_Enable(@this && @sysvar::IL_FR1::enable_AllNodes);
}

on sysvar_update sysvar::IL_FR1::enable_AllNodes
{
  ILFR1_Enable(@this && @sysvar::IL_FR1::NODES::N_VDDM::EnableNode);
}

on sysvar_update sysvar::NM_FR1::NODES::N_VDDM::DeactivateNM
{
  if( @this == 1 || @sysvar::NM_FR1::StateControl::DeactivateNM == 1)
  {
    NMFR1_Enable(0);
  }
  else
  {
    NMFR1_Enable(1);
  }
}

on sysvar_update sysvar::NM_FR1::StateControl::DeactivateNM
{
  if( @this == 1 || @sysvar::NM_FR1::NODES::N_VDDM::DeactivateNM == 1)
  {
    NMFR1_Enable(0);
  }
  else
  {
    NMFR1_Enable(1);
  }
}

/* #ChannelEnd# |FR1| #BusEnd# |Backbone| */
//--- end generated part --- Block end <#SysVar_Handler#> do not delete this line! Add application code below this line.

//--- begin generated part --- Block start <#MsgUpdateFcns#> do not delete this line and do not add application code in this code block!
/* #ChannelStart# |FR1| #BusStart# |Backbone| */
/* #ChannelEnd# |FR1| #BusEnd# |Backbone| */
//--- end generated part --- Block end <#MsgUpdateFcns#> do not delete this line! Add application code below this line.

