includes
{
  // Import required CAPL include files
  //--- begin generated part --- Block start #Hdr_Includes#; do not delete this line and do not add application code in this code block!
  /* #ChannelStart# |FR1| #BusStart# |Backbone| */
  /* #ChannelEnd# |FR1| #BusEnd# |Backbone| */
  //--- end generated part --- Block end #Hdr_Includes#; do not delete this line! Add application code below this line.
  //--- begin generated part --- Block start #Body_Includes#; do not delete this line and do not add application code in this code block!
  /* #ChannelStart# |FR1| #BusStart# |Backbone| */
  #include "..\CAPL\SPA-IL-KL30-Helper_FR1.cin"
  #include "..\CAPL\SPACommon_Common.cin"
  #include "..\Nodes\DIM_Adaptation.cin"
  #include "..\CAPL\SPA-NM-Panel-Helper_FR1.cin"
  #include "..\CAPL\SPA-NM-ASR-Helper_FR1.cin"
  /* #ChannelEnd# |FR1| #BusEnd# |Backbone| */
  //--- end generated part --- Block end #Body_Includes#; do not delete this line! Add application code below this line.
}

variables
{
  // Define global variables for this CAPL file

  /*--- #GenHeader Begin# --- begin generated comment ---
  | Generated on Tuesday, februari 20, 2018, 08:03:58
  | By ModelGenerator for SPA 1.0.0.3, ModelGeneratorSPADLL 3.1.1.0
  | Package SPA 3.0.0
  | Target Bus: Backbone; Channel: FR1; DB Cluster: Backbone;
  | From Database: SPA2610_ConfigurationsSPA_Backbone_171027.xml
  | CANoe Version 9.0.133.0
    --- #GenHeader End  # --- end generated comment --- */

  char gECU[256] = "DIM";
  //--- begin generated part --- Block start #Hdr_GlobalVariables#; do not delete this line and do not add application code in this code block!
  /* #ChannelStart# |FR1| #BusStart# |Backbone| */
  /* #ChannelEnd# |FR1| #BusEnd# |Backbone| */
  //--- end generated part --- Block end #Hdr_GlobalVariables#; do not delete this line! Add application code below this line.
  //--- begin generated part --- Block start #Body_GlobalVariables#; do not delete this line and do not add application code in this code block!
  /* #ChannelStart# |FR1| #BusStart# |Backbone| */
  char gFR1BusName[256] = "Backbone";
  int gFR1Channel = 1; //// The channel the bus is attached to
  int gFR1TXEnable = 1; //// enable/disable TX of application messages
  /* #ChannelEnd# |FR1| #BusEnd# |Backbone| */
  //--- end generated part --- Block end #Body_GlobalVariables#; do not delete this line! Add application code below this line.
}

on preStart
{
  // Initialize CAPL includes and node's modules/DLLs
  //--- begin generated part --- Block start #Hdr_OnInit#; do not delete this line and do not add application code in this code block!
  /* #ChannelStart# |FR1| #BusStart# |Backbone| */
  /* #ChannelEnd# |FR1| #BusEnd# |Backbone| */
  //--- end generated part --- Block end #Hdr_OnInit#; do not delete this line! Add application code below this line.
  //--- begin generated part --- Block start #Body_OnInit#; do not delete this line and do not add application code in this code block!
  /* #ChannelStart# |FR1| #BusStart# |Backbone| */
  ILFR1_OnInit();
  NMFR1_OnInit();
  /* #ChannelEnd# |FR1| #BusEnd# |Backbone| */
  //--- end generated part --- Block end #Body_OnInit#; do not delete this line! Add application code below this line.
}

on start
{
  // Start CAPL includes and node's modules/DLLs
  //--- begin generated part --- Block start #Hdr_OnStart#; do not delete this line and do not add application code in this code block!
  /* #ChannelStart# |FR1| #BusStart# |Backbone| */
  /* #ChannelEnd# |FR1| #BusEnd# |Backbone| */
  //--- end generated part --- Block end #Hdr_OnStart#; do not delete this line! Add application code below this line.
  //--- begin generated part --- Block start #Body_OnStart#; do not delete this line and do not add application code in this code block!
  /* #ChannelStart# |FR1| #BusStart# |Backbone| */
  ILFR1_OnStart();
  NMFR1_OnStart();
  /* #ChannelEnd# |FR1| #BusEnd# |Backbone| */
  //--- end generated part --- Block end #Body_OnStart#; do not delete this line! Add application code below this line.
}

on FrPOCState
{
  // Possibly propagate FlexRay POC state of interface to the FlexRay bus control
  //--- begin generated part --- Block start #Hdr_OnFrPOCState#; do not delete this line and do not add application code in this code block!
  /* #ChannelStart# |FR1| #BusStart# |Backbone| */
  /* #ChannelEnd# |FR1| #BusEnd# |Backbone| */
  //--- end generated part --- Block end #Hdr_OnFrPOCState#; do not delete this line! Add application code below this line.
  //--- begin generated part --- Block start #Body_OnFrPOCState#; do not delete this line and do not add application code in this code block!
  /* #ChannelStart# |FR1| #BusStart# |Backbone| */
  NMPFR1_ObservePOCState(this.MsgChannel, this.FR_POCState, this.FR_Info2);
  /* #ChannelEnd# |FR1| #BusEnd# |Backbone| */
  //--- end generated part --- Block end #Body_OnFrPOCState#; do not delete this line! Add application code below this line.
}

on FrSymbol
{
  // Possibly propagate FlexRay symbol reception to the FlexRay bus control
  //--- begin generated part --- Block start #Hdr_OnFrSymbol#; do not delete this line and do not add application code in this code block!
  /* #ChannelStart# |FR1| #BusStart# |Backbone| */
  /* #ChannelEnd# |FR1| #BusEnd# |Backbone| */
  //--- end generated part --- Block end #Hdr_OnFrSymbol#; do not delete this line! Add application code below this line.
  //--- begin generated part --- Block start #Body_OnFrSymbol#; do not delete this line and do not add application code in this code block!
  /* #ChannelStart# |FR1| #BusStart# |Backbone| */
  NMPFR1_ObserveSymbol(this.MsgChannel, this.FR_Symbol, this.FR_ChannelMask, this.FR_Length, this.FR_Cycle);
  /* #ChannelEnd# |FR1| #BusEnd# |Backbone| */
  //--- end generated part --- Block end #Body_OnFrSymbol#; do not delete this line! Add application code below this line.
}

on FRFrameError *
{
  // Possibly propagate FlexRay erroneous frame reception to the FlexRay bus control
  //--- begin generated part --- Block start #Hdr_OnFrFrameError#; do not delete this line and do not add application code in this code block!
  /* #ChannelStart# |FR1| #BusStart# |Backbone| */
  /* #ChannelEnd# |FR1| #BusEnd# |Backbone| */
  //--- end generated part --- Block end #Hdr_OnFrFrameError#; do not delete this line! Add application code below this line.
  //--- begin generated part --- Block start #Body_OnFrFrameError#; do not delete this line and do not add application code in this code block!
  /* #ChannelStart# |FR1| #BusStart# |Backbone| */
  NMPFR1_ObserveFrameError(this.MsgChannel, this.FR_ChannelMask, this.FR_SlotID, this.FR_Cycle, this.FR_Status);
  /* #ChannelEnd# |FR1| #BusEnd# |Backbone| */
  //--- end generated part --- Block end #Body_OnFrFrameError#; do not delete this line! Add application code below this line.
}

on preStop
{
  // Prepare stopping
  //--- begin generated part --- Block start #Hdr_OnStopping#; do not delete this line and do not add application code in this code block!
  /* #ChannelStart# |FR1| #BusStart# |Backbone| */
  /* #ChannelEnd# |FR1| #BusEnd# |Backbone| */
  //--- end generated part --- Block end #Hdr_OnStopping#; do not delete this line! Add application code below this line.
  //--- begin generated part --- Block start #Body_OnStopping#; do not delete this line and do not add application code in this code block!
  /* #ChannelStart# |FR1| #BusStart# |Backbone| */
  /* #ChannelEnd# |FR1| #BusEnd# |Backbone| */
  //--- end generated part --- Block end #Body_OnStopping#; do not delete this line! Add application code below this line.
}

on stopMeasurement
{
  // Stop actions
  //--- begin generated part --- Block start #Hdr_OnStop#; do not delete this line and do not add application code in this code block!
  /* #ChannelStart# |FR1| #BusStart# |Backbone| */
  /* #ChannelEnd# |FR1| #BusEnd# |Backbone| */
  //--- end generated part --- Block end #Hdr_OnStop#; do not delete this line! Add application code below this line.
  //--- begin generated part --- Block start #Body_OnStop#; do not delete this line and do not add application code in this code block!
  /* #ChannelStart# |FR1| #BusStart# |Backbone| */
  /* #ChannelEnd# |FR1| #BusEnd# |Backbone| */
  //--- end generated part --- Block end #Body_OnStop#; do not delete this line! Add application code below this line.
}

on sysvar_update sysvar::IL::Ignition
{
  // Handle system state variable
  //--- begin generated part --- Block start #Hdr_KL15_Ignition#; do not delete this line and do not add application code in this code block!
  /* #ChannelStart# |FR1| #BusStart# |Backbone| */
  /* #ChannelEnd# |FR1| #BusEnd# |Backbone| */
  //--- end generated part --- Block end #Hdr_KL15_Ignition#; do not delete this line! Add application code below this line.
  //--- begin generated part --- Block start #Body_KL15_Ignition#; do not delete this line and do not add application code in this code block!
  /* #ChannelStart# |FR1| #BusStart# |Backbone| */
  ILFR1_OnEnvClamp15(@this);
  /* #ChannelEnd# |FR1| #BusEnd# |Backbone| */
  //--- end generated part --- Block end #Body_KL15_Ignition#; do not delete this line! Add application code below this line.
}

on sysvar_update sysvar::IL::Power
{
  // Handle system state variable
  //--- begin generated part --- Block start #Hdr_KL30_Power#; do not delete this line and do not add application code in this code block!
  /* #ChannelStart# |FR1| #BusStart# |Backbone| */
  /* #ChannelEnd# |FR1| #BusEnd# |Backbone| */
  //--- end generated part --- Block end #Hdr_KL30_Power#; do not delete this line! Add application code below this line.
  //--- begin generated part --- Block start #Body_KL30_Power#; do not delete this line and do not add application code in this code block!
  /* #ChannelStart# |FR1| #BusStart# |Backbone| */
  ILFR1_OnEnvClamp30(@this);
  /* #ChannelEnd# |FR1| #BusEnd# |Backbone| */
  //--- end generated part --- Block end #Body_KL30_Power#; do not delete this line! Add application code below this line.
}

on sysvar_update sysvar::_SPAInternal::VIN::VinBlk
{
  //--- begin generated part --- Block start #Hdr_aModulesSignal_VinBlk_VinBlk#; do not delete this line and do not add application code in this code block!
  /* #ChannelStart# |FR1| #BusStart# |Backbone| */
  /* #ChannelEnd# |FR1| #BusEnd# |Backbone| */
  //--- end generated part --- Block end #Hdr_aModulesSignal_VinBlk_VinBlk#; do not delete this line! Add application code below this line.
  //--- begin generated part --- Block start #Body_aModulesSignal_VinBlk_VinBlk#; do not delete this line and do not add application code in this code block!
  /* #ChannelStart# |FR1| #BusStart# |Backbone| */
  /* #ChannelEnd# |FR1| #BusEnd# |Backbone| */
  //--- end generated part --- Block end #Body_aModulesSignal_VinBlk_VinBlk#; do not delete this line! Add application code below this line.
}

on sysvar_update sysvar::_SPAInternal::VIN::VinPosn1
{
  //--- begin generated part --- Block start #Hdr_aModulesSignal_VinPosn1_VinPosn1#; do not delete this line and do not add application code in this code block!
  /* #ChannelStart# |FR1| #BusStart# |Backbone| */
  /* #ChannelEnd# |FR1| #BusEnd# |Backbone| */
  //--- end generated part --- Block end #Hdr_aModulesSignal_VinPosn1_VinPosn1#; do not delete this line! Add application code below this line.
  //--- begin generated part --- Block start #Body_aModulesSignal_VinPosn1_VinPosn1#; do not delete this line and do not add application code in this code block!
  /* #ChannelStart# |FR1| #BusStart# |Backbone| */
  /* #ChannelEnd# |FR1| #BusEnd# |Backbone| */
  //--- end generated part --- Block end #Body_aModulesSignal_VinPosn1_VinPosn1#; do not delete this line! Add application code below this line.
}

on sysvar_update sysvar::_SPAInternal::VIN::VinPosn2
{
  //--- begin generated part --- Block start #Hdr_aModulesSignal_VinPosn2_VinPosn2#; do not delete this line and do not add application code in this code block!
  /* #ChannelStart# |FR1| #BusStart# |Backbone| */
  /* #ChannelEnd# |FR1| #BusEnd# |Backbone| */
  //--- end generated part --- Block end #Hdr_aModulesSignal_VinPosn2_VinPosn2#; do not delete this line! Add application code below this line.
  //--- begin generated part --- Block start #Body_aModulesSignal_VinPosn2_VinPosn2#; do not delete this line and do not add application code in this code block!
  /* #ChannelStart# |FR1| #BusStart# |Backbone| */
  /* #ChannelEnd# |FR1| #BusEnd# |Backbone| */
  //--- end generated part --- Block end #Body_aModulesSignal_VinPosn2_VinPosn2#; do not delete this line! Add application code below this line.
}

on sysvar_update sysvar::_SPAInternal::VIN::VinPosn3
{
  //--- begin generated part --- Block start #Hdr_aModulesSignal_VinPosn3_VinPosn3#; do not delete this line and do not add application code in this code block!
  /* #ChannelStart# |FR1| #BusStart# |Backbone| */
  /* #ChannelEnd# |FR1| #BusEnd# |Backbone| */
  //--- end generated part --- Block end #Hdr_aModulesSignal_VinPosn3_VinPosn3#; do not delete this line! Add application code below this line.
  //--- begin generated part --- Block start #Body_aModulesSignal_VinPosn3_VinPosn3#; do not delete this line and do not add application code in this code block!
  /* #ChannelStart# |FR1| #BusStart# |Backbone| */
  /* #ChannelEnd# |FR1| #BusEnd# |Backbone| */
  //--- end generated part --- Block end #Body_aModulesSignal_VinPosn3_VinPosn3#; do not delete this line! Add application code below this line.
}

on sysvar_update sysvar::_SPAInternal::VIN::VinPosn4
{
  //--- begin generated part --- Block start #Hdr_aModulesSignal_VinPosn4_VinPosn4#; do not delete this line and do not add application code in this code block!
  /* #ChannelStart# |FR1| #BusStart# |Backbone| */
  /* #ChannelEnd# |FR1| #BusEnd# |Backbone| */
  //--- end generated part --- Block end #Hdr_aModulesSignal_VinPosn4_VinPosn4#; do not delete this line! Add application code below this line.
  //--- begin generated part --- Block start #Body_aModulesSignal_VinPosn4_VinPosn4#; do not delete this line and do not add application code in this code block!
  /* #ChannelStart# |FR1| #BusStart# |Backbone| */
  /* #ChannelEnd# |FR1| #BusEnd# |Backbone| */
  //--- end generated part --- Block end #Body_aModulesSignal_VinPosn4_VinPosn4#; do not delete this line! Add application code below this line.
}

on sysvar_update sysvar::_SPAInternal::VIN::VinPosn5
{
  //--- begin generated part --- Block start #Hdr_aModulesSignal_VinPosn5_VinPosn5#; do not delete this line and do not add application code in this code block!
  /* #ChannelStart# |FR1| #BusStart# |Backbone| */
  /* #ChannelEnd# |FR1| #BusEnd# |Backbone| */
  //--- end generated part --- Block end #Hdr_aModulesSignal_VinPosn5_VinPosn5#; do not delete this line! Add application code below this line.
  //--- begin generated part --- Block start #Body_aModulesSignal_VinPosn5_VinPosn5#; do not delete this line and do not add application code in this code block!
  /* #ChannelStart# |FR1| #BusStart# |Backbone| */
  /* #ChannelEnd# |FR1| #BusEnd# |Backbone| */
  //--- end generated part --- Block end #Body_aModulesSignal_VinPosn5_VinPosn5#; do not delete this line! Add application code below this line.
}

on sysvar_update sysvar::_SPAInternal::VIN::VinPosn6
{
  //--- begin generated part --- Block start #Hdr_aModulesSignal_VinPosn6_VinPosn6#; do not delete this line and do not add application code in this code block!
  /* #ChannelStart# |FR1| #BusStart# |Backbone| */
  /* #ChannelEnd# |FR1| #BusEnd# |Backbone| */
  //--- end generated part --- Block end #Hdr_aModulesSignal_VinPosn6_VinPosn6#; do not delete this line! Add application code below this line.
  //--- begin generated part --- Block start #Body_aModulesSignal_VinPosn6_VinPosn6#; do not delete this line and do not add application code in this code block!
  /* #ChannelStart# |FR1| #BusStart# |Backbone| */
  /* #ChannelEnd# |FR1| #BusEnd# |Backbone| */
  //--- end generated part --- Block end #Body_aModulesSignal_VinPosn6_VinPosn6#; do not delete this line! Add application code below this line.
}

on sysvar_update sysvar::_SPAInternal::VIN::VinPosn7
{
  //--- begin generated part --- Block start #Hdr_aModulesSignal_VinPosn7_VinPosn7#; do not delete this line and do not add application code in this code block!
  /* #ChannelStart# |FR1| #BusStart# |Backbone| */
  /* #ChannelEnd# |FR1| #BusEnd# |Backbone| */
  //--- end generated part --- Block end #Hdr_aModulesSignal_VinPosn7_VinPosn7#; do not delete this line! Add application code below this line.
  //--- begin generated part --- Block start #Body_aModulesSignal_VinPosn7_VinPosn7#; do not delete this line and do not add application code in this code block!
  /* #ChannelStart# |FR1| #BusStart# |Backbone| */
  /* #ChannelEnd# |FR1| #BusEnd# |Backbone| */
  //--- end generated part --- Block end #Body_aModulesSignal_VinPosn7_VinPosn7#; do not delete this line! Add application code below this line.
}

on sysvar_update sysvar::_SPAInternal::CarConfig::VehCfgPrmBlk
{
  //--- begin generated part --- Block start #Hdr_aModulesSignal_VehCfgPrmBlk_VehCfgPrmBlk#; do not delete this line and do not add application code in this code block!
  /* #ChannelStart# |FR1| #BusStart# |Backbone| */
  /* #ChannelEnd# |FR1| #BusEnd# |Backbone| */
  //--- end generated part --- Block end #Hdr_aModulesSignal_VehCfgPrmBlk_VehCfgPrmBlk#; do not delete this line! Add application code below this line.
  //--- begin generated part --- Block start #Body_aModulesSignal_VehCfgPrmBlk_VehCfgPrmBlk#; do not delete this line and do not add application code in this code block!
  /* #ChannelStart# |FR1| #BusStart# |Backbone| */
  /* #ChannelEnd# |FR1| #BusEnd# |Backbone| */
  //--- end generated part --- Block end #Body_aModulesSignal_VehCfgPrmBlk_VehCfgPrmBlk#; do not delete this line! Add application code below this line.
}

on sysvar_update sysvar::_SPAInternal::CarConfig::VehCfgPrmVal1
{
  //--- begin generated part --- Block start #Hdr_aModulesSignal_VehCfgPrmVal1_VehCfgPrmVal1#; do not delete this line and do not add application code in this code block!
  /* #ChannelStart# |FR1| #BusStart# |Backbone| */
  /* #ChannelEnd# |FR1| #BusEnd# |Backbone| */
  //--- end generated part --- Block end #Hdr_aModulesSignal_VehCfgPrmVal1_VehCfgPrmVal1#; do not delete this line! Add application code below this line.
  //--- begin generated part --- Block start #Body_aModulesSignal_VehCfgPrmVal1_VehCfgPrmVal1#; do not delete this line and do not add application code in this code block!
  /* #ChannelStart# |FR1| #BusStart# |Backbone| */
  /* #ChannelEnd# |FR1| #BusEnd# |Backbone| */
  //--- end generated part --- Block end #Body_aModulesSignal_VehCfgPrmVal1_VehCfgPrmVal1#; do not delete this line! Add application code below this line.
}

on sysvar_update sysvar::_SPAInternal::CarConfig::VehCfgPrmVal2
{
  //--- begin generated part --- Block start #Hdr_aModulesSignal_VehCfgPrmVal2_VehCfgPrmVal2#; do not delete this line and do not add application code in this code block!
  /* #ChannelStart# |FR1| #BusStart# |Backbone| */
  /* #ChannelEnd# |FR1| #BusEnd# |Backbone| */
  //--- end generated part --- Block end #Hdr_aModulesSignal_VehCfgPrmVal2_VehCfgPrmVal2#; do not delete this line! Add application code below this line.
  //--- begin generated part --- Block start #Body_aModulesSignal_VehCfgPrmVal2_VehCfgPrmVal2#; do not delete this line and do not add application code in this code block!
  /* #ChannelStart# |FR1| #BusStart# |Backbone| */
  /* #ChannelEnd# |FR1| #BusEnd# |Backbone| */
  //--- end generated part --- Block end #Body_aModulesSignal_VehCfgPrmVal2_VehCfgPrmVal2#; do not delete this line! Add application code below this line.
}

on sysvar_update sysvar::_SPAInternal::CarConfig::VehCfgPrmVal3
{
  //--- begin generated part --- Block start #Hdr_aModulesSignal_VehCfgPrmVal3_VehCfgPrmVal3#; do not delete this line and do not add application code in this code block!
  /* #ChannelStart# |FR1| #BusStart# |Backbone| */
  /* #ChannelEnd# |FR1| #BusEnd# |Backbone| */
  //--- end generated part --- Block end #Hdr_aModulesSignal_VehCfgPrmVal3_VehCfgPrmVal3#; do not delete this line! Add application code below this line.
  //--- begin generated part --- Block start #Body_aModulesSignal_VehCfgPrmVal3_VehCfgPrmVal3#; do not delete this line and do not add application code in this code block!
  /* #ChannelStart# |FR1| #BusStart# |Backbone| */
  /* #ChannelEnd# |FR1| #BusEnd# |Backbone| */
  //--- end generated part --- Block end #Body_aModulesSignal_VehCfgPrmVal3_VehCfgPrmVal3#; do not delete this line! Add application code below this line.
}

on sysvar_update sysvar::_SPAInternal::CarConfig::VehCfgPrmVal4
{
  //--- begin generated part --- Block start #Hdr_aModulesSignal_VehCfgPrmVal4_VehCfgPrmVal4#; do not delete this line and do not add application code in this code block!
  /* #ChannelStart# |FR1| #BusStart# |Backbone| */
  /* #ChannelEnd# |FR1| #BusEnd# |Backbone| */
  //--- end generated part --- Block end #Hdr_aModulesSignal_VehCfgPrmVal4_VehCfgPrmVal4#; do not delete this line! Add application code below this line.
  //--- begin generated part --- Block start #Body_aModulesSignal_VehCfgPrmVal4_VehCfgPrmVal4#; do not delete this line and do not add application code in this code block!
  /* #ChannelStart# |FR1| #BusStart# |Backbone| */
  /* #ChannelEnd# |FR1| #BusEnd# |Backbone| */
  //--- end generated part --- Block end #Body_aModulesSignal_VehCfgPrmVal4_VehCfgPrmVal4#; do not delete this line! Add application code below this line.
}

on sysvar_update sysvar::_SPAInternal::CarConfig::VehCfgPrmVal5
{
  //--- begin generated part --- Block start #Hdr_aModulesSignal_VehCfgPrmVal5_VehCfgPrmVal5#; do not delete this line and do not add application code in this code block!
  /* #ChannelStart# |FR1| #BusStart# |Backbone| */
  /* #ChannelEnd# |FR1| #BusEnd# |Backbone| */
  //--- end generated part --- Block end #Hdr_aModulesSignal_VehCfgPrmVal5_VehCfgPrmVal5#; do not delete this line! Add application code below this line.
  //--- begin generated part --- Block start #Body_aModulesSignal_VehCfgPrmVal5_VehCfgPrmVal5#; do not delete this line and do not add application code in this code block!
  /* #ChannelStart# |FR1| #BusStart# |Backbone| */
  /* #ChannelEnd# |FR1| #BusEnd# |Backbone| */
  //--- end generated part --- Block end #Body_aModulesSignal_VehCfgPrmVal5_VehCfgPrmVal5#; do not delete this line! Add application code below this line.
}

on sysvar_update sysvar::_SPAInternal::CarConfig::VehCfgPrmVal6
{
  //--- begin generated part --- Block start #Hdr_aModulesSignal_VehCfgPrmVal6_VehCfgPrmVal6#; do not delete this line and do not add application code in this code block!
  /* #ChannelStart# |FR1| #BusStart# |Backbone| */
  /* #ChannelEnd# |FR1| #BusEnd# |Backbone| */
  //--- end generated part --- Block end #Hdr_aModulesSignal_VehCfgPrmVal6_VehCfgPrmVal6#; do not delete this line! Add application code below this line.
  //--- begin generated part --- Block start #Body_aModulesSignal_VehCfgPrmVal6_VehCfgPrmVal6#; do not delete this line and do not add application code in this code block!
  /* #ChannelStart# |FR1| #BusStart# |Backbone| */
  /* #ChannelEnd# |FR1| #BusEnd# |Backbone| */
  //--- end generated part --- Block end #Body_aModulesSignal_VehCfgPrmVal6_VehCfgPrmVal6#; do not delete this line! Add application code below this line.
}

on sysvar_update sysvar::_SPAInternal::CarConfig::VehCfgPrmVal7
{
  //--- begin generated part --- Block start #Hdr_aModulesSignal_VehCfgPrmVal7_VehCfgPrmVal7#; do not delete this line and do not add application code in this code block!
  /* #ChannelStart# |FR1| #BusStart# |Backbone| */
  /* #ChannelEnd# |FR1| #BusEnd# |Backbone| */
  //--- end generated part --- Block end #Hdr_aModulesSignal_VehCfgPrmVal7_VehCfgPrmVal7#; do not delete this line! Add application code below this line.
  //--- begin generated part --- Block start #Body_aModulesSignal_VehCfgPrmVal7_VehCfgPrmVal7#; do not delete this line and do not add application code in this code block!
  /* #ChannelStart# |FR1| #BusStart# |Backbone| */
  /* #ChannelEnd# |FR1| #BusEnd# |Backbone| */
  //--- end generated part --- Block end #Body_aModulesSignal_VehCfgPrmVal7_VehCfgPrmVal7#; do not delete this line! Add application code below this line.
}

on sysvar_update sysvar::_SPAInternal::CarTiGlb::CarTiGlbValue
{
  //--- begin generated part --- Block start #Hdr_aModulesSignal_CarTiGlb_CarTiGlbValue#; do not delete this line and do not add application code in this code block!
  /* #ChannelStart# |FR1| #BusStart# |Backbone| */
  /* #ChannelEnd# |FR1| #BusEnd# |Backbone| */
  //--- end generated part --- Block end #Hdr_aModulesSignal_CarTiGlb_CarTiGlbValue#; do not delete this line! Add application code below this line.
  //--- begin generated part --- Block start #Body_aModulesSignal_CarTiGlb_CarTiGlbValue#; do not delete this line and do not add application code in this code block!
  /* #ChannelStart# |FR1| #BusStart# |Backbone| */
  /* #ChannelEnd# |FR1| #BusEnd# |Backbone| */
  //--- end generated part --- Block end #Body_aModulesSignal_CarTiGlb_CarTiGlbValue#; do not delete this line! Add application code below this line.
}

on sysvar_update sysvar::_SPACommon::GParVehBattU::VehBattUSysU
{
  //--- begin generated part --- Block start #Hdr_aModulesSignal_VehBattUSysU_VehBattUSysU#; do not delete this line and do not add application code in this code block!
  /* #ChannelStart# |FR1| #BusStart# |Backbone| */
  /* #ChannelEnd# |FR1| #BusEnd# |Backbone| */
  //--- end generated part --- Block end #Hdr_aModulesSignal_VehBattUSysU_VehBattUSysU#; do not delete this line! Add application code below this line.
  //--- begin generated part --- Block start #Body_aModulesSignal_VehBattUSysU_VehBattUSysU#; do not delete this line and do not add application code in this code block!
  /* #ChannelStart# |FR1| #BusStart# |Backbone| */
  /* #ChannelEnd# |FR1| #BusEnd# |Backbone| */
  //--- end generated part --- Block end #Body_aModulesSignal_VehBattUSysU_VehBattUSysU#; do not delete this line! Add application code below this line.
}

on sysvar_update sysvar::_SPACommon::GParTiAndDate::Yr
{
  //--- begin generated part --- Block start #Hdr_aModulesSignal_Yr_Yr#; do not delete this line and do not add application code in this code block!
  /* #ChannelStart# |FR1| #BusStart# |Backbone| */
  /* #ChannelEnd# |FR1| #BusEnd# |Backbone| */
  //--- end generated part --- Block end #Hdr_aModulesSignal_Yr_Yr#; do not delete this line! Add application code below this line.
  //--- begin generated part --- Block start #Body_aModulesSignal_Yr_Yr#; do not delete this line and do not add application code in this code block!
  /* #ChannelStart# |FR1| #BusStart# |Backbone| */
  /* #ChannelEnd# |FR1| #BusEnd# |Backbone| */
  //--- end generated part --- Block end #Body_aModulesSignal_Yr_Yr#; do not delete this line! Add application code below this line.
}

on sysvar_update sysvar::_SPACommon::GParTiAndDate::Mth
{
  //--- begin generated part --- Block start #Hdr_aModulesSignal_Mth_Mth#; do not delete this line and do not add application code in this code block!
  /* #ChannelStart# |FR1| #BusStart# |Backbone| */
  /* #ChannelEnd# |FR1| #BusEnd# |Backbone| */
  //--- end generated part --- Block end #Hdr_aModulesSignal_Mth_Mth#; do not delete this line! Add application code below this line.
  //--- begin generated part --- Block start #Body_aModulesSignal_Mth_Mth#; do not delete this line and do not add application code in this code block!
  /* #ChannelStart# |FR1| #BusStart# |Backbone| */
  /* #ChannelEnd# |FR1| #BusEnd# |Backbone| */
  //--- end generated part --- Block end #Body_aModulesSignal_Mth_Mth#; do not delete this line! Add application code below this line.
}

on sysvar_update sysvar::_SPACommon::GParTiAndDate::Day
{
  //--- begin generated part --- Block start #Hdr_aModulesSignal_Day_Day#; do not delete this line and do not add application code in this code block!
  /* #ChannelStart# |FR1| #BusStart# |Backbone| */
  /* #ChannelEnd# |FR1| #BusEnd# |Backbone| */
  //--- end generated part --- Block end #Hdr_aModulesSignal_Day_Day#; do not delete this line! Add application code below this line.
  //--- begin generated part --- Block start #Body_aModulesSignal_Day_Day#; do not delete this line and do not add application code in this code block!
  /* #ChannelStart# |FR1| #BusStart# |Backbone| */
  /* #ChannelEnd# |FR1| #BusEnd# |Backbone| */
  //--- end generated part --- Block end #Body_aModulesSignal_Day_Day#; do not delete this line! Add application code below this line.
}

on sysvar_update sysvar::_SPACommon::GParTiAndDate::Hr
{
  //--- begin generated part --- Block start #Hdr_aModulesSignal_Hr_Hr#; do not delete this line and do not add application code in this code block!
  /* #ChannelStart# |FR1| #BusStart# |Backbone| */
  /* #ChannelEnd# |FR1| #BusEnd# |Backbone| */
  //--- end generated part --- Block end #Hdr_aModulesSignal_Hr_Hr#; do not delete this line! Add application code below this line.
  //--- begin generated part --- Block start #Body_aModulesSignal_Hr_Hr#; do not delete this line and do not add application code in this code block!
  /* #ChannelStart# |FR1| #BusStart# |Backbone| */
  /* #ChannelEnd# |FR1| #BusEnd# |Backbone| */
  //--- end generated part --- Block end #Body_aModulesSignal_Hr_Hr#; do not delete this line! Add application code below this line.
}

on sysvar_update sysvar::_SPACommon::GParTiAndDate::Mins
{
  //--- begin generated part --- Block start #Hdr_aModulesSignal_Mins_Mins#; do not delete this line and do not add application code in this code block!
  /* #ChannelStart# |FR1| #BusStart# |Backbone| */
  /* #ChannelEnd# |FR1| #BusEnd# |Backbone| */
  //--- end generated part --- Block end #Hdr_aModulesSignal_Mins_Mins#; do not delete this line! Add application code below this line.
  //--- begin generated part --- Block start #Body_aModulesSignal_Mins_Mins#; do not delete this line and do not add application code in this code block!
  /* #ChannelStart# |FR1| #BusStart# |Backbone| */
  /* #ChannelEnd# |FR1| #BusEnd# |Backbone| */
  //--- end generated part --- Block end #Body_aModulesSignal_Mins_Mins#; do not delete this line! Add application code below this line.
}

on sysvar_update sysvar::_SPACommon::GParTiAndDate::Sec
{
  //--- begin generated part --- Block start #Hdr_aModulesSignal_Sec_Sec#; do not delete this line and do not add application code in this code block!
  /* #ChannelStart# |FR1| #BusStart# |Backbone| */
  /* #ChannelEnd# |FR1| #BusEnd# |Backbone| */
  //--- end generated part --- Block end #Hdr_aModulesSignal_Sec_Sec#; do not delete this line! Add application code below this line.
  //--- begin generated part --- Block start #Body_aModulesSignal_Sec_Sec#; do not delete this line and do not add application code in this code block!
  /* #ChannelStart# |FR1| #BusStart# |Backbone| */
  /* #ChannelEnd# |FR1| #BusEnd# |Backbone| */
  //--- end generated part --- Block end #Body_aModulesSignal_Sec_Sec#; do not delete this line! Add application code below this line.
}

on sysvar_update sysvar::_SPACommon::GParTiAndDate::TiAndDateVld
{
  //--- begin generated part --- Block start #Hdr_aModulesSignal_TiAndDateVld_TiAndDateVld#; do not delete this line and do not add application code in this code block!
  /* #ChannelStart# |FR1| #BusStart# |Backbone| */
  /* #ChannelEnd# |FR1| #BusEnd# |Backbone| */
  //--- end generated part --- Block end #Hdr_aModulesSignal_TiAndDateVld_TiAndDateVld#; do not delete this line! Add application code below this line.
  //--- begin generated part --- Block start #Body_aModulesSignal_TiAndDateVld_TiAndDateVld#; do not delete this line and do not add application code in this code block!
  /* #ChannelStart# |FR1| #BusStart# |Backbone| */
  /* #ChannelEnd# |FR1| #BusEnd# |Backbone| */
  //--- end generated part --- Block end #Body_aModulesSignal_TiAndDateVld_TiAndDateVld#; do not delete this line! Add application code below this line.
}

on sysvar_update sysvar::IL::UBPlugNPlay
{
  // Handle system state variable
  //--- begin generated part --- Block start #Hdr_UBOpMode_UBPlugNPlay#; do not delete this line and do not add application code in this code block!
  /* #ChannelStart# |FR1| #BusStart# |Backbone| */
  /* #ChannelEnd# |FR1| #BusEnd# |Backbone| */
  //--- end generated part --- Block end #Hdr_UBOpMode_UBPlugNPlay#; do not delete this line! Add application code below this line.
  //--- begin generated part --- Block start #Body_UBOpMode_UBPlugNPlay#; do not delete this line and do not add application code in this code block!
  /* #ChannelStart# |FR1| #BusStart# |Backbone| */
  /* #ChannelEnd# |FR1| #BusEnd# |Backbone| */
  //--- end generated part --- Block end #Body_UBOpMode_UBPlugNPlay#; do not delete this line! Add application code below this line.
}

void Nm_NetworkStartInd()
{
  // Callback of CAN AUTOSAR NM DLL
  dword lBusContext;
  //--- begin generated part --- Block start #Hdr_Nm_NetworkStartInd#; do not delete this line and do not add application code in this code block!
  /* #ChannelStart# |FR1| #BusStart# |Backbone| */
  /* #ChannelEnd# |FR1| #BusEnd# |Backbone| */
  //--- end generated part --- Block end #Hdr_Nm_NetworkStartInd#; do not delete this line! Add application code below this line.
  lBusContext = GetBusContext();
  //--- begin generated part --- Block start #Body_Nm_NetworkStartInd#; do not delete this line and do not add application code in this code block!
  /* #ChannelStart# |FR1| #BusStart# |Backbone| */
  /* #ChannelEnd# |FR1| #BusEnd# |Backbone| */
  //--- end generated part --- Block end #Body_Nm_NetworkStartInd#; do not delete this line! Add application code below this line.
  SetBusContext(lBusContext);
}

void Nm_NetworkModeInd()
{
  // Callback of CAN AUTOSAR NM DLL
  dword lBusContext;
  //--- begin generated part --- Block start #Hdr_Nm_NetworkModeInd#; do not delete this line and do not add application code in this code block!
  /* #ChannelStart# |FR1| #BusStart# |Backbone| */
  /* #ChannelEnd# |FR1| #BusEnd# |Backbone| */
  //--- end generated part --- Block end #Hdr_Nm_NetworkModeInd#; do not delete this line! Add application code below this line.
  lBusContext = GetBusContext();
  //--- begin generated part --- Block start #Body_Nm_NetworkModeInd#; do not delete this line and do not add application code in this code block!
  /* #ChannelStart# |FR1| #BusStart# |Backbone| */
  /* #ChannelEnd# |FR1| #BusEnd# |Backbone| */
  //--- end generated part --- Block end #Body_Nm_NetworkModeInd#; do not delete this line! Add application code below this line.
  SetBusContext(lBusContext);
}

void Nm_NetworkTimeoutInd()
{
  // Callback of CAN AUTOSAR NM DLL
  dword lBusContext;
  //--- begin generated part --- Block start #Hdr_Nm_NetworkTimeoutInd#; do not delete this line and do not add application code in this code block!
  /* #ChannelStart# |FR1| #BusStart# |Backbone| */
  /* #ChannelEnd# |FR1| #BusEnd# |Backbone| */
  //--- end generated part --- Block end #Hdr_Nm_NetworkTimeoutInd#; do not delete this line! Add application code below this line.
  lBusContext = GetBusContext();
  //--- begin generated part --- Block start #Body_Nm_NetworkTimeoutInd#; do not delete this line and do not add application code in this code block!
  /* #ChannelStart# |FR1| #BusStart# |Backbone| */
  /* #ChannelEnd# |FR1| #BusEnd# |Backbone| */
  //--- end generated part --- Block end #Body_Nm_NetworkTimeoutInd#; do not delete this line! Add application code below this line.
  SetBusContext(lBusContext);
}

void Nm_PrepareBusSleepModeInd()
{
  // Callback of CAN AUTOSAR NM DLL
  dword lBusContext;
  //--- begin generated part --- Block start #Hdr_Nm_PrepareBusSleepModeInd#; do not delete this line and do not add application code in this code block!
  /* #ChannelStart# |FR1| #BusStart# |Backbone| */
  /* #ChannelEnd# |FR1| #BusEnd# |Backbone| */
  //--- end generated part --- Block end #Hdr_Nm_PrepareBusSleepModeInd#; do not delete this line! Add application code below this line.
  lBusContext = GetBusContext();
  //--- begin generated part --- Block start #Body_Nm_PrepareBusSleepModeInd#; do not delete this line and do not add application code in this code block!
  /* #ChannelStart# |FR1| #BusStart# |Backbone| */
  /* #ChannelEnd# |FR1| #BusEnd# |Backbone| */
  //--- end generated part --- Block end #Body_Nm_PrepareBusSleepModeInd#; do not delete this line! Add application code below this line.
  SetBusContext(lBusContext);
}

void Nm_BusSleepModeInd()
{
  // Callback of CAN AUTOSAR NM DLL
  dword lBusContext;
  //--- begin generated part --- Block start #Hdr_Nm_BusSleepModeInd#; do not delete this line and do not add application code in this code block!
  /* #ChannelStart# |FR1| #BusStart# |Backbone| */
  /* #ChannelEnd# |FR1| #BusEnd# |Backbone| */
  //--- end generated part --- Block end #Hdr_Nm_BusSleepModeInd#; do not delete this line! Add application code below this line.
  lBusContext = GetBusContext();
  //--- begin generated part --- Block start #Body_Nm_BusSleepModeInd#; do not delete this line and do not add application code in this code block!
  /* #ChannelStart# |FR1| #BusStart# |Backbone| */
  /* #ChannelEnd# |FR1| #BusEnd# |Backbone| */
  //--- end generated part --- Block end #Body_Nm_BusSleepModeInd#; do not delete this line! Add application code below this line.
  SetBusContext(lBusContext);
}

void Nm_StateChangeNotification(long previousState, long currentState)
{
  // Callback of CAN AUTOSAR NM DLL
  dword lBusContext;
  //--- begin generated part --- Block start #Hdr_Nm_StateChangeNotification#; do not delete this line and do not add application code in this code block!
  /* #ChannelStart# |FR1| #BusStart# |Backbone| */
  /* #ChannelEnd# |FR1| #BusEnd# |Backbone| */
  //--- end generated part --- Block end #Hdr_Nm_StateChangeNotification#; do not delete this line! Add application code below this line.
  lBusContext = GetBusContext();
  //--- begin generated part --- Block start #Body_Nm_StateChangeNotification#; do not delete this line and do not add application code in this code block!
  /* #ChannelStart# |FR1| #BusStart# |Backbone| */
  /* #ChannelEnd# |FR1| #BusEnd# |Backbone| */
  //--- end generated part --- Block end #Body_Nm_StateChangeNotification#; do not delete this line! Add application code below this line.
  SetBusContext(lBusContext);
}

void FrNm_NetworkStartInd()
{
  // Callback of FlexRay AUTOSAR NM DLL
  dword lBusContext;
  //--- begin generated part --- Block start #Hdr_FrNm_NetworkStartInd#; do not delete this line and do not add application code in this code block!
  /* #ChannelStart# |FR1| #BusStart# |Backbone| */
  /* #ChannelEnd# |FR1| #BusEnd# |Backbone| */
  //--- end generated part --- Block end #Hdr_FrNm_NetworkStartInd#; do not delete this line! Add application code below this line.
  lBusContext = GetBusContext();
  //--- begin generated part --- Block start #Body_FrNm_NetworkStartInd#; do not delete this line and do not add application code in this code block!
  /* #ChannelStart# |FR1| #BusStart# |Backbone| */
  if (lBusContext == gNMFR1_BusContext) NMFR1_IndNetworkStart();
  /* #ChannelEnd# |FR1| #BusEnd# |Backbone| */
  //--- end generated part --- Block end #Body_FrNm_NetworkStartInd#; do not delete this line! Add application code below this line.
  SetBusContext(lBusContext);
}

void FrNm_NetworkModeInd()
{
  // Callback of FlexRay AUTOSAR NM DLL
  dword lBusContext;
  //--- begin generated part --- Block start #Hdr_FrNm_NetworkModeInd#; do not delete this line and do not add application code in this code block!
  /* #ChannelStart# |FR1| #BusStart# |Backbone| */
  /* #ChannelEnd# |FR1| #BusEnd# |Backbone| */
  //--- end generated part --- Block end #Hdr_FrNm_NetworkModeInd#; do not delete this line! Add application code below this line.
  lBusContext = GetBusContext();
  //--- begin generated part --- Block start #Body_FrNm_NetworkModeInd#; do not delete this line and do not add application code in this code block!
  /* #ChannelStart# |FR1| #BusStart# |Backbone| */
  if (lBusContext == gNMFR1_BusContext) NMFR1_IndNetworkMode();
  /* #ChannelEnd# |FR1| #BusEnd# |Backbone| */
  //--- end generated part --- Block end #Body_FrNm_NetworkModeInd#; do not delete this line! Add application code below this line.
  SetBusContext(lBusContext);
}

void FrNm_NetworkTimeoutInd()
{
  // Callback of FlexRay AUTOSAR NM DLL
  dword lBusContext;
  //--- begin generated part --- Block start #Hdr_FrNm_NetworkTimeoutInd#; do not delete this line and do not add application code in this code block!
  /* #ChannelStart# |FR1| #BusStart# |Backbone| */
  /* #ChannelEnd# |FR1| #BusEnd# |Backbone| */
  //--- end generated part --- Block end #Hdr_FrNm_NetworkTimeoutInd#; do not delete this line! Add application code below this line.
  lBusContext = GetBusContext();
  //--- begin generated part --- Block start #Body_FrNm_NetworkTimeoutInd#; do not delete this line and do not add application code in this code block!
  /* #ChannelStart# |FR1| #BusStart# |Backbone| */
  if (lBusContext == gNMFR1_BusContext) NMFR1_IndNetworkTimeout();
  /* #ChannelEnd# |FR1| #BusEnd# |Backbone| */
  //--- end generated part --- Block end #Body_FrNm_NetworkTimeoutInd#; do not delete this line! Add application code below this line.
  SetBusContext(lBusContext);
}

void FrNm_BusSleepModeInd()
{
  // Callback of FlexRay AUTOSAR NM DLL
  dword lBusContext;
  //--- begin generated part --- Block start #Hdr_FrNm_BusSleepModeInd#; do not delete this line and do not add application code in this code block!
  /* #ChannelStart# |FR1| #BusStart# |Backbone| */
  /* #ChannelEnd# |FR1| #BusEnd# |Backbone| */
  //--- end generated part --- Block end #Hdr_FrNm_BusSleepModeInd#; do not delete this line! Add application code below this line.
  lBusContext = GetBusContext();
  //--- begin generated part --- Block start #Body_FrNm_BusSleepModeInd#; do not delete this line and do not add application code in this code block!
  /* #ChannelStart# |FR1| #BusStart# |Backbone| */
  if (lBusContext == gNMFR1_BusContext) NMFR1_IndBusSleepMode();
  /* #ChannelEnd# |FR1| #BusEnd# |Backbone| */
  //--- end generated part --- Block end #Body_FrNm_BusSleepModeInd#; do not delete this line! Add application code below this line.
  SetBusContext(lBusContext);
}

void FrNm_StateChangeNotification(long previousState, long currentState)
{
  // Callback of FlexRay AUTOSAR NM DLL
  dword lBusContext;
  //--- begin generated part --- Block start #Hdr_FrNm_StateChangeNotification#; do not delete this line and do not add application code in this code block!
  /* #ChannelStart# |FR1| #BusStart# |Backbone| */
  /* #ChannelEnd# |FR1| #BusEnd# |Backbone| */
  //--- end generated part --- Block end #Hdr_FrNm_StateChangeNotification#; do not delete this line! Add application code below this line.
  lBusContext = GetBusContext();
  //--- begin generated part --- Block start #Body_FrNm_StateChangeNotification#; do not delete this line and do not add application code in this code block!
  /* #ChannelStart# |FR1| #BusStart# |Backbone| */
  if (lBusContext == gNMFR1_BusContext) NMFR1_IndStateChangeNotification(previousState, currentState);
  /* #ChannelEnd# |FR1| #BusEnd# |Backbone| */
  //--- end generated part --- Block end #Body_FrNm_StateChangeNotification#; do not delete this line! Add application code below this line.
  SetBusContext(lBusContext);
}

void FrNm_SynchronizeModeInd()
{
  // Callback of FlexRay AUTOSAR NM DLL
  dword lBusContext;
  //--- begin generated part --- Block start #Hdr_FrNm_SynchronizeModeInd#; do not delete this line and do not add application code in this code block!
  /* #ChannelStart# |FR1| #BusStart# |Backbone| */
  /* #ChannelEnd# |FR1| #BusEnd# |Backbone| */
  //--- end generated part --- Block end #Hdr_FrNm_SynchronizeModeInd#; do not delete this line! Add application code below this line.
  lBusContext = GetBusContext();
  //--- begin generated part --- Block start #Body_FrNm_SynchronizeModeInd#; do not delete this line and do not add application code in this code block!
  /* #ChannelStart# |FR1| #BusStart# |Backbone| */
  if (lBusContext == gNMFR1_BusContext) NMFR1_IndSynchronizeMode();
  /* #ChannelEnd# |FR1| #BusEnd# |Backbone| */
  //--- end generated part --- Block end #Body_FrNm_SynchronizeModeInd#; do not delete this line! Add application code below this line.
  SetBusContext(lBusContext);
}

void StartSim(dword busContext, int busActive, int mode)
{
  //--- begin generated part --- Block start #Hdr_StartSim#; do not delete this line and do not add application code in this code block!
  /* #ChannelStart# |FR1| #BusStart# |Backbone| */
  /* #ChannelEnd# |FR1| #BusEnd# |Backbone| */
  //--- end generated part --- Block end #Hdr_StartSim#; do not delete this line! Add application code below this line.
  //--- begin generated part --- Block start #Body_StartSim#; do not delete this line and do not add application code in this code block!
  /* #ChannelStart# |FR1| #BusStart# |Backbone| */
  /* #ChannelEnd# |FR1| #BusEnd# |Backbone| */
  //--- end generated part --- Block end #Body_StartSim#; do not delete this line! Add application code below this line.
}

void StopSim(dword busContext, int busActive, int mode)
{
  //--- begin generated part --- Block start #Hdr_StopSim#; do not delete this line and do not add application code in this code block!
  /* #ChannelStart# |FR1| #BusStart# |Backbone| */
  /* #ChannelEnd# |FR1| #BusEnd# |Backbone| */
  //--- end generated part --- Block end #Hdr_StopSim#; do not delete this line! Add application code below this line.
  //--- begin generated part --- Block start #Body_StopSim#; do not delete this line and do not add application code in this code block!
  /* #ChannelStart# |FR1| #BusStart# |Backbone| */
  /* #ChannelEnd# |FR1| #BusEnd# |Backbone| */
  //--- end generated part --- Block end #Body_StopSim#; do not delete this line! Add application code below this line.
}

void FrILTxPending(char pduName[], long len, byte payload[], long TxAck)
{
  //--- begin generated part --- Block start #Hdr_FrILTxPending#; do not delete this line and do not add application code in this code block!
  /* #ChannelStart# |FR1| #BusStart# |Backbone| */
  /* #ChannelEnd# |FR1| #BusEnd# |Backbone| */
  //--- end generated part --- Block end #Hdr_FrILTxPending#; do not delete this line! Add application code below this line.
  //--- begin generated part --- Block start #Body_FrILTxPending#; do not delete this line and do not add application code in this code block!
  /* #ChannelStart# |FR1| #BusStart# |Backbone| */
  /* #ChannelEnd# |FR1| #BusEnd# |Backbone| */
  //--- end generated part --- Block end #Body_FrILTxPending#; do not delete this line! Add application code below this line.
}

dword applILTxPending(long aId, dword aDlc, byte data[])
{
  dword ret = 1;
  //--- begin generated part --- Block start #Hdr_applILTxPending#; do not delete this line and do not add application code in this code block!
  /* #ChannelStart# |FR1| #BusStart# |Backbone| */
  /* #ChannelEnd# |FR1| #BusEnd# |Backbone| */
  //--- end generated part --- Block end #Hdr_applILTxPending#; do not delete this line! Add application code below this line.
  //--- begin generated part --- Block start #Body_applILTxPending#; do not delete this line and do not add application code in this code block!
  /* #ChannelStart# |FR1| #BusStart# |Backbone| */
  /* #ChannelEnd# |FR1| #BusEnd# |Backbone| */
  //--- end generated part --- Block end #Body_applILTxPending#; do not delete this line! Add application code below this line.
  return ret;
}

on sysvar_update sysvar::DIM::Common::Control::SimulationControl
{
  //--- begin generated part --- Block start #Hdr_Name_SimulationControl#; do not delete this line and do not add application code in this code block!
  /* #ChannelStart# |FR1| #BusStart# |Backbone| */
  /* #ChannelEnd# |FR1| #BusEnd# |Backbone| */
  //--- end generated part --- Block end #Hdr_Name_SimulationControl#; do not delete this line! Add application code below this line.
  //--- begin generated part --- Block start #Body_Name_SimulationControl#; do not delete this line and do not add application code in this code block!
  /* #ChannelStart# |FR1| #BusStart# |Backbone| */
  setBusContext(getBusNameContext(gFR1BusName));
  @sysvar::IL_FR1::NODES::N_DIM::EnableNode = @this;
  /* #ChannelEnd# |FR1| #BusEnd# |Backbone| */
  //--- end generated part --- Block end #Body_Name_SimulationControl#; do not delete this line! Add application code below this line.
}

on sysvar_update sysvar::DIM::Common::Control::E2EUBMode
{
  int controlValue;
  long resultValue;
  
  //--- begin generated part --- Block start #Hdr_Name_E2EUBMode#; do not delete this line and do not add application code in this code block!
  /* #ChannelStart# |FR1| #BusStart# |Backbone| */
  /* #ChannelEnd# |FR1| #BusEnd# |Backbone| */
  //--- end generated part --- Block end #Hdr_Name_E2EUBMode#; do not delete this line! Add application code below this line.
  //--- begin generated part --- Block start #Body_Name_E2EUBMode#; do not delete this line and do not add application code in this code block!
  /* #ChannelStart# |FR1| #BusStart# |Backbone| */
  controlValue = (int) @this;
  setBusContext(getBusNameContext(gFR1BusName));
  switch(controlValue)
  {
     Case(this::NodeReal) :
        resultValue = SetOperationMode(1,0); break;
     Case(this::NodePnP) :
        resultValue = SetOperationMode(1,1); break;
     Default :
        resultValue = -1;
  }
  
  /* #ChannelEnd# |FR1| #BusEnd# |Backbone| */
  //--- end generated part --- Block end #Body_Name_E2EUBMode#; do not delete this line! Add application code below this line.
}

on sysvar_update sysvar::DIM::Common::Control::UB
{
  int controlValue;
  long resultValue;
  
  //--- begin generated part --- Block start #Hdr_Name_UB#; do not delete this line and do not add application code in this code block!
  /* #ChannelStart# |FR1| #BusStart# |Backbone| */
  /* #ChannelEnd# |FR1| #BusEnd# |Backbone| */
  //--- end generated part --- Block end #Hdr_Name_UB#; do not delete this line! Add application code below this line.
  //--- begin generated part --- Block start #Body_Name_UB#; do not delete this line and do not add application code in this code block!
  /* #ChannelStart# |FR1| #BusStart# |Backbone| */
  controlValue = (int) @this;
  setBusContext(getBusNameContext(gFR1BusName));
  switch(controlValue)
  {
     Case(this::NodeUBOFF) :
        resultValue = DisturbUB(0,0,-1,0); break;
     Case(this::NodeUBHandled) :
        resultValue = DisturbUB(0,0,0,0); break;
     Case(this::NodeUBON) :
        resultValue = DisturbUB(0,0,-1,1); break;
     Default :
        resultValue = -1;
  }
  
  /* #ChannelEnd# |FR1| #BusEnd# |Backbone| */
  //--- end generated part --- Block end #Body_Name_UB#; do not delete this line! Add application code below this line.
}

//--- begin generated part --- Block start <#Helper_Functions#> do not delete this line and do not add application code in this code block!
/* #ChannelStart# |FR1| #BusStart# |Backbone| */
/* #ChannelEnd# |FR1| #BusEnd# |Backbone| */
//--- end generated part --- Block end <#Helper_Functions#> do not delete this line! Add application code below this line.

//--- begin generated part --- Block start <#SysVar_Handler#> do not delete this line and do not add application code in this code block!
/* #ChannelStart# |FR1| #BusStart# |Backbone| */
on sysvar_update sysvar::DIM::Backbone::Signals::Control::UB::VehSpdIndcd_UB_Control
{
  long resultValue;
  
  // --- FR ---
  setBusContext(getBusNameContext(gFR1BusName));
  switch(@this)
  {
     Case(this::SignalUBOFF) :
        resultValue = DisturbUB(Backbone::DIM::DIMBackBoneSignalIPdu01::VehSpdIndcd_UB,0,-1,0); break;
     Case(this::SignalUBHandled) :
        resultValue = DisturbUB(Backbone::DIM::DIMBackBoneSignalIPdu01::VehSpdIndcd_UB,0,0,0); break;
     Case(this::SignalUBON) :
        resultValue = DisturbUB(Backbone::DIM::DIMBackBoneSignalIPdu01::VehSpdIndcd_UB,0,-1,1); break;
     Default :
        resultValue = -1;
  }
  
}

on sysvar_update sysvar::DIM::Backbone::Signals::Control::UB::BltRmnTelltl_UB_Control
{
  long resultValue;
  
  // --- FR ---
  setBusContext(getBusNameContext(gFR1BusName));
  switch(@this)
  {
     Case(this::SignalUBOFF) :
        resultValue = DisturbUB(Backbone::DIM::DIMBackBoneSignalIPdu01::BltRmnTelltl_UB,0,-1,0); break;
     Case(this::SignalUBHandled) :
        resultValue = DisturbUB(Backbone::DIM::DIMBackBoneSignalIPdu01::BltRmnTelltl_UB,0,0,0); break;
     Case(this::SignalUBON) :
        resultValue = DisturbUB(Backbone::DIM::DIMBackBoneSignalIPdu01::BltRmnTelltl_UB,0,-1,1); break;
     Default :
        resultValue = -1;
  }
  
}

on sysvar_update sysvar::DIM::Backbone::Signals::Control::UB::DrvrCrsAModReq_UB_Control
{
  long resultValue;
  
  // --- FR ---
  setBusContext(getBusNameContext(gFR1BusName));
  switch(@this)
  {
     Case(this::SignalUBOFF) :
        resultValue = DisturbUB(Backbone::DIM::DIMBackBoneSignalIPdu01::DrvrCrsAModReq_UB,0,-1,0); break;
     Case(this::SignalUBHandled) :
        resultValue = DisturbUB(Backbone::DIM::DIMBackBoneSignalIPdu01::DrvrCrsAModReq_UB,0,0,0); break;
     Case(this::SignalUBON) :
        resultValue = DisturbUB(Backbone::DIM::DIMBackBoneSignalIPdu01::DrvrCrsAModReq_UB,0,-1,1); break;
     Default :
        resultValue = -1;
  }
  
}

on sysvar_update sysvar::DIM::Backbone::Signals::Control::UB::DrvrCrsCtrlFctActvReq_UB_Control
{
  long resultValue;
  
  // --- FR ---
  setBusContext(getBusNameContext(gFR1BusName));
  switch(@this)
  {
     Case(this::SignalUBOFF) :
        resultValue = DisturbUB(Backbone::DIM::DIMBackBoneSignalIPdu01::DrvrCrsCtrlFctActvReq_UB,0,-1,0); break;
     Case(this::SignalUBHandled) :
        resultValue = DisturbUB(Backbone::DIM::DIMBackBoneSignalIPdu01::DrvrCrsCtrlFctActvReq_UB,0,0,0); break;
     Case(this::SignalUBON) :
        resultValue = DisturbUB(Backbone::DIM::DIMBackBoneSignalIPdu01::DrvrCrsCtrlFctActvReq_UB,0,-1,1); break;
     Default :
        resultValue = -1;
  }
  
}

on sysvar_update sysvar::DIM::Backbone::Signals::Control::UB::DrvrCrsCtrlFctDeactvnReq_UB_Control
{
  long resultValue;
  
  // --- FR ---
  setBusContext(getBusNameContext(gFR1BusName));
  switch(@this)
  {
     Case(this::SignalUBOFF) :
        resultValue = DisturbUB(Backbone::DIM::DIMBackBoneSignalIPdu01::DrvrCrsCtrlFctDeactvnReq_UB,0,-1,0); break;
     Case(this::SignalUBHandled) :
        resultValue = DisturbUB(Backbone::DIM::DIMBackBoneSignalIPdu01::DrvrCrsCtrlFctDeactvnReq_UB,0,0,0); break;
     Case(this::SignalUBON) :
        resultValue = DisturbUB(Backbone::DIM::DIMBackBoneSignalIPdu01::DrvrCrsCtrlFctDeactvnReq_UB,0,-1,1); break;
     Default :
        resultValue = -1;
  }
  
}

on sysvar_update sysvar::DIM::Backbone::Signals::Control::UB::DrvrCrsCtrlFctSeld_UB_Control
{
  long resultValue;
  
  // --- FR ---
  setBusContext(getBusNameContext(gFR1BusName));
  switch(@this)
  {
     Case(this::SignalUBOFF) :
        resultValue = DisturbUB(Backbone::DIM::DIMBackBoneSignalIPdu01::DrvrCrsCtrlFctSeld_UB,0,-1,0); break;
     Case(this::SignalUBHandled) :
        resultValue = DisturbUB(Backbone::DIM::DIMBackBoneSignalIPdu01::DrvrCrsCtrlFctSeld_UB,0,0,0); break;
     Case(this::SignalUBON) :
        resultValue = DisturbUB(Backbone::DIM::DIMBackBoneSignalIPdu01::DrvrCrsCtrlFctSeld_UB,0,-1,1); break;
     Default :
        resultValue = -1;
  }
  
}

on sysvar_update sysvar::DIM::Backbone::Signals::Control::UB::SetSpdForKeySpdLimn_UB_Control
{
  long resultValue;
  
  // --- FR ---
  setBusContext(getBusNameContext(gFR1BusName));
  switch(@this)
  {
     Case(this::SignalUBOFF) :
        resultValue = DisturbUB(Backbone::DIM::DIMBackBoneSignalIPdu01::SetSpdForKeySpdLimn_UB,0,-1,0); break;
     Case(this::SignalUBHandled) :
        resultValue = DisturbUB(Backbone::DIM::DIMBackBoneSignalIPdu01::SetSpdForKeySpdLimn_UB,0,0,0); break;
     Case(this::SignalUBON) :
        resultValue = DisturbUB(Backbone::DIM::DIMBackBoneSignalIPdu01::SetSpdForKeySpdLimn_UB,0,-1,1); break;
     Default :
        resultValue = -1;
  }
  
}

on sysvar_update sysvar::DIM::Backbone::SignalGroups::Control::E2E::SteerAutDrvActvGroupSafeChks_Control
{
  int controlValue;
  long resultValue;
  
  // --- FR ---
  controlValue = (int) @this;
  setBusContext(getBusNameContext(gFR1BusName));
  switch(controlValue)
  {
     Case(this::ChksHandled) :
        resultValue = EnableCRC("SteerAutDrvActvGroupSafe", 1); break;
     Case(this::ChksManual) :
        resultValue = EnableCRC("SteerAutDrvActvGroupSafe", 0); break;
     Default :
        resultValue = -1;
  }
  
}

on sysvar_update sysvar::DIM::Backbone::SignalGroups::Control::E2E::SteerAutDrvActvGroupSafeCntr_Control
{
  int controlValue;
  long resultValue;
  
  // --- FR ---
  controlValue = (int) @this;
  setBusContext(getBusNameContext(gFR1BusName));
  switch(controlValue)
  {
     Case(this::CntrHandled) :
        resultValue = EnableCounter ("SteerAutDrvActvGroupSafe", 1); break;
     Case(this::CntrManual) :
        resultValue = EnableCounter ("SteerAutDrvActvGroupSafe", 0); break;
     Default :
        resultValue = -1;
  }
  
}

on sysvar_update sysvar::DIM::Backbone::Signals::Control::UB::AmbTIndcdWithUnit_UB_Control
{
  long resultValue;
  
  // --- FR ---
  setBusContext(getBusNameContext(gFR1BusName));
  switch(@this)
  {
     Case(this::SignalUBOFF) :
        resultValue = DisturbUB(Backbone::DIM::DIMBackBoneSignalIPdu02::AmbTIndcdWithUnit_UB,0,-1,0); break;
     Case(this::SignalUBHandled) :
        resultValue = DisturbUB(Backbone::DIM::DIMBackBoneSignalIPdu02::AmbTIndcdWithUnit_UB,0,0,0); break;
     Case(this::SignalUBON) :
        resultValue = DisturbUB(Backbone::DIM::DIMBackBoneSignalIPdu02::AmbTIndcdWithUnit_UB,0,-1,1); break;
     Default :
        resultValue = -1;
  }
  
}

on sysvar_update sysvar::DIM::Backbone::Signals::Control::UB::SteerAutDrvActvGroupSafe_UB_Control
{
  long resultValue;
  
  // --- FR ---
  setBusContext(getBusNameContext(gFR1BusName));
  switch(@this)
  {
     Case(this::SignalUBOFF) :
        resultValue = DisturbUB(Backbone::DIM::DIMBackBoneSignalIPdu02::SteerAutDrvActvGroupSafe_UB,0,-1,0); break;
     Case(this::SignalUBHandled) :
        resultValue = DisturbUB(Backbone::DIM::DIMBackBoneSignalIPdu02::SteerAutDrvActvGroupSafe_UB,0,0,0); break;
     Case(this::SignalUBON) :
        resultValue = DisturbUB(Backbone::DIM::DIMBackBoneSignalIPdu02::SteerAutDrvActvGroupSafe_UB,0,-1,1); break;
     Default :
        resultValue = -1;
  }
  
}

on sysvar_update sysvar::DIM::Backbone::Signals::Control::UB::BkpOfDstTrvld_UB_Control
{
  long resultValue;
  
  // --- FR ---
  setBusContext(getBusNameContext(gFR1BusName));
  switch(@this)
  {
     Case(this::SignalUBOFF) :
        resultValue = DisturbUB(Backbone::DIM::DIMBackBoneSignalIPdu02::BkpOfDstTrvld_UB,0,-1,0); break;
     Case(this::SignalUBHandled) :
        resultValue = DisturbUB(Backbone::DIM::DIMBackBoneSignalIPdu02::BkpOfDstTrvld_UB,0,0,0); break;
     Case(this::SignalUBON) :
        resultValue = DisturbUB(Backbone::DIM::DIMBackBoneSignalIPdu02::BkpOfDstTrvld_UB,0,-1,1); break;
     Default :
        resultValue = -1;
  }
  
}

on sysvar_update sysvar::DIM::Backbone::Signals::Control::UB::BltRmnSound1_UB_Control
{
  long resultValue;
  
  // --- FR ---
  setBusContext(getBusNameContext(gFR1BusName));
  switch(@this)
  {
     Case(this::SignalUBOFF) :
        resultValue = DisturbUB(Backbone::DIM::DIMBackBoneSignalIPdu02::BltRmnSound1_UB,0,-1,0); break;
     Case(this::SignalUBHandled) :
        resultValue = DisturbUB(Backbone::DIM::DIMBackBoneSignalIPdu02::BltRmnSound1_UB,0,0,0); break;
     Case(this::SignalUBON) :
        resultValue = DisturbUB(Backbone::DIM::DIMBackBoneSignalIPdu02::BltRmnSound1_UB,0,-1,1); break;
     Default :
        resultValue = -1;
  }
  
}

on sysvar_update sysvar::DIM::Backbone::Signals::Control::UB::BltRmnSound2_UB_Control
{
  long resultValue;
  
  // --- FR ---
  setBusContext(getBusNameContext(gFR1BusName));
  switch(@this)
  {
     Case(this::SignalUBOFF) :
        resultValue = DisturbUB(Backbone::DIM::DIMBackBoneSignalIPdu02::BltRmnSound2_UB,0,-1,0); break;
     Case(this::SignalUBHandled) :
        resultValue = DisturbUB(Backbone::DIM::DIMBackBoneSignalIPdu02::BltRmnSound2_UB,0,0,0); break;
     Case(this::SignalUBON) :
        resultValue = DisturbUB(Backbone::DIM::DIMBackBoneSignalIPdu02::BltRmnSound2_UB,0,-1,1); break;
     Default :
        resultValue = -1;
  }
  
}

on sysvar_update sysvar::DIM::Backbone::Signals::Control::UB::BltRmnSound3_UB_Control
{
  long resultValue;
  
  // --- FR ---
  setBusContext(getBusNameContext(gFR1BusName));
  switch(@this)
  {
     Case(this::SignalUBOFF) :
        resultValue = DisturbUB(Backbone::DIM::DIMBackBoneSignalIPdu02::BltRmnSound3_UB,0,-1,0); break;
     Case(this::SignalUBHandled) :
        resultValue = DisturbUB(Backbone::DIM::DIMBackBoneSignalIPdu02::BltRmnSound3_UB,0,0,0); break;
     Case(this::SignalUBON) :
        resultValue = DisturbUB(Backbone::DIM::DIMBackBoneSignalIPdu02::BltRmnSound3_UB,0,-1,1); break;
     Default :
        resultValue = -1;
  }
  
}

on sysvar_update sysvar::DIM::Backbone::Signals::Control::UB::BltRmnSound4_UB_Control
{
  long resultValue;
  
  // --- FR ---
  setBusContext(getBusNameContext(gFR1BusName));
  switch(@this)
  {
     Case(this::SignalUBOFF) :
        resultValue = DisturbUB(Backbone::DIM::DIMBackBoneSignalIPdu02::BltRmnSound4_UB,0,-1,0); break;
     Case(this::SignalUBHandled) :
        resultValue = DisturbUB(Backbone::DIM::DIMBackBoneSignalIPdu02::BltRmnSound4_UB,0,0,0); break;
     Case(this::SignalUBON) :
        resultValue = DisturbUB(Backbone::DIM::DIMBackBoneSignalIPdu02::BltRmnSound4_UB,0,-1,1); break;
     Default :
        resultValue = -1;
  }
  
}

on sysvar_update sysvar::DIM::Backbone::Signals::Control::UB::BtnAudFbSts_UB_Control
{
  long resultValue;
  
  // --- FR ---
  setBusContext(getBusNameContext(gFR1BusName));
  switch(@this)
  {
     Case(this::SignalUBOFF) :
        resultValue = DisturbUB(Backbone::DIM::DIMBackBoneSignalIPdu02::BtnAudFbSts_UB,0,-1,0); break;
     Case(this::SignalUBHandled) :
        resultValue = DisturbUB(Backbone::DIM::DIMBackBoneSignalIPdu02::BtnAudFbSts_UB,0,0,0); break;
     Case(this::SignalUBON) :
        resultValue = DisturbUB(Backbone::DIM::DIMBackBoneSignalIPdu02::BtnAudFbSts_UB,0,-1,1); break;
     Default :
        resultValue = -1;
  }
  
}

on sysvar_update sysvar::DIM::Backbone::Signals::Control::UB::BtnAudVolSts_UB_Control
{
  long resultValue;
  
  // --- FR ---
  setBusContext(getBusNameContext(gFR1BusName));
  switch(@this)
  {
     Case(this::SignalUBOFF) :
        resultValue = DisturbUB(Backbone::DIM::DIMBackBoneSignalIPdu02::BtnAudVolSts_UB,0,-1,0); break;
     Case(this::SignalUBHandled) :
        resultValue = DisturbUB(Backbone::DIM::DIMBackBoneSignalIPdu02::BtnAudVolSts_UB,0,0,0); break;
     Case(this::SignalUBON) :
        resultValue = DisturbUB(Backbone::DIM::DIMBackBoneSignalIPdu02::BtnAudVolSts_UB,0,-1,1); break;
     Default :
        resultValue = -1;
  }
  
}

on sysvar_update sysvar::DIM::Backbone::Signals::Control::UB::DrvrCrsCtrlWithBoostReq_UB_Control
{
  long resultValue;
  
  // --- FR ---
  setBusContext(getBusNameContext(gFR1BusName));
  switch(@this)
  {
     Case(this::SignalUBOFF) :
        resultValue = DisturbUB(Backbone::DIM::DIMBackBoneSignalIPdu02::DrvrCrsCtrlWithBoostReq_UB,0,-1,0); break;
     Case(this::SignalUBHandled) :
        resultValue = DisturbUB(Backbone::DIM::DIMBackBoneSignalIPdu02::DrvrCrsCtrlWithBoostReq_UB,0,0,0); break;
     Case(this::SignalUBON) :
        resultValue = DisturbUB(Backbone::DIM::DIMBackBoneSignalIPdu02::DrvrCrsCtrlWithBoostReq_UB,0,-1,1); break;
     Default :
        resultValue = -1;
  }
  
}

on sysvar_update sysvar::DIM::Backbone::SignalGroups::Control::E2E::SftySigGroupFromHmiSafeChks_Control
{
  int controlValue;
  long resultValue;
  
  // --- FR ---
  controlValue = (int) @this;
  setBusContext(getBusNameContext(gFR1BusName));
  switch(controlValue)
  {
     Case(this::ChksHandled) :
        resultValue = EnableCRC("SftySigGroupFromHmiSafe", 1); break;
     Case(this::ChksManual) :
        resultValue = EnableCRC("SftySigGroupFromHmiSafe", 0); break;
     Default :
        resultValue = -1;
  }
  
}

on sysvar_update sysvar::DIM::Backbone::SignalGroups::Control::E2E::SftySigGroupFromHmiSafeCntr_Control
{
  int controlValue;
  long resultValue;
  
  // --- FR ---
  controlValue = (int) @this;
  setBusContext(getBusNameContext(gFR1BusName));
  switch(controlValue)
  {
     Case(this::CntrHandled) :
        resultValue = EnableCounter ("SftySigGroupFromHmiSafe", 1); break;
     Case(this::CntrManual) :
        resultValue = EnableCounter ("SftySigGroupFromHmiSafe", 0); break;
     Default :
        resultValue = -1;
  }
  
}

on sysvar_update sysvar::DIM::Backbone::Signals::Control::UB::FuLvlIndcd_UB_Control
{
  long resultValue;
  
  // --- FR ---
  setBusContext(getBusNameContext(gFR1BusName));
  switch(@this)
  {
     Case(this::SignalUBOFF) :
        resultValue = DisturbUB(Backbone::DIM::DIMBackBoneSignalIPdu04::FuLvlIndcd_UB,0,-1,0); break;
     Case(this::SignalUBHandled) :
        resultValue = DisturbUB(Backbone::DIM::DIMBackBoneSignalIPdu04::FuLvlIndcd_UB,0,0,0); break;
     Case(this::SignalUBON) :
        resultValue = DisturbUB(Backbone::DIM::DIMBackBoneSignalIPdu04::FuLvlIndcd_UB,0,-1,1); break;
     Default :
        resultValue = -1;
  }
  
}

on sysvar_update sysvar::DIM::Backbone::Signals::Control::UB::FuLvlRawActvSide_UB_Control
{
  long resultValue;
  
  // --- FR ---
  setBusContext(getBusNameContext(gFR1BusName));
  switch(@this)
  {
     Case(this::SignalUBOFF) :
        resultValue = DisturbUB(Backbone::DIM::DIMBackBoneSignalIPdu04::FuLvlRawActvSide_UB,0,-1,0); break;
     Case(this::SignalUBHandled) :
        resultValue = DisturbUB(Backbone::DIM::DIMBackBoneSignalIPdu04::FuLvlRawActvSide_UB,0,0,0); break;
     Case(this::SignalUBON) :
        resultValue = DisturbUB(Backbone::DIM::DIMBackBoneSignalIPdu04::FuLvlRawActvSide_UB,0,-1,1); break;
     Default :
        resultValue = -1;
  }
  
}

on sysvar_update sysvar::DIM::Backbone::Signals::Control::UB::FuLvlRawPasSide_UB_Control
{
  long resultValue;
  
  // --- FR ---
  setBusContext(getBusNameContext(gFR1BusName));
  switch(@this)
  {
     Case(this::SignalUBOFF) :
        resultValue = DisturbUB(Backbone::DIM::DIMBackBoneSignalIPdu04::FuLvlRawPasSide_UB,0,-1,0); break;
     Case(this::SignalUBHandled) :
        resultValue = DisturbUB(Backbone::DIM::DIMBackBoneSignalIPdu04::FuLvlRawPasSide_UB,0,0,0); break;
     Case(this::SignalUBON) :
        resultValue = DisturbUB(Backbone::DIM::DIMBackBoneSignalIPdu04::FuLvlRawPasSide_UB,0,-1,1); break;
     Default :
        resultValue = -1;
  }
  
}

on sysvar_update sysvar::DIM::Backbone::Signals::Control::UB::HudDiagc_UB_Control
{
  long resultValue;
  
  // --- FR ---
  setBusContext(getBusNameContext(gFR1BusName));
  switch(@this)
  {
     Case(this::SignalUBOFF) :
        resultValue = DisturbUB(Backbone::DIM::DIMBackBoneSignalIPdu04::HudDiagc_UB,0,-1,0); break;
     Case(this::SignalUBHandled) :
        resultValue = DisturbUB(Backbone::DIM::DIMBackBoneSignalIPdu04::HudDiagc_UB,0,0,0); break;
     Case(this::SignalUBON) :
        resultValue = DisturbUB(Backbone::DIM::DIMBackBoneSignalIPdu04::HudDiagc_UB,0,-1,1); break;
     Default :
        resultValue = -1;
  }
  
}

on sysvar_update sysvar::DIM::Backbone::Signals::Control::UB::SetSpdForDispToDrvr_UB_Control
{
  long resultValue;
  
  // --- FR ---
  setBusContext(getBusNameContext(gFR1BusName));
  switch(@this)
  {
     Case(this::SignalUBOFF) :
        resultValue = DisturbUB(Backbone::DIM::DIMBackBoneSignalIPdu04::SetSpdForDispToDrvr_UB,0,-1,0); break;
     Case(this::SignalUBHandled) :
        resultValue = DisturbUB(Backbone::DIM::DIMBackBoneSignalIPdu04::SetSpdForDispToDrvr_UB,0,0,0); break;
     Case(this::SignalUBON) :
        resultValue = DisturbUB(Backbone::DIM::DIMBackBoneSignalIPdu04::SetSpdForDispToDrvr_UB,0,-1,1); break;
     Default :
        resultValue = -1;
  }
  
}

on sysvar_update sysvar::DIM::Backbone::Signals::Control::UB::SftySigGroupFromHmiSafe_UB_Control
{
  long resultValue;
  
  // --- FR ---
  setBusContext(getBusNameContext(gFR1BusName));
  switch(@this)
  {
     Case(this::SignalUBOFF) :
        resultValue = DisturbUB(Backbone::DIM::DIMBackBoneSignalIPdu04::SftySigGroupFromHmiSafe_UB,0,-1,0); break;
     Case(this::SignalUBHandled) :
        resultValue = DisturbUB(Backbone::DIM::DIMBackBoneSignalIPdu04::SftySigGroupFromHmiSafe_UB,0,0,0); break;
     Case(this::SignalUBON) :
        resultValue = DisturbUB(Backbone::DIM::DIMBackBoneSignalIPdu04::SftySigGroupFromHmiSafe_UB,0,-1,1); break;
     Default :
        resultValue = -1;
  }
  
}

on sysvar_update sysvar::DIM::Backbone::Signals::Control::UB::TiGap_UB_Control
{
  long resultValue;
  
  // --- FR ---
  setBusContext(getBusNameContext(gFR1BusName));
  switch(@this)
  {
     Case(this::SignalUBOFF) :
        resultValue = DisturbUB(Backbone::DIM::DIMBackBoneSignalIPdu04::TiGap_UB,0,-1,0); break;
     Case(this::SignalUBHandled) :
        resultValue = DisturbUB(Backbone::DIM::DIMBackBoneSignalIPdu04::TiGap_UB,0,0,0); break;
     Case(this::SignalUBON) :
        resultValue = DisturbUB(Backbone::DIM::DIMBackBoneSignalIPdu04::TiGap_UB,0,-1,1); break;
     Default :
        resultValue = -1;
  }
  
}

on sysvar_update sysvar::DIM::Backbone::Signals::Control::UB::VFCVectorDIM_UB_Control
{
  long resultValue;
  
  // --- FR ---
  setBusContext(getBusNameContext(gFR1BusName));
  switch(@this)
  {
     Case(this::SignalUBOFF) :
        resultValue = DisturbUB(Backbone::DIM::DIMBackBoneSignalIPdu04::VFCVectorDIM_UB,0,-1,0); break;
     Case(this::SignalUBHandled) :
        resultValue = DisturbUB(Backbone::DIM::DIMBackBoneSignalIPdu04::VFCVectorDIM_UB,0,0,0); break;
     Case(this::SignalUBON) :
        resultValue = DisturbUB(Backbone::DIM::DIMBackBoneSignalIPdu04::VFCVectorDIM_UB,0,-1,1); break;
     Default :
        resultValue = -1;
  }
  
}

on sysvar_update sysvar::DIM::Backbone::Signals::Control::UB::AudMsgReq_UB_Control
{
  long resultValue;
  
  // --- FR ---
  setBusContext(getBusNameContext(gFR1BusName));
  switch(@this)
  {
     Case(this::SignalUBOFF) :
        resultValue = DisturbUB(Backbone::DIM::DIMBackBoneSignalIPdu04::AudMsgReq_UB,0,-1,0); break;
     Case(this::SignalUBHandled) :
        resultValue = DisturbUB(Backbone::DIM::DIMBackBoneSignalIPdu04::AudMsgReq_UB,0,0,0); break;
     Case(this::SignalUBON) :
        resultValue = DisturbUB(Backbone::DIM::DIMBackBoneSignalIPdu04::AudMsgReq_UB,0,-1,1); break;
     Default :
        resultValue = -1;
  }
  
}

on sysvar_update sysvar::DIM::Backbone::Signals::Control::UB::BkpUsrIntxcnChk_UB_Control
{
  long resultValue;
  
  // --- FR ---
  setBusContext(getBusNameContext(gFR1BusName));
  switch(@this)
  {
     Case(this::SignalUBOFF) :
        resultValue = DisturbUB(Backbone::DIM::DIMBackBoneSignalIPdu04::BkpUsrIntxcnChk_UB,0,-1,0); break;
     Case(this::SignalUBHandled) :
        resultValue = DisturbUB(Backbone::DIM::DIMBackBoneSignalIPdu04::BkpUsrIntxcnChk_UB,0,0,0); break;
     Case(this::SignalUBON) :
        resultValue = DisturbUB(Backbone::DIM::DIMBackBoneSignalIPdu04::BkpUsrIntxcnChk_UB,0,-1,1); break;
     Default :
        resultValue = -1;
  }
  
}

on sysvar_update sysvar::DIM::Backbone::Signals::Control::UB::BtnL6Req_UB_Control
{
  long resultValue;
  
  // --- FR ---
  setBusContext(getBusNameContext(gFR1BusName));
  switch(@this)
  {
     Case(this::SignalUBOFF) :
        resultValue = DisturbUB(Backbone::DIM::DIMBackBoneSignalIPdu04::BtnL6Req_UB,0,-1,0); break;
     Case(this::SignalUBHandled) :
        resultValue = DisturbUB(Backbone::DIM::DIMBackBoneSignalIPdu04::BtnL6Req_UB,0,0,0); break;
     Case(this::SignalUBON) :
        resultValue = DisturbUB(Backbone::DIM::DIMBackBoneSignalIPdu04::BtnL6Req_UB,0,-1,1); break;
     Default :
        resultValue = -1;
  }
  
}

on sysvar_update sysvar::DIM::Backbone::Signals::Control::UB::BtnL7Req_UB_Control
{
  long resultValue;
  
  // --- FR ---
  setBusContext(getBusNameContext(gFR1BusName));
  switch(@this)
  {
     Case(this::SignalUBOFF) :
        resultValue = DisturbUB(Backbone::DIM::DIMBackBoneSignalIPdu04::BtnL7Req_UB,0,-1,0); break;
     Case(this::SignalUBHandled) :
        resultValue = DisturbUB(Backbone::DIM::DIMBackBoneSignalIPdu04::BtnL7Req_UB,0,0,0); break;
     Case(this::SignalUBON) :
        resultValue = DisturbUB(Backbone::DIM::DIMBackBoneSignalIPdu04::BtnL7Req_UB,0,-1,1); break;
     Default :
        resultValue = -1;
  }
  
}

on sysvar_update sysvar::DIM::Backbone::Signals::Control::UB::BtnMmedLeRiSts_UB_Control
{
  long resultValue;
  
  // --- FR ---
  setBusContext(getBusNameContext(gFR1BusName));
  switch(@this)
  {
     Case(this::SignalUBOFF) :
        resultValue = DisturbUB(Backbone::DIM::DIMBackBoneSignalIPdu04::BtnMmedLeRiSts_UB,0,-1,0); break;
     Case(this::SignalUBHandled) :
        resultValue = DisturbUB(Backbone::DIM::DIMBackBoneSignalIPdu04::BtnMmedLeRiSts_UB,0,0,0); break;
     Case(this::SignalUBON) :
        resultValue = DisturbUB(Backbone::DIM::DIMBackBoneSignalIPdu04::BtnMmedLeRiSts_UB,0,-1,1); break;
     Default :
        resultValue = -1;
  }
  
}

on sysvar_update sysvar::DIM::Backbone::Signals::Control::UB::BtnMmedSetSts_UB_Control
{
  long resultValue;
  
  // --- FR ---
  setBusContext(getBusNameContext(gFR1BusName));
  switch(@this)
  {
     Case(this::SignalUBOFF) :
        resultValue = DisturbUB(Backbone::DIM::DIMBackBoneSignalIPdu04::BtnMmedSetSts_UB,0,-1,0); break;
     Case(this::SignalUBHandled) :
        resultValue = DisturbUB(Backbone::DIM::DIMBackBoneSignalIPdu04::BtnMmedSetSts_UB,0,0,0); break;
     Case(this::SignalUBON) :
        resultValue = DisturbUB(Backbone::DIM::DIMBackBoneSignalIPdu04::BtnMmedSetSts_UB,0,-1,1); break;
     Default :
        resultValue = -1;
  }
  
}

on sysvar_update sysvar::DIM::Backbone::Signals::Control::UB::DispStsFrnt_UB_Control
{
  long resultValue;
  
  // --- FR ---
  setBusContext(getBusNameContext(gFR1BusName));
  switch(@this)
  {
     Case(this::SignalUBOFF) :
        resultValue = DisturbUB(Backbone::DIM::DIMBackBoneSignalIPdu04::DispStsFrnt_UB,0,-1,0); break;
     Case(this::SignalUBHandled) :
        resultValue = DisturbUB(Backbone::DIM::DIMBackBoneSignalIPdu04::DispStsFrnt_UB,0,0,0); break;
     Case(this::SignalUBON) :
        resultValue = DisturbUB(Backbone::DIM::DIMBackBoneSignalIPdu04::DispStsFrnt_UB,0,-1,1); break;
     Default :
        resultValue = -1;
  }
  
}

on sysvar_update sysvar::DIM::Backbone::Signals::Control::UB::DrvrHmiSpdLimAdpnSts_UB_Control
{
  long resultValue;
  
  // --- FR ---
  setBusContext(getBusNameContext(gFR1BusName));
  switch(@this)
  {
     Case(this::SignalUBOFF) :
        resultValue = DisturbUB(Backbone::DIM::DIMBackBoneSignalIPdu04::DrvrHmiSpdLimAdpnSts_UB,0,-1,0); break;
     Case(this::SignalUBHandled) :
        resultValue = DisturbUB(Backbone::DIM::DIMBackBoneSignalIPdu04::DrvrHmiSpdLimAdpnSts_UB,0,0,0); break;
     Case(this::SignalUBON) :
        resultValue = DisturbUB(Backbone::DIM::DIMBackBoneSignalIPdu04::DrvrHmiSpdLimAdpnSts_UB,0,-1,1); break;
     Default :
        resultValue = -1;
  }
  
}

on sysvar_update sysvar::DIM::Backbone::Signals::Control::UB::DrvrWLoadLvlForAuxOper_UB_Control
{
  long resultValue;
  
  // --- FR ---
  setBusContext(getBusNameContext(gFR1BusName));
  switch(@this)
  {
     Case(this::SignalUBOFF) :
        resultValue = DisturbUB(Backbone::DIM::DIMBackBoneSignalIPdu04::DrvrWLoadLvlForAuxOper_UB,0,-1,0); break;
     Case(this::SignalUBHandled) :
        resultValue = DisturbUB(Backbone::DIM::DIMBackBoneSignalIPdu04::DrvrWLoadLvlForAuxOper_UB,0,0,0); break;
     Case(this::SignalUBON) :
        resultValue = DisturbUB(Backbone::DIM::DIMBackBoneSignalIPdu04::DrvrWLoadLvlForAuxOper_UB,0,-1,1); break;
     Default :
        resultValue = -1;
  }
  
}

on sysvar_update sysvar::DIM::Backbone::Signals::Control::UB::DstTrvld2_UB_Control
{
  long resultValue;
  
  // --- FR ---
  setBusContext(getBusNameContext(gFR1BusName));
  switch(@this)
  {
     Case(this::SignalUBOFF) :
        resultValue = DisturbUB(Backbone::DIM::DIMBackBoneSignalIPdu04::DstTrvld2_UB,0,-1,0); break;
     Case(this::SignalUBHandled) :
        resultValue = DisturbUB(Backbone::DIM::DIMBackBoneSignalIPdu04::DstTrvld2_UB,0,0,0); break;
     Case(this::SignalUBON) :
        resultValue = DisturbUB(Backbone::DIM::DIMBackBoneSignalIPdu04::DstTrvld2_UB,0,-1,1); break;
     Default :
        resultValue = -1;
  }
  
}

on sysvar_update sysvar::DIM::Backbone::Signals::Control::UB::DstTrvldHiResl_UB_Control
{
  long resultValue;
  
  // --- FR ---
  setBusContext(getBusNameContext(gFR1BusName));
  switch(@this)
  {
     Case(this::SignalUBOFF) :
        resultValue = DisturbUB(Backbone::DIM::DIMBackBoneSignalIPdu04::DstTrvldHiResl_UB,0,-1,0); break;
     Case(this::SignalUBHandled) :
        resultValue = DisturbUB(Backbone::DIM::DIMBackBoneSignalIPdu04::DstTrvldHiResl_UB,0,0,0); break;
     Case(this::SignalUBON) :
        resultValue = DisturbUB(Backbone::DIM::DIMBackBoneSignalIPdu04::DstTrvldHiResl_UB,0,-1,1); break;
     Default :
        resultValue = -1;
  }
  
}

on sysvar_update sysvar::DIM::Backbone::Signals::Control::UB::HudActvSts_UB_Control
{
  long resultValue;
  
  // --- FR ---
  setBusContext(getBusNameContext(gFR1BusName));
  switch(@this)
  {
     Case(this::SignalUBOFF) :
        resultValue = DisturbUB(Backbone::DIM::DIMBackBoneSignalIPdu04::HudActvSts_UB,0,-1,0); break;
     Case(this::SignalUBHandled) :
        resultValue = DisturbUB(Backbone::DIM::DIMBackBoneSignalIPdu04::HudActvSts_UB,0,0,0); break;
     Case(this::SignalUBON) :
        resultValue = DisturbUB(Backbone::DIM::DIMBackBoneSignalIPdu04::HudActvSts_UB,0,-1,1); break;
     Default :
        resultValue = -1;
  }
  
}

on sysvar_update sysvar::DIM::Backbone::Signals::Control::UB::HudSts_UB_Control
{
  long resultValue;
  
  // --- FR ---
  setBusContext(getBusNameContext(gFR1BusName));
  switch(@this)
  {
     Case(this::SignalUBOFF) :
        resultValue = DisturbUB(Backbone::DIM::DIMBackBoneSignalIPdu04::HudSts_UB,0,-1,0); break;
     Case(this::SignalUBHandled) :
        resultValue = DisturbUB(Backbone::DIM::DIMBackBoneSignalIPdu04::HudSts_UB,0,0,0); break;
     Case(this::SignalUBON) :
        resultValue = DisturbUB(Backbone::DIM::DIMBackBoneSignalIPdu04::HudSts_UB,0,-1,1); break;
     Default :
        resultValue = -1;
  }
  
}

on sysvar_update sysvar::DIM::Backbone::Signals::Control::UB::KeyLostWarnIndcnAckd_UB_Control
{
  long resultValue;
  
  // --- FR ---
  setBusContext(getBusNameContext(gFR1BusName));
  switch(@this)
  {
     Case(this::SignalUBOFF) :
        resultValue = DisturbUB(Backbone::DIM::DIMBackBoneSignalIPdu04::KeyLostWarnIndcnAckd_UB,0,-1,0); break;
     Case(this::SignalUBHandled) :
        resultValue = DisturbUB(Backbone::DIM::DIMBackBoneSignalIPdu04::KeyLostWarnIndcnAckd_UB,0,0,0); break;
     Case(this::SignalUBON) :
        resultValue = DisturbUB(Backbone::DIM::DIMBackBoneSignalIPdu04::KeyLostWarnIndcnAckd_UB,0,-1,1); break;
     Default :
        resultValue = -1;
  }
  
}

on sysvar_update sysvar::DIM::Backbone::Signals::Control::UB::KeySpdWarn_UB_Control
{
  long resultValue;
  
  // --- FR ---
  setBusContext(getBusNameContext(gFR1BusName));
  switch(@this)
  {
     Case(this::SignalUBOFF) :
        resultValue = DisturbUB(Backbone::DIM::DIMBackBoneSignalIPdu04::KeySpdWarn_UB,0,-1,0); break;
     Case(this::SignalUBHandled) :
        resultValue = DisturbUB(Backbone::DIM::DIMBackBoneSignalIPdu04::KeySpdWarn_UB,0,0,0); break;
     Case(this::SignalUBON) :
        resultValue = DisturbUB(Backbone::DIM::DIMBackBoneSignalIPdu04::KeySpdWarn_UB,0,-1,1); break;
     Default :
        resultValue = -1;
  }
  
}

on sysvar_update sysvar::DIM::Backbone::Signals::Control::UB::SetSpdForCrsCtrlFct_UB_Control
{
  long resultValue;
  
  // --- FR ---
  setBusContext(getBusNameContext(gFR1BusName));
  switch(@this)
  {
     Case(this::SignalUBOFF) :
        resultValue = DisturbUB(Backbone::DIM::DIMBackBoneSignalIPdu04::SetSpdForCrsCtrlFct_UB,0,-1,0); break;
     Case(this::SignalUBHandled) :
        resultValue = DisturbUB(Backbone::DIM::DIMBackBoneSignalIPdu04::SetSpdForCrsCtrlFct_UB,0,0,0); break;
     Case(this::SignalUBON) :
        resultValue = DisturbUB(Backbone::DIM::DIMBackBoneSignalIPdu04::SetSpdForCrsCtrlFct_UB,0,-1,1); break;
     Default :
        resultValue = -1;
  }
  
}

on sysvar_update sysvar::DIM::Backbone::Signals::Control::UB::SetSpdSts_UB_Control
{
  long resultValue;
  
  // --- FR ---
  setBusContext(getBusNameContext(gFR1BusName));
  switch(@this)
  {
     Case(this::SignalUBOFF) :
        resultValue = DisturbUB(Backbone::DIM::DIMBackBoneSignalIPdu04::SetSpdSts_UB,0,-1,0); break;
     Case(this::SignalUBHandled) :
        resultValue = DisturbUB(Backbone::DIM::DIMBackBoneSignalIPdu04::SetSpdSts_UB,0,0,0); break;
     Case(this::SignalUBON) :
        resultValue = DisturbUB(Backbone::DIM::DIMBackBoneSignalIPdu04::SetSpdSts_UB,0,-1,1); break;
     Default :
        resultValue = -1;
  }
  
}

on sysvar_update sysvar::DIM::Backbone::Signals::Control::UB::SpdWarn_UB_Control
{
  long resultValue;
  
  // --- FR ---
  setBusContext(getBusNameContext(gFR1BusName));
  switch(@this)
  {
     Case(this::SignalUBOFF) :
        resultValue = DisturbUB(Backbone::DIM::DIMBackBoneSignalIPdu04::SpdWarn_UB,0,-1,0); break;
     Case(this::SignalUBHandled) :
        resultValue = DisturbUB(Backbone::DIM::DIMBackBoneSignalIPdu04::SpdWarn_UB,0,0,0); break;
     Case(this::SignalUBON) :
        resultValue = DisturbUB(Backbone::DIM::DIMBackBoneSignalIPdu04::SpdWarn_UB,0,-1,1); break;
     Default :
        resultValue = -1;
  }
  
}

on sysvar_update sysvar::DIM::Backbone::Signals::Control::UB::SteerWhlSwtPwr_UB_Control
{
  long resultValue;
  
  // --- FR ---
  setBusContext(getBusNameContext(gFR1BusName));
  switch(@this)
  {
     Case(this::SignalUBOFF) :
        resultValue = DisturbUB(Backbone::DIM::DIMBackBoneSignalIPdu04::SteerWhlSwtPwr_UB,0,-1,0); break;
     Case(this::SignalUBHandled) :
        resultValue = DisturbUB(Backbone::DIM::DIMBackBoneSignalIPdu04::SteerWhlSwtPwr_UB,0,0,0); break;
     Case(this::SignalUBON) :
        resultValue = DisturbUB(Backbone::DIM::DIMBackBoneSignalIPdu04::SteerWhlSwtPwr_UB,0,-1,1); break;
     Default :
        resultValue = -1;
  }
  
}

on sysvar_update sysvar::DIM::Backbone::Signals::Control::UB::TrlrLampChkReq_UB_Control
{
  long resultValue;
  
  // --- FR ---
  setBusContext(getBusNameContext(gFR1BusName));
  switch(@this)
  {
     Case(this::SignalUBOFF) :
        resultValue = DisturbUB(Backbone::DIM::DIMBackBoneSignalIPdu04::TrlrLampChkReq_UB,0,-1,0); break;
     Case(this::SignalUBHandled) :
        resultValue = DisturbUB(Backbone::DIM::DIMBackBoneSignalIPdu04::TrlrLampChkReq_UB,0,0,0); break;
     Case(this::SignalUBON) :
        resultValue = DisturbUB(Backbone::DIM::DIMBackBoneSignalIPdu04::TrlrLampChkReq_UB,0,-1,1); break;
     Default :
        resultValue = -1;
  }
  
}

on sysvar_update sysvar::DIM::Backbone::Signals::Control::UB::DstToEmptyIndcd_UB_Control
{
  long resultValue;
  
  // --- FR ---
  setBusContext(getBusNameContext(gFR1BusName));
  switch(@this)
  {
     Case(this::SignalUBOFF) :
        resultValue = DisturbUB(Backbone::DIM::DIMBackBoneSignalIPdu05::DstToEmptyIndcd_UB,0,-1,0); break;
     Case(this::SignalUBHandled) :
        resultValue = DisturbUB(Backbone::DIM::DIMBackBoneSignalIPdu05::DstToEmptyIndcd_UB,0,0,0); break;
     Case(this::SignalUBON) :
        resultValue = DisturbUB(Backbone::DIM::DIMBackBoneSignalIPdu05::DstToEmptyIndcd_UB,0,-1,1); break;
     Default :
        resultValue = -1;
  }
  
}

on sysvar_update sysvar::DIM::Backbone::Signals::Control::UB::FuCnsAvgIndcd_UB_Control
{
  long resultValue;
  
  // --- FR ---
  setBusContext(getBusNameContext(gFR1BusName));
  switch(@this)
  {
     Case(this::SignalUBOFF) :
        resultValue = DisturbUB(Backbone::DIM::DIMBackBoneSignalIPdu05::FuCnsAvgIndcd_UB,0,-1,0); break;
     Case(this::SignalUBHandled) :
        resultValue = DisturbUB(Backbone::DIM::DIMBackBoneSignalIPdu05::FuCnsAvgIndcd_UB,0,0,0); break;
     Case(this::SignalUBON) :
        resultValue = DisturbUB(Backbone::DIM::DIMBackBoneSignalIPdu05::FuCnsAvgIndcd_UB,0,-1,1); break;
     Default :
        resultValue = -1;
  }
  
}

on sysvar_update sysvar::DIM::Backbone::Signals::Control::UB::FuCnsIndcd_UB_Control
{
  long resultValue;
  
  // --- FR ---
  setBusContext(getBusNameContext(gFR1BusName));
  switch(@this)
  {
     Case(this::SignalUBOFF) :
        resultValue = DisturbUB(Backbone::DIM::DIMBackBoneSignalIPdu05::FuCnsIndcd_UB,0,-1,0); break;
     Case(this::SignalUBHandled) :
        resultValue = DisturbUB(Backbone::DIM::DIMBackBoneSignalIPdu05::FuCnsIndcd_UB,0,0,0); break;
     Case(this::SignalUBON) :
        resultValue = DisturbUB(Backbone::DIM::DIMBackBoneSignalIPdu05::FuCnsIndcd_UB,0,-1,1); break;
     Default :
        resultValue = -1;
  }
  
}

on sysvar_update sysvar::DIM::Backbone::Signals::Control::UB::VehSpdAvgIndcd_UB_Control
{
  long resultValue;
  
  // --- FR ---
  setBusContext(getBusNameContext(gFR1BusName));
  switch(@this)
  {
     Case(this::SignalUBOFF) :
        resultValue = DisturbUB(Backbone::DIM::DIMBackBoneSignalIPdu05::VehSpdAvgIndcd_UB,0,-1,0); break;
     Case(this::SignalUBHandled) :
        resultValue = DisturbUB(Backbone::DIM::DIMBackBoneSignalIPdu05::VehSpdAvgIndcd_UB,0,0,0); break;
     Case(this::SignalUBON) :
        resultValue = DisturbUB(Backbone::DIM::DIMBackBoneSignalIPdu05::VehSpdAvgIndcd_UB,0,-1,1); break;
     Default :
        resultValue = -1;
  }
  
}

on sysvar_update sysvar::DIM::Backbone::Signals::Control::UB::BtnMmedModSts_UB_Control
{
  long resultValue;
  
  // --- FR ---
  setBusContext(getBusNameContext(gFR1BusName));
  switch(@this)
  {
     Case(this::SignalUBOFF) :
        resultValue = DisturbUB(Backbone::DIM::DIMBackBoneSignalIPdu05::BtnMmedModSts_UB,0,-1,0); break;
     Case(this::SignalUBHandled) :
        resultValue = DisturbUB(Backbone::DIM::DIMBackBoneSignalIPdu05::BtnMmedModSts_UB,0,0,0); break;
     Case(this::SignalUBON) :
        resultValue = DisturbUB(Backbone::DIM::DIMBackBoneSignalIPdu05::BtnMmedModSts_UB,0,-1,1); break;
     Default :
        resultValue = -1;
  }
  
}

on sysvar_update sysvar::DIM::Backbone::Signals::Control::UB::CarModDynoCnfrm_UB_Control
{
  long resultValue;
  
  // --- FR ---
  setBusContext(getBusNameContext(gFR1BusName));
  switch(@this)
  {
     Case(this::SignalUBOFF) :
        resultValue = DisturbUB(Backbone::DIM::DIMBackBoneSignalIPdu05::CarModDynoCnfrm_UB,0,-1,0); break;
     Case(this::SignalUBHandled) :
        resultValue = DisturbUB(Backbone::DIM::DIMBackBoneSignalIPdu05::CarModDynoCnfrm_UB,0,0,0); break;
     Case(this::SignalUBON) :
        resultValue = DisturbUB(Backbone::DIM::DIMBackBoneSignalIPdu05::CarModDynoCnfrm_UB,0,-1,1); break;
     Default :
        resultValue = -1;
  }
  
}

on sysvar_update sysvar::DIM::Backbone::Signals::Control::UB::CoolgReqForDrvrDisp_UB_Control
{
  long resultValue;
  
  // --- FR ---
  setBusContext(getBusNameContext(gFR1BusName));
  switch(@this)
  {
     Case(this::SignalUBOFF) :
        resultValue = DisturbUB(Backbone::DIM::DIMBackBoneSignalIPdu05::CoolgReqForDrvrDisp_UB,0,-1,0); break;
     Case(this::SignalUBHandled) :
        resultValue = DisturbUB(Backbone::DIM::DIMBackBoneSignalIPdu05::CoolgReqForDrvrDisp_UB,0,0,0); break;
     Case(this::SignalUBON) :
        resultValue = DisturbUB(Backbone::DIM::DIMBackBoneSignalIPdu05::CoolgReqForDrvrDisp_UB,0,-1,1); break;
     Default :
        resultValue = -1;
  }
  
}

on sysvar_update sysvar::DIM::Backbone::Signals::Control::UB::DayToSrv_UB_Control
{
  long resultValue;
  
  // --- FR ---
  setBusContext(getBusNameContext(gFR1BusName));
  switch(@this)
  {
     Case(this::SignalUBOFF) :
        resultValue = DisturbUB(Backbone::DIM::DIMBackBoneSignalIPdu05::DayToSrv_UB,0,-1,0); break;
     Case(this::SignalUBHandled) :
        resultValue = DisturbUB(Backbone::DIM::DIMBackBoneSignalIPdu05::DayToSrv_UB,0,0,0); break;
     Case(this::SignalUBON) :
        resultValue = DisturbUB(Backbone::DIM::DIMBackBoneSignalIPdu05::DayToSrv_UB,0,-1,1); break;
     Default :
        resultValue = -1;
  }
  
}

on sysvar_update sysvar::DIM::Backbone::Signals::Control::UB::DrvrWLoadLvl_UB_Control
{
  long resultValue;
  
  // --- FR ---
  setBusContext(getBusNameContext(gFR1BusName));
  switch(@this)
  {
     Case(this::SignalUBOFF) :
        resultValue = DisturbUB(Backbone::DIM::DIMBackBoneSignalIPdu05::DrvrWLoadLvl_UB,0,-1,0); break;
     Case(this::SignalUBHandled) :
        resultValue = DisturbUB(Backbone::DIM::DIMBackBoneSignalIPdu05::DrvrWLoadLvl_UB,0,0,0); break;
     Case(this::SignalUBON) :
        resultValue = DisturbUB(Backbone::DIM::DIMBackBoneSignalIPdu05::DrvrWLoadLvl_UB,0,-1,1); break;
     Default :
        resultValue = -1;
  }
  
}

on sysvar_update sysvar::DIM::Backbone::Signals::Control::UB::DstFromClstrForObdPid_UB_Control
{
  long resultValue;
  
  // --- FR ---
  setBusContext(getBusNameContext(gFR1BusName));
  switch(@this)
  {
     Case(this::SignalUBOFF) :
        resultValue = DisturbUB(Backbone::DIM::DIMBackBoneSignalIPdu05::DstFromClstrForObdPid_UB,0,-1,0); break;
     Case(this::SignalUBHandled) :
        resultValue = DisturbUB(Backbone::DIM::DIMBackBoneSignalIPdu05::DstFromClstrForObdPid_UB,0,0,0); break;
     Case(this::SignalUBON) :
        resultValue = DisturbUB(Backbone::DIM::DIMBackBoneSignalIPdu05::DstFromClstrForObdPid_UB,0,-1,1); break;
     Default :
        resultValue = -1;
  }
  
}

on sysvar_update sysvar::DIM::Backbone::Signals::Control::UB::DstToSrv_UB_Control
{
  long resultValue;
  
  // --- FR ---
  setBusContext(getBusNameContext(gFR1BusName));
  switch(@this)
  {
     Case(this::SignalUBOFF) :
        resultValue = DisturbUB(Backbone::DIM::DIMBackBoneSignalIPdu05::DstToSrv_UB,0,-1,0); break;
     Case(this::SignalUBHandled) :
        resultValue = DisturbUB(Backbone::DIM::DIMBackBoneSignalIPdu05::DstToSrv_UB,0,0,0); break;
     Case(this::SignalUBON) :
        resultValue = DisturbUB(Backbone::DIM::DIMBackBoneSignalIPdu05::DstToSrv_UB,0,-1,1); break;
     Default :
        resultValue = -1;
  }
  
}

on sysvar_update sysvar::DIM::Backbone::Signals::Control::UB::DstTrvld1_UB_Control
{
  long resultValue;
  
  // --- FR ---
  setBusContext(getBusNameContext(gFR1BusName));
  switch(@this)
  {
     Case(this::SignalUBOFF) :
        resultValue = DisturbUB(Backbone::DIM::DIMBackBoneSignalIPdu05::DstTrvld1_UB,0,-1,0); break;
     Case(this::SignalUBHandled) :
        resultValue = DisturbUB(Backbone::DIM::DIMBackBoneSignalIPdu05::DstTrvld1_UB,0,0,0); break;
     Case(this::SignalUBON) :
        resultValue = DisturbUB(Backbone::DIM::DIMBackBoneSignalIPdu05::DstTrvld1_UB,0,-1,1); break;
     Default :
        resultValue = -1;
  }
  
}

on sysvar_update sysvar::DIM::Backbone::Signals::Control::UB::DstTrvldMst2_UB_Control
{
  long resultValue;
  
  // --- FR ---
  setBusContext(getBusNameContext(gFR1BusName));
  switch(@this)
  {
     Case(this::SignalUBOFF) :
        resultValue = DisturbUB(Backbone::DIM::DIMBackBoneSignalIPdu05::DstTrvldMst2_UB,0,-1,0); break;
     Case(this::SignalUBHandled) :
        resultValue = DisturbUB(Backbone::DIM::DIMBackBoneSignalIPdu05::DstTrvldMst2_UB,0,0,0); break;
     Case(this::SignalUBON) :
        resultValue = DisturbUB(Backbone::DIM::DIMBackBoneSignalIPdu05::DstTrvldMst2_UB,0,-1,1); break;
     Default :
        resultValue = -1;
  }
  
}

on sysvar_update sysvar::DIM::Backbone::Signals::Control::UB::EgyCnsAvgIndcn_UB_Control
{
  long resultValue;
  
  // --- FR ---
  setBusContext(getBusNameContext(gFR1BusName));
  switch(@this)
  {
     Case(this::SignalUBOFF) :
        resultValue = DisturbUB(Backbone::DIM::DIMBackBoneSignalIPdu05::EgyCnsAvgIndcn_UB,0,-1,0); break;
     Case(this::SignalUBHandled) :
        resultValue = DisturbUB(Backbone::DIM::DIMBackBoneSignalIPdu05::EgyCnsAvgIndcn_UB,0,0,0); break;
     Case(this::SignalUBON) :
        resultValue = DisturbUB(Backbone::DIM::DIMBackBoneSignalIPdu05::EgyCnsAvgIndcn_UB,0,-1,1); break;
     Default :
        resultValue = -1;
  }
  
}

on sysvar_update sysvar::DIM::Backbone::Signals::Control::UB::EngHrToSrv_UB_Control
{
  long resultValue;
  
  // --- FR ---
  setBusContext(getBusNameContext(gFR1BusName));
  switch(@this)
  {
     Case(this::SignalUBOFF) :
        resultValue = DisturbUB(Backbone::DIM::DIMBackBoneSignalIPdu05::EngHrToSrv_UB,0,-1,0); break;
     Case(this::SignalUBHandled) :
        resultValue = DisturbUB(Backbone::DIM::DIMBackBoneSignalIPdu05::EngHrToSrv_UB,0,0,0); break;
     Case(this::SignalUBON) :
        resultValue = DisturbUB(Backbone::DIM::DIMBackBoneSignalIPdu05::EngHrToSrv_UB,0,-1,1); break;
     Default :
        resultValue = -1;
  }
  
}

on sysvar_update sysvar::DIM::Backbone::Signals::Control::UB::FuLvlLoIndcn_UB_Control
{
  long resultValue;
  
  // --- FR ---
  setBusContext(getBusNameContext(gFR1BusName));
  switch(@this)
  {
     Case(this::SignalUBOFF) :
        resultValue = DisturbUB(Backbone::DIM::DIMBackBoneSignalIPdu05::FuLvlLoIndcn_UB,0,-1,0); break;
     Case(this::SignalUBHandled) :
        resultValue = DisturbUB(Backbone::DIM::DIMBackBoneSignalIPdu05::FuLvlLoIndcn_UB,0,0,0); break;
     Case(this::SignalUBON) :
        resultValue = DisturbUB(Backbone::DIM::DIMBackBoneSignalIPdu05::FuLvlLoIndcn_UB,0,-1,1); break;
     Default :
        resultValue = -1;
  }
  
}

on sysvar_update sysvar::DIM::Backbone::Signals::Control::UB::FuLvlLoWarn_UB_Control
{
  long resultValue;
  
  // --- FR ---
  setBusContext(getBusNameContext(gFR1BusName));
  switch(@this)
  {
     Case(this::SignalUBOFF) :
        resultValue = DisturbUB(Backbone::DIM::DIMBackBoneSignalIPdu05::FuLvlLoWarn_UB,0,-1,0); break;
     Case(this::SignalUBHandled) :
        resultValue = DisturbUB(Backbone::DIM::DIMBackBoneSignalIPdu05::FuLvlLoWarn_UB,0,0,0); break;
     Case(this::SignalUBON) :
        resultValue = DisturbUB(Backbone::DIM::DIMBackBoneSignalIPdu05::FuLvlLoWarn_UB,0,-1,1); break;
     Default :
        resultValue = -1;
  }
  
}

on sysvar_update sysvar::DIM::Backbone::Signals::Control::UB::NewTripCdn_UB_Control
{
  long resultValue;
  
  // --- FR ---
  setBusContext(getBusNameContext(gFR1BusName));
  switch(@this)
  {
     Case(this::SignalUBOFF) :
        resultValue = DisturbUB(Backbone::DIM::DIMBackBoneSignalIPdu05::NewTripCdn_UB,0,-1,0); break;
     Case(this::SignalUBHandled) :
        resultValue = DisturbUB(Backbone::DIM::DIMBackBoneSignalIPdu05::NewTripCdn_UB,0,0,0); break;
     Case(this::SignalUBON) :
        resultValue = DisturbUB(Backbone::DIM::DIMBackBoneSignalIPdu05::NewTripCdn_UB,0,-1,1); break;
     Default :
        resultValue = -1;
  }
  
}

on sysvar_update sysvar::DIM::Backbone::Signals::Control::UB::NotifChkDistbn_UB_Control
{
  long resultValue;
  
  // --- FR ---
  setBusContext(getBusNameContext(gFR1BusName));
  switch(@this)
  {
     Case(this::SignalUBOFF) :
        resultValue = DisturbUB(Backbone::DIM::DIMBackBoneSignalIPdu05::NotifChkDistbn_UB,0,-1,0); break;
     Case(this::SignalUBHandled) :
        resultValue = DisturbUB(Backbone::DIM::DIMBackBoneSignalIPdu05::NotifChkDistbn_UB,0,0,0); break;
     Case(this::SignalUBON) :
        resultValue = DisturbUB(Backbone::DIM::DIMBackBoneSignalIPdu05::NotifChkDistbn_UB,0,-1,1); break;
     Default :
        resultValue = -1;
  }
  
}

on sysvar_update sysvar::DIM::Backbone::Signals::Control::UB::ReqForPassAirbIndcnAckd_UB_Control
{
  long resultValue;
  
  // --- FR ---
  setBusContext(getBusNameContext(gFR1BusName));
  switch(@this)
  {
     Case(this::SignalUBOFF) :
        resultValue = DisturbUB(Backbone::DIM::DIMBackBoneSignalIPdu05::ReqForPassAirbIndcnAckd_UB,0,-1,0); break;
     Case(this::SignalUBHandled) :
        resultValue = DisturbUB(Backbone::DIM::DIMBackBoneSignalIPdu05::ReqForPassAirbIndcnAckd_UB,0,0,0); break;
     Case(this::SignalUBON) :
        resultValue = DisturbUB(Backbone::DIM::DIMBackBoneSignalIPdu05::ReqForPassAirbIndcnAckd_UB,0,-1,1); break;
     Default :
        resultValue = -1;
  }
  
}

on sysvar_update sysvar::DIM::Backbone::Signals::Control::UB::RstrtAutMovmtSts_UB_Control
{
  long resultValue;
  
  // --- FR ---
  setBusContext(getBusNameContext(gFR1BusName));
  switch(@this)
  {
     Case(this::SignalUBOFF) :
        resultValue = DisturbUB(Backbone::DIM::DIMBackBoneSignalIPdu05::RstrtAutMovmtSts_UB,0,-1,0); break;
     Case(this::SignalUBHandled) :
        resultValue = DisturbUB(Backbone::DIM::DIMBackBoneSignalIPdu05::RstrtAutMovmtSts_UB,0,0,0); break;
     Case(this::SignalUBON) :
        resultValue = DisturbUB(Backbone::DIM::DIMBackBoneSignalIPdu05::RstrtAutMovmtSts_UB,0,-1,1); break;
     Default :
        resultValue = -1;
  }
  
}

on sysvar_update sysvar::DIM::Backbone::Signals::Control::UB::SrvRst_UB_Control
{
  long resultValue;
  
  // --- FR ---
  setBusContext(getBusNameContext(gFR1BusName));
  switch(@this)
  {
     Case(this::SignalUBOFF) :
        resultValue = DisturbUB(Backbone::DIM::DIMBackBoneSignalIPdu05::SrvRst_UB,0,-1,0); break;
     Case(this::SignalUBHandled) :
        resultValue = DisturbUB(Backbone::DIM::DIMBackBoneSignalIPdu05::SrvRst_UB,0,0,0); break;
     Case(this::SignalUBON) :
        resultValue = DisturbUB(Backbone::DIM::DIMBackBoneSignalIPdu05::SrvRst_UB,0,-1,1); break;
     Default :
        resultValue = -1;
  }
  
}

on sysvar_update sysvar::DIM::Backbone::Signals::Control::UB::SrvTrig_UB_Control
{
  long resultValue;
  
  // --- FR ---
  setBusContext(getBusNameContext(gFR1BusName));
  switch(@this)
  {
     Case(this::SignalUBOFF) :
        resultValue = DisturbUB(Backbone::DIM::DIMBackBoneSignalIPdu05::SrvTrig_UB,0,-1,0); break;
     Case(this::SignalUBHandled) :
        resultValue = DisturbUB(Backbone::DIM::DIMBackBoneSignalIPdu05::SrvTrig_UB,0,0,0); break;
     Case(this::SignalUBON) :
        resultValue = DisturbUB(Backbone::DIM::DIMBackBoneSignalIPdu05::SrvTrig_UB,0,-1,1); break;
     Default :
        resultValue = -1;
  }
  
}

on sysvar_update sysvar::DIM::Backbone::Signals::Control::UB::TiGapAdpvSts_UB_Control
{
  long resultValue;
  
  // --- FR ---
  setBusContext(getBusNameContext(gFR1BusName));
  switch(@this)
  {
     Case(this::SignalUBOFF) :
        resultValue = DisturbUB(Backbone::DIM::DIMBackBoneSignalIPdu05::TiGapAdpvSts_UB,0,-1,0); break;
     Case(this::SignalUBHandled) :
        resultValue = DisturbUB(Backbone::DIM::DIMBackBoneSignalIPdu05::TiGapAdpvSts_UB,0,0,0); break;
     Case(this::SignalUBON) :
        resultValue = DisturbUB(Backbone::DIM::DIMBackBoneSignalIPdu05::TiGapAdpvSts_UB,0,-1,1); break;
     Default :
        resultValue = -1;
  }
  
}

on sysvar_update sysvar::DIM::Backbone::Signals::Control::UB::VehSpdIndcdQly_UB_Control
{
  long resultValue;
  
  // --- FR ---
  setBusContext(getBusNameContext(gFR1BusName));
  switch(@this)
  {
     Case(this::SignalUBOFF) :
        resultValue = DisturbUB(Backbone::DIM::DIMBackBoneSignalIPdu05::VehSpdIndcdQly_UB,0,-1,0); break;
     Case(this::SignalUBHandled) :
        resultValue = DisturbUB(Backbone::DIM::DIMBackBoneSignalIPdu05::VehSpdIndcdQly_UB,0,0,0); break;
     Case(this::SignalUBON) :
        resultValue = DisturbUB(Backbone::DIM::DIMBackBoneSignalIPdu05::VehSpdIndcdQly_UB,0,-1,1); break;
     Default :
        resultValue = -1;
  }
  
}

on sysvar_update sysvar::IL_FR1::NODES::N_DIM::EnableNode
{
  ILFR1_Enable(@this && @sysvar::IL_FR1::enable_AllNodes);
}

on sysvar_update sysvar::IL_FR1::enable_AllNodes
{
  ILFR1_Enable(@this && @sysvar::IL_FR1::NODES::N_DIM::EnableNode);
}

on sysvar_update sysvar::NM_FR1::NODES::N_DIM::DeactivateNM
{
  if( @this == 1 || @sysvar::NM_FR1::StateControl::DeactivateNM == 1)
  {
    NMFR1_Enable(0);
  }
  else
  {
    NMFR1_Enable(1);
  }
}

on sysvar_update sysvar::NM_FR1::StateControl::DeactivateNM
{
  if( @this == 1 || @sysvar::NM_FR1::NODES::N_DIM::DeactivateNM == 1)
  {
    NMFR1_Enable(0);
  }
  else
  {
    NMFR1_Enable(1);
  }
}

/* #ChannelEnd# |FR1| #BusEnd# |Backbone| */
//--- end generated part --- Block end <#SysVar_Handler#> do not delete this line! Add application code below this line.

//--- begin generated part --- Block start <#MsgUpdateFcns#> do not delete this line and do not add application code in this code block!
/* #ChannelStart# |FR1| #BusStart# |Backbone| */
/* #ChannelEnd# |FR1| #BusEnd# |Backbone| */
//--- end generated part --- Block end <#MsgUpdateFcns#> do not delete this line! Add application code below this line.

