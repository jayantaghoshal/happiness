includes
{
  // Import required CAPL include files
  //--- begin generated part --- Block start #Hdr_Includes#; do not delete this line and do not add application code in this code block!
  /* #ChannelStart# |FR1| #BusStart# |Backbone| */
  /* #ChannelEnd# |FR1| #BusEnd# |Backbone| */
  //--- end generated part --- Block end #Hdr_Includes#; do not delete this line! Add application code below this line.
  //--- begin generated part --- Block start #Body_Includes#; do not delete this line and do not add application code in this code block!
  /* #ChannelStart# |FR1| #BusStart# |Backbone| */
  #include "..\CAPL\SPA-IL-KL30-Helper_FR1.cin"
  #include "..\CAPL\SPACommon_Common.cin"
  #include "..\Nodes\CEM_Adaptation.cin"
  #include "..\CAPL\SPA-NM-Panel-Helper_FR1.cin"
  #include "..\CAPL\SPA-NM-ASR-Helper_FR1.cin"
  /* #ChannelEnd# |FR1| #BusEnd# |Backbone| */
  //--- end generated part --- Block end #Body_Includes#; do not delete this line! Add application code below this line.
}

variables
{
  // Define global variables for this CAPL file

  /*--- #GenHeader Begin# --- begin generated comment ---
  | Generated on Thursday, februari 15, 2018, 17:11:18
  | By ModelGenerator for SPA 1.0.0.3, ModelGeneratorSPADLL 3.1.1.0
  | Package SPA 3.0.0
  | Target Bus: Backbone; Channel: FR1; DB Cluster: Backbone;
  | From Database: SPA2610_ConfigurationsSPA_Backbone_170920.xml
  | CANoe Version 9.0.133.0
    --- #GenHeader End  # --- end generated comment --- */

  char gECU[256] = "CEM";
  //--- begin generated part --- Block start #Hdr_GlobalVariables#; do not delete this line and do not add application code in this code block!
  /* #ChannelStart# |FR1| #BusStart# |Backbone| */
  /* #ChannelEnd# |FR1| #BusEnd# |Backbone| */
  //--- end generated part --- Block end #Hdr_GlobalVariables#; do not delete this line! Add application code below this line.
  //--- begin generated part --- Block start #Body_GlobalVariables#; do not delete this line and do not add application code in this code block!
  /* #ChannelStart# |FR1| #BusStart# |Backbone| */
  char gFR1BusName[256] = "Backbone";
  int gFR1Channel = 1; //// The channel the bus is attached to
  int gFR1TXEnable = 1; //// enable/disable TX of application messages
  /* #ChannelEnd# |FR1| #BusEnd# |Backbone| */
  //--- end generated part --- Block end #Body_GlobalVariables#; do not delete this line! Add application code below this line.
}

on preStart
{
  // Initialize CAPL includes and node's modules/DLLs
  //--- begin generated part --- Block start #Hdr_OnInit#; do not delete this line and do not add application code in this code block!
  /* #ChannelStart# |FR1| #BusStart# |Backbone| */
  /* #ChannelEnd# |FR1| #BusEnd# |Backbone| */
  //--- end generated part --- Block end #Hdr_OnInit#; do not delete this line! Add application code below this line.
  //--- begin generated part --- Block start #Body_OnInit#; do not delete this line and do not add application code in this code block!
  /* #ChannelStart# |FR1| #BusStart# |Backbone| */
  ILFR1_OnInit();
  NMFR1_OnInit();
  /* #ChannelEnd# |FR1| #BusEnd# |Backbone| */
  //--- end generated part --- Block end #Body_OnInit#; do not delete this line! Add application code below this line.
}

on start
{
  // Start CAPL includes and node's modules/DLLs
  //--- begin generated part --- Block start #Hdr_OnStart#; do not delete this line and do not add application code in this code block!
  /* #ChannelStart# |FR1| #BusStart# |Backbone| */
  /* #ChannelEnd# |FR1| #BusEnd# |Backbone| */
  //--- end generated part --- Block end #Hdr_OnStart#; do not delete this line! Add application code below this line.
  //--- begin generated part --- Block start #Body_OnStart#; do not delete this line and do not add application code in this code block!
  /* #ChannelStart# |FR1| #BusStart# |Backbone| */
  ILFR1_OnStart();
  NMFR1_OnStart();
  /* #ChannelEnd# |FR1| #BusEnd# |Backbone| */
  //--- end generated part --- Block end #Body_OnStart#; do not delete this line! Add application code below this line.
}

on FrPOCState
{
  // Possibly propagate FlexRay POC state of interface to the FlexRay bus control
  //--- begin generated part --- Block start #Hdr_OnFrPOCState#; do not delete this line and do not add application code in this code block!
  /* #ChannelStart# |FR1| #BusStart# |Backbone| */
  /* #ChannelEnd# |FR1| #BusEnd# |Backbone| */
  //--- end generated part --- Block end #Hdr_OnFrPOCState#; do not delete this line! Add application code below this line.
  //--- begin generated part --- Block start #Body_OnFrPOCState#; do not delete this line and do not add application code in this code block!
  /* #ChannelStart# |FR1| #BusStart# |Backbone| */
  NMPFR1_ObservePOCState(this.MsgChannel, this.FR_POCState, this.FR_Info2);
  /* #ChannelEnd# |FR1| #BusEnd# |Backbone| */
  //--- end generated part --- Block end #Body_OnFrPOCState#; do not delete this line! Add application code below this line.
}

on FrSymbol
{
  // Possibly propagate FlexRay symbol reception to the FlexRay bus control
  //--- begin generated part --- Block start #Hdr_OnFrSymbol#; do not delete this line and do not add application code in this code block!
  /* #ChannelStart# |FR1| #BusStart# |Backbone| */
  /* #ChannelEnd# |FR1| #BusEnd# |Backbone| */
  //--- end generated part --- Block end #Hdr_OnFrSymbol#; do not delete this line! Add application code below this line.
  //--- begin generated part --- Block start #Body_OnFrSymbol#; do not delete this line and do not add application code in this code block!
  /* #ChannelStart# |FR1| #BusStart# |Backbone| */
  NMPFR1_ObserveSymbol(this.MsgChannel, this.FR_Symbol, this.FR_ChannelMask, this.FR_Length, this.FR_Cycle);
  /* #ChannelEnd# |FR1| #BusEnd# |Backbone| */
  //--- end generated part --- Block end #Body_OnFrSymbol#; do not delete this line! Add application code below this line.
}

on FRFrameError *
{
  // Possibly propagate FlexRay erroneous frame reception to the FlexRay bus control
  //--- begin generated part --- Block start #Hdr_OnFrFrameError#; do not delete this line and do not add application code in this code block!
  /* #ChannelStart# |FR1| #BusStart# |Backbone| */
  /* #ChannelEnd# |FR1| #BusEnd# |Backbone| */
  //--- end generated part --- Block end #Hdr_OnFrFrameError#; do not delete this line! Add application code below this line.
  //--- begin generated part --- Block start #Body_OnFrFrameError#; do not delete this line and do not add application code in this code block!
  /* #ChannelStart# |FR1| #BusStart# |Backbone| */
  NMPFR1_ObserveFrameError(this.MsgChannel, this.FR_ChannelMask, this.FR_SlotID, this.FR_Cycle, this.FR_Status);
  /* #ChannelEnd# |FR1| #BusEnd# |Backbone| */
  //--- end generated part --- Block end #Body_OnFrFrameError#; do not delete this line! Add application code below this line.
}

on preStop
{
  // Prepare stopping
  //--- begin generated part --- Block start #Hdr_OnStopping#; do not delete this line and do not add application code in this code block!
  /* #ChannelStart# |FR1| #BusStart# |Backbone| */
  /* #ChannelEnd# |FR1| #BusEnd# |Backbone| */
  //--- end generated part --- Block end #Hdr_OnStopping#; do not delete this line! Add application code below this line.
  //--- begin generated part --- Block start #Body_OnStopping#; do not delete this line and do not add application code in this code block!
  /* #ChannelStart# |FR1| #BusStart# |Backbone| */
  /* #ChannelEnd# |FR1| #BusEnd# |Backbone| */
  //--- end generated part --- Block end #Body_OnStopping#; do not delete this line! Add application code below this line.
}

on stopMeasurement
{
  // Stop actions
  //--- begin generated part --- Block start #Hdr_OnStop#; do not delete this line and do not add application code in this code block!
  /* #ChannelStart# |FR1| #BusStart# |Backbone| */
  /* #ChannelEnd# |FR1| #BusEnd# |Backbone| */
  //--- end generated part --- Block end #Hdr_OnStop#; do not delete this line! Add application code below this line.
  //--- begin generated part --- Block start #Body_OnStop#; do not delete this line and do not add application code in this code block!
  /* #ChannelStart# |FR1| #BusStart# |Backbone| */
  /* #ChannelEnd# |FR1| #BusEnd# |Backbone| */
  //--- end generated part --- Block end #Body_OnStop#; do not delete this line! Add application code below this line.
}

on sysvar_update sysvar::IL::Ignition
{
  // Handle system state variable
  //--- begin generated part --- Block start #Hdr_KL15_Ignition#; do not delete this line and do not add application code in this code block!
  /* #ChannelStart# |FR1| #BusStart# |Backbone| */
  /* #ChannelEnd# |FR1| #BusEnd# |Backbone| */
  //--- end generated part --- Block end #Hdr_KL15_Ignition#; do not delete this line! Add application code below this line.
  //--- begin generated part --- Block start #Body_KL15_Ignition#; do not delete this line and do not add application code in this code block!
  /* #ChannelStart# |FR1| #BusStart# |Backbone| */
  ILFR1_OnEnvClamp15(@this);
  /* #ChannelEnd# |FR1| #BusEnd# |Backbone| */
  //--- end generated part --- Block end #Body_KL15_Ignition#; do not delete this line! Add application code below this line.
}

on sysvar_update sysvar::IL::Power
{
  // Handle system state variable
  //--- begin generated part --- Block start #Hdr_KL30_Power#; do not delete this line and do not add application code in this code block!
  /* #ChannelStart# |FR1| #BusStart# |Backbone| */
  /* #ChannelEnd# |FR1| #BusEnd# |Backbone| */
  //--- end generated part --- Block end #Hdr_KL30_Power#; do not delete this line! Add application code below this line.
  //--- begin generated part --- Block start #Body_KL30_Power#; do not delete this line and do not add application code in this code block!
  /* #ChannelStart# |FR1| #BusStart# |Backbone| */
  ILFR1_OnEnvClamp30(@this);
  /* #ChannelEnd# |FR1| #BusEnd# |Backbone| */
  //--- end generated part --- Block end #Body_KL30_Power#; do not delete this line! Add application code below this line.
}

on sysvar_update sysvar::_SPAInternal::VIN::VinBlk
{
  //--- begin generated part --- Block start #Hdr_aModulesSignal_VinBlk_VinBlk#; do not delete this line and do not add application code in this code block!
  /* #ChannelStart# |FR1| #BusStart# |Backbone| */
  /* #ChannelEnd# |FR1| #BusEnd# |Backbone| */
  //--- end generated part --- Block end #Hdr_aModulesSignal_VinBlk_VinBlk#; do not delete this line! Add application code below this line.
  //--- begin generated part --- Block start #Body_aModulesSignal_VinBlk_VinBlk#; do not delete this line and do not add application code in this code block!
  /* #ChannelStart# |FR1| #BusStart# |Backbone| */
  $Backbone::CEMBackBoneSignalIpdu07::VinBlk = @this;
  /* #ChannelEnd# |FR1| #BusEnd# |Backbone| */
  //--- end generated part --- Block end #Body_aModulesSignal_VinBlk_VinBlk#; do not delete this line! Add application code below this line.
}

on sysvar_update sysvar::_SPAInternal::VIN::VinPosn1
{
  //--- begin generated part --- Block start #Hdr_aModulesSignal_VinPosn1_VinPosn1#; do not delete this line and do not add application code in this code block!
  /* #ChannelStart# |FR1| #BusStart# |Backbone| */
  /* #ChannelEnd# |FR1| #BusEnd# |Backbone| */
  //--- end generated part --- Block end #Hdr_aModulesSignal_VinPosn1_VinPosn1#; do not delete this line! Add application code below this line.
  //--- begin generated part --- Block start #Body_aModulesSignal_VinPosn1_VinPosn1#; do not delete this line and do not add application code in this code block!
  /* #ChannelStart# |FR1| #BusStart# |Backbone| */
  $Backbone::CEMBackBoneSignalIpdu07::VinPosn1 = @this;
  /* #ChannelEnd# |FR1| #BusEnd# |Backbone| */
  //--- end generated part --- Block end #Body_aModulesSignal_VinPosn1_VinPosn1#; do not delete this line! Add application code below this line.
}

on sysvar_update sysvar::_SPAInternal::VIN::VinPosn2
{
  //--- begin generated part --- Block start #Hdr_aModulesSignal_VinPosn2_VinPosn2#; do not delete this line and do not add application code in this code block!
  /* #ChannelStart# |FR1| #BusStart# |Backbone| */
  /* #ChannelEnd# |FR1| #BusEnd# |Backbone| */
  //--- end generated part --- Block end #Hdr_aModulesSignal_VinPosn2_VinPosn2#; do not delete this line! Add application code below this line.
  //--- begin generated part --- Block start #Body_aModulesSignal_VinPosn2_VinPosn2#; do not delete this line and do not add application code in this code block!
  /* #ChannelStart# |FR1| #BusStart# |Backbone| */
  $Backbone::CEMBackBoneSignalIpdu07::VinPosn2 = @this;
  /* #ChannelEnd# |FR1| #BusEnd# |Backbone| */
  //--- end generated part --- Block end #Body_aModulesSignal_VinPosn2_VinPosn2#; do not delete this line! Add application code below this line.
}

on sysvar_update sysvar::_SPAInternal::VIN::VinPosn3
{
  //--- begin generated part --- Block start #Hdr_aModulesSignal_VinPosn3_VinPosn3#; do not delete this line and do not add application code in this code block!
  /* #ChannelStart# |FR1| #BusStart# |Backbone| */
  /* #ChannelEnd# |FR1| #BusEnd# |Backbone| */
  //--- end generated part --- Block end #Hdr_aModulesSignal_VinPosn3_VinPosn3#; do not delete this line! Add application code below this line.
  //--- begin generated part --- Block start #Body_aModulesSignal_VinPosn3_VinPosn3#; do not delete this line and do not add application code in this code block!
  /* #ChannelStart# |FR1| #BusStart# |Backbone| */
  $Backbone::CEMBackBoneSignalIpdu07::VinPosn3 = @this;
  /* #ChannelEnd# |FR1| #BusEnd# |Backbone| */
  //--- end generated part --- Block end #Body_aModulesSignal_VinPosn3_VinPosn3#; do not delete this line! Add application code below this line.
}

on sysvar_update sysvar::_SPAInternal::VIN::VinPosn4
{
  //--- begin generated part --- Block start #Hdr_aModulesSignal_VinPosn4_VinPosn4#; do not delete this line and do not add application code in this code block!
  /* #ChannelStart# |FR1| #BusStart# |Backbone| */
  /* #ChannelEnd# |FR1| #BusEnd# |Backbone| */
  //--- end generated part --- Block end #Hdr_aModulesSignal_VinPosn4_VinPosn4#; do not delete this line! Add application code below this line.
  //--- begin generated part --- Block start #Body_aModulesSignal_VinPosn4_VinPosn4#; do not delete this line and do not add application code in this code block!
  /* #ChannelStart# |FR1| #BusStart# |Backbone| */
  $Backbone::CEMBackBoneSignalIpdu07::VinPosn4 = @this;
  /* #ChannelEnd# |FR1| #BusEnd# |Backbone| */
  //--- end generated part --- Block end #Body_aModulesSignal_VinPosn4_VinPosn4#; do not delete this line! Add application code below this line.
}

on sysvar_update sysvar::_SPAInternal::VIN::VinPosn5
{
  //--- begin generated part --- Block start #Hdr_aModulesSignal_VinPosn5_VinPosn5#; do not delete this line and do not add application code in this code block!
  /* #ChannelStart# |FR1| #BusStart# |Backbone| */
  /* #ChannelEnd# |FR1| #BusEnd# |Backbone| */
  //--- end generated part --- Block end #Hdr_aModulesSignal_VinPosn5_VinPosn5#; do not delete this line! Add application code below this line.
  //--- begin generated part --- Block start #Body_aModulesSignal_VinPosn5_VinPosn5#; do not delete this line and do not add application code in this code block!
  /* #ChannelStart# |FR1| #BusStart# |Backbone| */
  $Backbone::CEMBackBoneSignalIpdu07::VinPosn5 = @this;
  /* #ChannelEnd# |FR1| #BusEnd# |Backbone| */
  //--- end generated part --- Block end #Body_aModulesSignal_VinPosn5_VinPosn5#; do not delete this line! Add application code below this line.
}

on sysvar_update sysvar::_SPAInternal::VIN::VinPosn6
{
  //--- begin generated part --- Block start #Hdr_aModulesSignal_VinPosn6_VinPosn6#; do not delete this line and do not add application code in this code block!
  /* #ChannelStart# |FR1| #BusStart# |Backbone| */
  /* #ChannelEnd# |FR1| #BusEnd# |Backbone| */
  //--- end generated part --- Block end #Hdr_aModulesSignal_VinPosn6_VinPosn6#; do not delete this line! Add application code below this line.
  //--- begin generated part --- Block start #Body_aModulesSignal_VinPosn6_VinPosn6#; do not delete this line and do not add application code in this code block!
  /* #ChannelStart# |FR1| #BusStart# |Backbone| */
  $Backbone::CEMBackBoneSignalIpdu07::VinPosn6 = @this;
  /* #ChannelEnd# |FR1| #BusEnd# |Backbone| */
  //--- end generated part --- Block end #Body_aModulesSignal_VinPosn6_VinPosn6#; do not delete this line! Add application code below this line.
}

on sysvar_update sysvar::_SPAInternal::VIN::VinPosn7
{
  //--- begin generated part --- Block start #Hdr_aModulesSignal_VinPosn7_VinPosn7#; do not delete this line and do not add application code in this code block!
  /* #ChannelStart# |FR1| #BusStart# |Backbone| */
  /* #ChannelEnd# |FR1| #BusEnd# |Backbone| */
  //--- end generated part --- Block end #Hdr_aModulesSignal_VinPosn7_VinPosn7#; do not delete this line! Add application code below this line.
  //--- begin generated part --- Block start #Body_aModulesSignal_VinPosn7_VinPosn7#; do not delete this line and do not add application code in this code block!
  /* #ChannelStart# |FR1| #BusStart# |Backbone| */
  $Backbone::CEMBackBoneSignalIpdu07::VinPosn7 = @this;
  /* #ChannelEnd# |FR1| #BusEnd# |Backbone| */
  //--- end generated part --- Block end #Body_aModulesSignal_VinPosn7_VinPosn7#; do not delete this line! Add application code below this line.
}

on sysvar_update sysvar::_SPAInternal::CarConfig::VehCfgPrmBlk
{
  //--- begin generated part --- Block start #Hdr_aModulesSignal_VehCfgPrmBlk_VehCfgPrmBlk#; do not delete this line and do not add application code in this code block!
  /* #ChannelStart# |FR1| #BusStart# |Backbone| */
  /* #ChannelEnd# |FR1| #BusEnd# |Backbone| */
  //--- end generated part --- Block end #Hdr_aModulesSignal_VehCfgPrmBlk_VehCfgPrmBlk#; do not delete this line! Add application code below this line.
  //--- begin generated part --- Block start #Body_aModulesSignal_VehCfgPrmBlk_VehCfgPrmBlk#; do not delete this line and do not add application code in this code block!
  /* #ChannelStart# |FR1| #BusStart# |Backbone| */
  $Backbone::CEMBackBoneSignalIpdu04::VehCfgPrmBlk = @this;
  /* #ChannelEnd# |FR1| #BusEnd# |Backbone| */
  //--- end generated part --- Block end #Body_aModulesSignal_VehCfgPrmBlk_VehCfgPrmBlk#; do not delete this line! Add application code below this line.
}

on sysvar_update sysvar::_SPAInternal::CarConfig::VehCfgPrmVal1
{
  //--- begin generated part --- Block start #Hdr_aModulesSignal_VehCfgPrmVal1_VehCfgPrmVal1#; do not delete this line and do not add application code in this code block!
  /* #ChannelStart# |FR1| #BusStart# |Backbone| */
  /* #ChannelEnd# |FR1| #BusEnd# |Backbone| */
  //--- end generated part --- Block end #Hdr_aModulesSignal_VehCfgPrmVal1_VehCfgPrmVal1#; do not delete this line! Add application code below this line.
  //--- begin generated part --- Block start #Body_aModulesSignal_VehCfgPrmVal1_VehCfgPrmVal1#; do not delete this line and do not add application code in this code block!
  /* #ChannelStart# |FR1| #BusStart# |Backbone| */
  $Backbone::CEMBackBoneSignalIpdu04::VehCfgPrmVal1 = @this;
  /* #ChannelEnd# |FR1| #BusEnd# |Backbone| */
  //--- end generated part --- Block end #Body_aModulesSignal_VehCfgPrmVal1_VehCfgPrmVal1#; do not delete this line! Add application code below this line.
}

on sysvar_update sysvar::_SPAInternal::CarConfig::VehCfgPrmVal2
{
  //--- begin generated part --- Block start #Hdr_aModulesSignal_VehCfgPrmVal2_VehCfgPrmVal2#; do not delete this line and do not add application code in this code block!
  /* #ChannelStart# |FR1| #BusStart# |Backbone| */
  /* #ChannelEnd# |FR1| #BusEnd# |Backbone| */
  //--- end generated part --- Block end #Hdr_aModulesSignal_VehCfgPrmVal2_VehCfgPrmVal2#; do not delete this line! Add application code below this line.
  //--- begin generated part --- Block start #Body_aModulesSignal_VehCfgPrmVal2_VehCfgPrmVal2#; do not delete this line and do not add application code in this code block!
  /* #ChannelStart# |FR1| #BusStart# |Backbone| */
  $Backbone::CEMBackBoneSignalIpdu04::VehCfgPrmVal2 = @this;
  /* #ChannelEnd# |FR1| #BusEnd# |Backbone| */
  //--- end generated part --- Block end #Body_aModulesSignal_VehCfgPrmVal2_VehCfgPrmVal2#; do not delete this line! Add application code below this line.
}

on sysvar_update sysvar::_SPAInternal::CarConfig::VehCfgPrmVal3
{
  //--- begin generated part --- Block start #Hdr_aModulesSignal_VehCfgPrmVal3_VehCfgPrmVal3#; do not delete this line and do not add application code in this code block!
  /* #ChannelStart# |FR1| #BusStart# |Backbone| */
  /* #ChannelEnd# |FR1| #BusEnd# |Backbone| */
  //--- end generated part --- Block end #Hdr_aModulesSignal_VehCfgPrmVal3_VehCfgPrmVal3#; do not delete this line! Add application code below this line.
  //--- begin generated part --- Block start #Body_aModulesSignal_VehCfgPrmVal3_VehCfgPrmVal3#; do not delete this line and do not add application code in this code block!
  /* #ChannelStart# |FR1| #BusStart# |Backbone| */
  $Backbone::CEMBackBoneSignalIpdu04::VehCfgPrmVal3 = @this;
  /* #ChannelEnd# |FR1| #BusEnd# |Backbone| */
  //--- end generated part --- Block end #Body_aModulesSignal_VehCfgPrmVal3_VehCfgPrmVal3#; do not delete this line! Add application code below this line.
}

on sysvar_update sysvar::_SPAInternal::CarConfig::VehCfgPrmVal4
{
  //--- begin generated part --- Block start #Hdr_aModulesSignal_VehCfgPrmVal4_VehCfgPrmVal4#; do not delete this line and do not add application code in this code block!
  /* #ChannelStart# |FR1| #BusStart# |Backbone| */
  /* #ChannelEnd# |FR1| #BusEnd# |Backbone| */
  //--- end generated part --- Block end #Hdr_aModulesSignal_VehCfgPrmVal4_VehCfgPrmVal4#; do not delete this line! Add application code below this line.
  //--- begin generated part --- Block start #Body_aModulesSignal_VehCfgPrmVal4_VehCfgPrmVal4#; do not delete this line and do not add application code in this code block!
  /* #ChannelStart# |FR1| #BusStart# |Backbone| */
  $Backbone::CEMBackBoneSignalIpdu04::VehCfgPrmVal4 = @this;
  /* #ChannelEnd# |FR1| #BusEnd# |Backbone| */
  //--- end generated part --- Block end #Body_aModulesSignal_VehCfgPrmVal4_VehCfgPrmVal4#; do not delete this line! Add application code below this line.
}

on sysvar_update sysvar::_SPAInternal::CarConfig::VehCfgPrmVal5
{
  //--- begin generated part --- Block start #Hdr_aModulesSignal_VehCfgPrmVal5_VehCfgPrmVal5#; do not delete this line and do not add application code in this code block!
  /* #ChannelStart# |FR1| #BusStart# |Backbone| */
  /* #ChannelEnd# |FR1| #BusEnd# |Backbone| */
  //--- end generated part --- Block end #Hdr_aModulesSignal_VehCfgPrmVal5_VehCfgPrmVal5#; do not delete this line! Add application code below this line.
  //--- begin generated part --- Block start #Body_aModulesSignal_VehCfgPrmVal5_VehCfgPrmVal5#; do not delete this line and do not add application code in this code block!
  /* #ChannelStart# |FR1| #BusStart# |Backbone| */
  $Backbone::CEMBackBoneSignalIpdu04::VehCfgPrmVal5 = @this;
  /* #ChannelEnd# |FR1| #BusEnd# |Backbone| */
  //--- end generated part --- Block end #Body_aModulesSignal_VehCfgPrmVal5_VehCfgPrmVal5#; do not delete this line! Add application code below this line.
}

on sysvar_update sysvar::_SPAInternal::CarConfig::VehCfgPrmVal6
{
  //--- begin generated part --- Block start #Hdr_aModulesSignal_VehCfgPrmVal6_VehCfgPrmVal6#; do not delete this line and do not add application code in this code block!
  /* #ChannelStart# |FR1| #BusStart# |Backbone| */
  /* #ChannelEnd# |FR1| #BusEnd# |Backbone| */
  //--- end generated part --- Block end #Hdr_aModulesSignal_VehCfgPrmVal6_VehCfgPrmVal6#; do not delete this line! Add application code below this line.
  //--- begin generated part --- Block start #Body_aModulesSignal_VehCfgPrmVal6_VehCfgPrmVal6#; do not delete this line and do not add application code in this code block!
  /* #ChannelStart# |FR1| #BusStart# |Backbone| */
  $Backbone::CEMBackBoneSignalIpdu04::VehCfgPrmVal6 = @this;
  /* #ChannelEnd# |FR1| #BusEnd# |Backbone| */
  //--- end generated part --- Block end #Body_aModulesSignal_VehCfgPrmVal6_VehCfgPrmVal6#; do not delete this line! Add application code below this line.
}

on sysvar_update sysvar::_SPAInternal::CarConfig::VehCfgPrmVal7
{
  //--- begin generated part --- Block start #Hdr_aModulesSignal_VehCfgPrmVal7_VehCfgPrmVal7#; do not delete this line and do not add application code in this code block!
  /* #ChannelStart# |FR1| #BusStart# |Backbone| */
  /* #ChannelEnd# |FR1| #BusEnd# |Backbone| */
  //--- end generated part --- Block end #Hdr_aModulesSignal_VehCfgPrmVal7_VehCfgPrmVal7#; do not delete this line! Add application code below this line.
  //--- begin generated part --- Block start #Body_aModulesSignal_VehCfgPrmVal7_VehCfgPrmVal7#; do not delete this line and do not add application code in this code block!
  /* #ChannelStart# |FR1| #BusStart# |Backbone| */
  $Backbone::CEMBackBoneSignalIpdu04::VehCfgPrmVal7 = @this;
  /* #ChannelEnd# |FR1| #BusEnd# |Backbone| */
  //--- end generated part --- Block end #Body_aModulesSignal_VehCfgPrmVal7_VehCfgPrmVal7#; do not delete this line! Add application code below this line.
}

on sysvar_update sysvar::_SPAInternal::CarTiGlb::CarTiGlbValue
{
  //--- begin generated part --- Block start #Hdr_aModulesSignal_CarTiGlb_CarTiGlbValue#; do not delete this line and do not add application code in this code block!
  /* #ChannelStart# |FR1| #BusStart# |Backbone| */
  /* #ChannelEnd# |FR1| #BusEnd# |Backbone| */
  //--- end generated part --- Block end #Hdr_aModulesSignal_CarTiGlb_CarTiGlbValue#; do not delete this line! Add application code below this line.
  //--- begin generated part --- Block start #Body_aModulesSignal_CarTiGlb_CarTiGlbValue#; do not delete this line and do not add application code in this code block!
  /* #ChannelStart# |FR1| #BusStart# |Backbone| */
  $Backbone::CEMBackBoneSignalIpdu05::CarTiGlb = @this;
  /* #ChannelEnd# |FR1| #BusEnd# |Backbone| */
  //--- end generated part --- Block end #Body_aModulesSignal_CarTiGlb_CarTiGlbValue#; do not delete this line! Add application code below this line.
}

on sysvar_update sysvar::_SPACommon::GParVehBattU::VehBattUSysU
{
  //--- begin generated part --- Block start #Hdr_aModulesSignal_VehBattUSysU_VehBattUSysU#; do not delete this line and do not add application code in this code block!
  /* #ChannelStart# |FR1| #BusStart# |Backbone| */
  /* #ChannelEnd# |FR1| #BusEnd# |Backbone| */
  //--- end generated part --- Block end #Hdr_aModulesSignal_VehBattUSysU_VehBattUSysU#; do not delete this line! Add application code below this line.
  //--- begin generated part --- Block start #Body_aModulesSignal_VehBattUSysU_VehBattUSysU#; do not delete this line and do not add application code in this code block!
  /* #ChannelStart# |FR1| #BusStart# |Backbone| */
  $Backbone::CEMBackBoneSignalIpdu07::VehBattUSysU = @this;
  /* #ChannelEnd# |FR1| #BusEnd# |Backbone| */
  //--- end generated part --- Block end #Body_aModulesSignal_VehBattUSysU_VehBattUSysU#; do not delete this line! Add application code below this line.
}

on sysvar_update sysvar::_SPACommon::GParTiAndDate::Yr
{
  //--- begin generated part --- Block start #Hdr_aModulesSignal_Yr_Yr#; do not delete this line and do not add application code in this code block!
  /* #ChannelStart# |FR1| #BusStart# |Backbone| */
  /* #ChannelEnd# |FR1| #BusEnd# |Backbone| */
  //--- end generated part --- Block end #Hdr_aModulesSignal_Yr_Yr#; do not delete this line! Add application code below this line.
  //--- begin generated part --- Block start #Body_aModulesSignal_Yr_Yr#; do not delete this line and do not add application code in this code block!
  /* #ChannelStart# |FR1| #BusStart# |Backbone| */
  $Backbone::CEMBackBoneSignalIpdu06::Yr = @this;
  /* #ChannelEnd# |FR1| #BusEnd# |Backbone| */
  //--- end generated part --- Block end #Body_aModulesSignal_Yr_Yr#; do not delete this line! Add application code below this line.
}

on sysvar_update sysvar::_SPACommon::GParTiAndDate::Mth
{
  //--- begin generated part --- Block start #Hdr_aModulesSignal_Mth_Mth#; do not delete this line and do not add application code in this code block!
  /* #ChannelStart# |FR1| #BusStart# |Backbone| */
  /* #ChannelEnd# |FR1| #BusEnd# |Backbone| */
  //--- end generated part --- Block end #Hdr_aModulesSignal_Mth_Mth#; do not delete this line! Add application code below this line.
  //--- begin generated part --- Block start #Body_aModulesSignal_Mth_Mth#; do not delete this line and do not add application code in this code block!
  /* #ChannelStart# |FR1| #BusStart# |Backbone| */
  $Backbone::CEMBackBoneSignalIpdu06::Mth = @this;
  /* #ChannelEnd# |FR1| #BusEnd# |Backbone| */
  //--- end generated part --- Block end #Body_aModulesSignal_Mth_Mth#; do not delete this line! Add application code below this line.
}

on sysvar_update sysvar::_SPACommon::GParTiAndDate::Day
{
  //--- begin generated part --- Block start #Hdr_aModulesSignal_Day_Day#; do not delete this line and do not add application code in this code block!
  /* #ChannelStart# |FR1| #BusStart# |Backbone| */
  /* #ChannelEnd# |FR1| #BusEnd# |Backbone| */
  //--- end generated part --- Block end #Hdr_aModulesSignal_Day_Day#; do not delete this line! Add application code below this line.
  //--- begin generated part --- Block start #Body_aModulesSignal_Day_Day#; do not delete this line and do not add application code in this code block!
  /* #ChannelStart# |FR1| #BusStart# |Backbone| */
  $Backbone::CEMBackBoneSignalIpdu06::Day = @this;
  /* #ChannelEnd# |FR1| #BusEnd# |Backbone| */
  //--- end generated part --- Block end #Body_aModulesSignal_Day_Day#; do not delete this line! Add application code below this line.
}

on sysvar_update sysvar::_SPACommon::GParTiAndDate::Hr
{
  //--- begin generated part --- Block start #Hdr_aModulesSignal_Hr_Hr#; do not delete this line and do not add application code in this code block!
  /* #ChannelStart# |FR1| #BusStart# |Backbone| */
  /* #ChannelEnd# |FR1| #BusEnd# |Backbone| */
  //--- end generated part --- Block end #Hdr_aModulesSignal_Hr_Hr#; do not delete this line! Add application code below this line.
  //--- begin generated part --- Block start #Body_aModulesSignal_Hr_Hr#; do not delete this line and do not add application code in this code block!
  /* #ChannelStart# |FR1| #BusStart# |Backbone| */
  $Backbone::CEMBackBoneSignalIpdu06::Hr = @this;
  /* #ChannelEnd# |FR1| #BusEnd# |Backbone| */
  //--- end generated part --- Block end #Body_aModulesSignal_Hr_Hr#; do not delete this line! Add application code below this line.
}

on sysvar_update sysvar::_SPACommon::GParTiAndDate::Mins
{
  //--- begin generated part --- Block start #Hdr_aModulesSignal_Mins_Mins#; do not delete this line and do not add application code in this code block!
  /* #ChannelStart# |FR1| #BusStart# |Backbone| */
  /* #ChannelEnd# |FR1| #BusEnd# |Backbone| */
  //--- end generated part --- Block end #Hdr_aModulesSignal_Mins_Mins#; do not delete this line! Add application code below this line.
  //--- begin generated part --- Block start #Body_aModulesSignal_Mins_Mins#; do not delete this line and do not add application code in this code block!
  /* #ChannelStart# |FR1| #BusStart# |Backbone| */
  $Backbone::CEMBackBoneSignalIpdu06::Mins = @this;
  /* #ChannelEnd# |FR1| #BusEnd# |Backbone| */
  //--- end generated part --- Block end #Body_aModulesSignal_Mins_Mins#; do not delete this line! Add application code below this line.
}

on sysvar_update sysvar::_SPACommon::GParTiAndDate::Sec
{
  //--- begin generated part --- Block start #Hdr_aModulesSignal_Sec_Sec#; do not delete this line and do not add application code in this code block!
  /* #ChannelStart# |FR1| #BusStart# |Backbone| */
  /* #ChannelEnd# |FR1| #BusEnd# |Backbone| */
  //--- end generated part --- Block end #Hdr_aModulesSignal_Sec_Sec#; do not delete this line! Add application code below this line.
  //--- begin generated part --- Block start #Body_aModulesSignal_Sec_Sec#; do not delete this line and do not add application code in this code block!
  /* #ChannelStart# |FR1| #BusStart# |Backbone| */
  $Backbone::CEMBackBoneSignalIpdu06::Sec = @this;
  /* #ChannelEnd# |FR1| #BusEnd# |Backbone| */
  //--- end generated part --- Block end #Body_aModulesSignal_Sec_Sec#; do not delete this line! Add application code below this line.
}

on sysvar_update sysvar::_SPACommon::GParTiAndDate::TiAndDateVld
{
  //--- begin generated part --- Block start #Hdr_aModulesSignal_TiAndDateVld_TiAndDateVld#; do not delete this line and do not add application code in this code block!
  /* #ChannelStart# |FR1| #BusStart# |Backbone| */
  /* #ChannelEnd# |FR1| #BusEnd# |Backbone| */
  //--- end generated part --- Block end #Hdr_aModulesSignal_TiAndDateVld_TiAndDateVld#; do not delete this line! Add application code below this line.
  //--- begin generated part --- Block start #Body_aModulesSignal_TiAndDateVld_TiAndDateVld#; do not delete this line and do not add application code in this code block!
  /* #ChannelStart# |FR1| #BusStart# |Backbone| */
  $Backbone::CEMBackBoneSignalIpdu06::TiAndDateVld = @this;
  /* #ChannelEnd# |FR1| #BusEnd# |Backbone| */
  //--- end generated part --- Block end #Body_aModulesSignal_TiAndDateVld_TiAndDateVld#; do not delete this line! Add application code below this line.
}

on sysvar_update sysvar::IL::UBPlugNPlay
{
  // Handle system state variable
  //--- begin generated part --- Block start #Hdr_UBOpMode_UBPlugNPlay#; do not delete this line and do not add application code in this code block!
  /* #ChannelStart# |FR1| #BusStart# |Backbone| */
  /* #ChannelEnd# |FR1| #BusEnd# |Backbone| */
  //--- end generated part --- Block end #Hdr_UBOpMode_UBPlugNPlay#; do not delete this line! Add application code below this line.
  //--- begin generated part --- Block start #Body_UBOpMode_UBPlugNPlay#; do not delete this line and do not add application code in this code block!
  /* #ChannelStart# |FR1| #BusStart# |Backbone| */
  /* #ChannelEnd# |FR1| #BusEnd# |Backbone| */
  //--- end generated part --- Block end #Body_UBOpMode_UBPlugNPlay#; do not delete this line! Add application code below this line.
}

void Nm_NetworkStartInd()
{
  // Callback of CAN AUTOSAR NM DLL
  dword lBusContext;
  //--- begin generated part --- Block start #Hdr_Nm_NetworkStartInd#; do not delete this line and do not add application code in this code block!
  /* #ChannelStart# |FR1| #BusStart# |Backbone| */
  /* #ChannelEnd# |FR1| #BusEnd# |Backbone| */
  //--- end generated part --- Block end #Hdr_Nm_NetworkStartInd#; do not delete this line! Add application code below this line.
  lBusContext = GetBusContext();
  //--- begin generated part --- Block start #Body_Nm_NetworkStartInd#; do not delete this line and do not add application code in this code block!
  /* #ChannelStart# |FR1| #BusStart# |Backbone| */
  /* #ChannelEnd# |FR1| #BusEnd# |Backbone| */
  //--- end generated part --- Block end #Body_Nm_NetworkStartInd#; do not delete this line! Add application code below this line.
  SetBusContext(lBusContext);
}

void Nm_NetworkModeInd()
{
  // Callback of CAN AUTOSAR NM DLL
  dword lBusContext;
  //--- begin generated part --- Block start #Hdr_Nm_NetworkModeInd#; do not delete this line and do not add application code in this code block!
  /* #ChannelStart# |FR1| #BusStart# |Backbone| */
  /* #ChannelEnd# |FR1| #BusEnd# |Backbone| */
  //--- end generated part --- Block end #Hdr_Nm_NetworkModeInd#; do not delete this line! Add application code below this line.
  lBusContext = GetBusContext();
  //--- begin generated part --- Block start #Body_Nm_NetworkModeInd#; do not delete this line and do not add application code in this code block!
  /* #ChannelStart# |FR1| #BusStart# |Backbone| */
  /* #ChannelEnd# |FR1| #BusEnd# |Backbone| */
  //--- end generated part --- Block end #Body_Nm_NetworkModeInd#; do not delete this line! Add application code below this line.
  SetBusContext(lBusContext);
}

void Nm_NetworkTimeoutInd()
{
  // Callback of CAN AUTOSAR NM DLL
  dword lBusContext;
  //--- begin generated part --- Block start #Hdr_Nm_NetworkTimeoutInd#; do not delete this line and do not add application code in this code block!
  /* #ChannelStart# |FR1| #BusStart# |Backbone| */
  /* #ChannelEnd# |FR1| #BusEnd# |Backbone| */
  //--- end generated part --- Block end #Hdr_Nm_NetworkTimeoutInd#; do not delete this line! Add application code below this line.
  lBusContext = GetBusContext();
  //--- begin generated part --- Block start #Body_Nm_NetworkTimeoutInd#; do not delete this line and do not add application code in this code block!
  /* #ChannelStart# |FR1| #BusStart# |Backbone| */
  /* #ChannelEnd# |FR1| #BusEnd# |Backbone| */
  //--- end generated part --- Block end #Body_Nm_NetworkTimeoutInd#; do not delete this line! Add application code below this line.
  SetBusContext(lBusContext);
}

void Nm_PrepareBusSleepModeInd()
{
  // Callback of CAN AUTOSAR NM DLL
  dword lBusContext;
  //--- begin generated part --- Block start #Hdr_Nm_PrepareBusSleepModeInd#; do not delete this line and do not add application code in this code block!
  /* #ChannelStart# |FR1| #BusStart# |Backbone| */
  /* #ChannelEnd# |FR1| #BusEnd# |Backbone| */
  //--- end generated part --- Block end #Hdr_Nm_PrepareBusSleepModeInd#; do not delete this line! Add application code below this line.
  lBusContext = GetBusContext();
  //--- begin generated part --- Block start #Body_Nm_PrepareBusSleepModeInd#; do not delete this line and do not add application code in this code block!
  /* #ChannelStart# |FR1| #BusStart# |Backbone| */
  /* #ChannelEnd# |FR1| #BusEnd# |Backbone| */
  //--- end generated part --- Block end #Body_Nm_PrepareBusSleepModeInd#; do not delete this line! Add application code below this line.
  SetBusContext(lBusContext);
}

void Nm_BusSleepModeInd()
{
  // Callback of CAN AUTOSAR NM DLL
  dword lBusContext;
  //--- begin generated part --- Block start #Hdr_Nm_BusSleepModeInd#; do not delete this line and do not add application code in this code block!
  /* #ChannelStart# |FR1| #BusStart# |Backbone| */
  /* #ChannelEnd# |FR1| #BusEnd# |Backbone| */
  //--- end generated part --- Block end #Hdr_Nm_BusSleepModeInd#; do not delete this line! Add application code below this line.
  lBusContext = GetBusContext();
  //--- begin generated part --- Block start #Body_Nm_BusSleepModeInd#; do not delete this line and do not add application code in this code block!
  /* #ChannelStart# |FR1| #BusStart# |Backbone| */
  /* #ChannelEnd# |FR1| #BusEnd# |Backbone| */
  //--- end generated part --- Block end #Body_Nm_BusSleepModeInd#; do not delete this line! Add application code below this line.
  SetBusContext(lBusContext);
}

void Nm_StateChangeNotification(long previousState, long currentState)
{
  // Callback of CAN AUTOSAR NM DLL
  dword lBusContext;
  //--- begin generated part --- Block start #Hdr_Nm_StateChangeNotification#; do not delete this line and do not add application code in this code block!
  /* #ChannelStart# |FR1| #BusStart# |Backbone| */
  /* #ChannelEnd# |FR1| #BusEnd# |Backbone| */
  //--- end generated part --- Block end #Hdr_Nm_StateChangeNotification#; do not delete this line! Add application code below this line.
  lBusContext = GetBusContext();
  //--- begin generated part --- Block start #Body_Nm_StateChangeNotification#; do not delete this line and do not add application code in this code block!
  /* #ChannelStart# |FR1| #BusStart# |Backbone| */
  /* #ChannelEnd# |FR1| #BusEnd# |Backbone| */
  //--- end generated part --- Block end #Body_Nm_StateChangeNotification#; do not delete this line! Add application code below this line.
  SetBusContext(lBusContext);
}

void FrNm_NetworkStartInd()
{
  // Callback of FlexRay AUTOSAR NM DLL
  dword lBusContext;
  //--- begin generated part --- Block start #Hdr_FrNm_NetworkStartInd#; do not delete this line and do not add application code in this code block!
  /* #ChannelStart# |FR1| #BusStart# |Backbone| */
  /* #ChannelEnd# |FR1| #BusEnd# |Backbone| */
  //--- end generated part --- Block end #Hdr_FrNm_NetworkStartInd#; do not delete this line! Add application code below this line.
  lBusContext = GetBusContext();
  //--- begin generated part --- Block start #Body_FrNm_NetworkStartInd#; do not delete this line and do not add application code in this code block!
  /* #ChannelStart# |FR1| #BusStart# |Backbone| */
  if (lBusContext == gNMFR1_BusContext) NMFR1_IndNetworkStart();
  /* #ChannelEnd# |FR1| #BusEnd# |Backbone| */
  //--- end generated part --- Block end #Body_FrNm_NetworkStartInd#; do not delete this line! Add application code below this line.
  SetBusContext(lBusContext);
}

void FrNm_NetworkModeInd()
{
  // Callback of FlexRay AUTOSAR NM DLL
  dword lBusContext;
  //--- begin generated part --- Block start #Hdr_FrNm_NetworkModeInd#; do not delete this line and do not add application code in this code block!
  /* #ChannelStart# |FR1| #BusStart# |Backbone| */
  /* #ChannelEnd# |FR1| #BusEnd# |Backbone| */
  //--- end generated part --- Block end #Hdr_FrNm_NetworkModeInd#; do not delete this line! Add application code below this line.
  lBusContext = GetBusContext();
  //--- begin generated part --- Block start #Body_FrNm_NetworkModeInd#; do not delete this line and do not add application code in this code block!
  /* #ChannelStart# |FR1| #BusStart# |Backbone| */
  if (lBusContext == gNMFR1_BusContext) NMFR1_IndNetworkMode();
  /* #ChannelEnd# |FR1| #BusEnd# |Backbone| */
  //--- end generated part --- Block end #Body_FrNm_NetworkModeInd#; do not delete this line! Add application code below this line.
  SetBusContext(lBusContext);
}

void FrNm_NetworkTimeoutInd()
{
  // Callback of FlexRay AUTOSAR NM DLL
  dword lBusContext;
  //--- begin generated part --- Block start #Hdr_FrNm_NetworkTimeoutInd#; do not delete this line and do not add application code in this code block!
  /* #ChannelStart# |FR1| #BusStart# |Backbone| */
  /* #ChannelEnd# |FR1| #BusEnd# |Backbone| */
  //--- end generated part --- Block end #Hdr_FrNm_NetworkTimeoutInd#; do not delete this line! Add application code below this line.
  lBusContext = GetBusContext();
  //--- begin generated part --- Block start #Body_FrNm_NetworkTimeoutInd#; do not delete this line and do not add application code in this code block!
  /* #ChannelStart# |FR1| #BusStart# |Backbone| */
  if (lBusContext == gNMFR1_BusContext) NMFR1_IndNetworkTimeout();
  /* #ChannelEnd# |FR1| #BusEnd# |Backbone| */
  //--- end generated part --- Block end #Body_FrNm_NetworkTimeoutInd#; do not delete this line! Add application code below this line.
  SetBusContext(lBusContext);
}

void FrNm_BusSleepModeInd()
{
  // Callback of FlexRay AUTOSAR NM DLL
  dword lBusContext;
  //--- begin generated part --- Block start #Hdr_FrNm_BusSleepModeInd#; do not delete this line and do not add application code in this code block!
  /* #ChannelStart# |FR1| #BusStart# |Backbone| */
  /* #ChannelEnd# |FR1| #BusEnd# |Backbone| */
  //--- end generated part --- Block end #Hdr_FrNm_BusSleepModeInd#; do not delete this line! Add application code below this line.
  lBusContext = GetBusContext();
  //--- begin generated part --- Block start #Body_FrNm_BusSleepModeInd#; do not delete this line and do not add application code in this code block!
  /* #ChannelStart# |FR1| #BusStart# |Backbone| */
  if (lBusContext == gNMFR1_BusContext) NMFR1_IndBusSleepMode();
  /* #ChannelEnd# |FR1| #BusEnd# |Backbone| */
  //--- end generated part --- Block end #Body_FrNm_BusSleepModeInd#; do not delete this line! Add application code below this line.
  SetBusContext(lBusContext);
}

void FrNm_StateChangeNotification(long previousState, long currentState)
{
  // Callback of FlexRay AUTOSAR NM DLL
  dword lBusContext;
  //--- begin generated part --- Block start #Hdr_FrNm_StateChangeNotification#; do not delete this line and do not add application code in this code block!
  /* #ChannelStart# |FR1| #BusStart# |Backbone| */
  /* #ChannelEnd# |FR1| #BusEnd# |Backbone| */
  //--- end generated part --- Block end #Hdr_FrNm_StateChangeNotification#; do not delete this line! Add application code below this line.
  lBusContext = GetBusContext();
  //--- begin generated part --- Block start #Body_FrNm_StateChangeNotification#; do not delete this line and do not add application code in this code block!
  /* #ChannelStart# |FR1| #BusStart# |Backbone| */
  if (lBusContext == gNMFR1_BusContext) NMFR1_IndStateChangeNotification(previousState, currentState);
  /* #ChannelEnd# |FR1| #BusEnd# |Backbone| */
  //--- end generated part --- Block end #Body_FrNm_StateChangeNotification#; do not delete this line! Add application code below this line.
  SetBusContext(lBusContext);
}

void FrNm_SynchronizeModeInd()
{
  // Callback of FlexRay AUTOSAR NM DLL
  dword lBusContext;
  //--- begin generated part --- Block start #Hdr_FrNm_SynchronizeModeInd#; do not delete this line and do not add application code in this code block!
  /* #ChannelStart# |FR1| #BusStart# |Backbone| */
  /* #ChannelEnd# |FR1| #BusEnd# |Backbone| */
  //--- end generated part --- Block end #Hdr_FrNm_SynchronizeModeInd#; do not delete this line! Add application code below this line.
  lBusContext = GetBusContext();
  //--- begin generated part --- Block start #Body_FrNm_SynchronizeModeInd#; do not delete this line and do not add application code in this code block!
  /* #ChannelStart# |FR1| #BusStart# |Backbone| */
  if (lBusContext == gNMFR1_BusContext) NMFR1_IndSynchronizeMode();
  /* #ChannelEnd# |FR1| #BusEnd# |Backbone| */
  //--- end generated part --- Block end #Body_FrNm_SynchronizeModeInd#; do not delete this line! Add application code below this line.
  SetBusContext(lBusContext);
}

void StartSim(dword busContext, int busActive, int mode)
{
  //--- begin generated part --- Block start #Hdr_StartSim#; do not delete this line and do not add application code in this code block!
  /* #ChannelStart# |FR1| #BusStart# |Backbone| */
  /* #ChannelEnd# |FR1| #BusEnd# |Backbone| */
  //--- end generated part --- Block end #Hdr_StartSim#; do not delete this line! Add application code below this line.
  //--- begin generated part --- Block start #Body_StartSim#; do not delete this line and do not add application code in this code block!
  /* #ChannelStart# |FR1| #BusStart# |Backbone| */
  /* #ChannelEnd# |FR1| #BusEnd# |Backbone| */
  //--- end generated part --- Block end #Body_StartSim#; do not delete this line! Add application code below this line.
}

void StopSim(dword busContext, int busActive, int mode)
{
  //--- begin generated part --- Block start #Hdr_StopSim#; do not delete this line and do not add application code in this code block!
  /* #ChannelStart# |FR1| #BusStart# |Backbone| */
  /* #ChannelEnd# |FR1| #BusEnd# |Backbone| */
  //--- end generated part --- Block end #Hdr_StopSim#; do not delete this line! Add application code below this line.
  //--- begin generated part --- Block start #Body_StopSim#; do not delete this line and do not add application code in this code block!
  /* #ChannelStart# |FR1| #BusStart# |Backbone| */
  /* #ChannelEnd# |FR1| #BusEnd# |Backbone| */
  //--- end generated part --- Block end #Body_StopSim#; do not delete this line! Add application code below this line.
}

void FrILTxPending(char pduName[], long len, byte payload[], long TxAck)
{
  //--- begin generated part --- Block start #Hdr_FrILTxPending#; do not delete this line and do not add application code in this code block!
  /* #ChannelStart# |FR1| #BusStart# |Backbone| */
  /* #ChannelEnd# |FR1| #BusEnd# |Backbone| */
  //--- end generated part --- Block end #Hdr_FrILTxPending#; do not delete this line! Add application code below this line.
  //--- begin generated part --- Block start #Body_FrILTxPending#; do not delete this line and do not add application code in this code block!
  /* #ChannelStart# |FR1| #BusStart# |Backbone| */
  /* #ChannelEnd# |FR1| #BusEnd# |Backbone| */
  //--- end generated part --- Block end #Body_FrILTxPending#; do not delete this line! Add application code below this line.
}

dword applILTxPending(long aId, dword aDlc, byte data[])
{
  dword ret = 1;
  //--- begin generated part --- Block start #Hdr_applILTxPending#; do not delete this line and do not add application code in this code block!
  /* #ChannelStart# |FR1| #BusStart# |Backbone| */
  /* #ChannelEnd# |FR1| #BusEnd# |Backbone| */
  //--- end generated part --- Block end #Hdr_applILTxPending#; do not delete this line! Add application code below this line.
  //--- begin generated part --- Block start #Body_applILTxPending#; do not delete this line and do not add application code in this code block!
  /* #ChannelStart# |FR1| #BusStart# |Backbone| */
  /* #ChannelEnd# |FR1| #BusEnd# |Backbone| */
  //--- end generated part --- Block end #Body_applILTxPending#; do not delete this line! Add application code below this line.
  return ret;
}

on sysvar_update sysvar::CEM::Common::Control::SimulationControl
{
  //--- begin generated part --- Block start #Hdr_Name_SimulationControl#; do not delete this line and do not add application code in this code block!
  /* #ChannelStart# |FR1| #BusStart# |Backbone| */
  /* #ChannelEnd# |FR1| #BusEnd# |Backbone| */
  //--- end generated part --- Block end #Hdr_Name_SimulationControl#; do not delete this line! Add application code below this line.
  //--- begin generated part --- Block start #Body_Name_SimulationControl#; do not delete this line and do not add application code in this code block!
  /* #ChannelStart# |FR1| #BusStart# |Backbone| */
  setBusContext(getBusNameContext(gFR1BusName));
  @sysvar::IL_FR1::NODES::N_CEM::EnableNode = @this;
  /* #ChannelEnd# |FR1| #BusEnd# |Backbone| */
  //--- end generated part --- Block end #Body_Name_SimulationControl#; do not delete this line! Add application code below this line.
}

on sysvar_update sysvar::CEM::Common::Control::E2EUBMode
{
  int controlValue;
  long resultValue;
  
  //--- begin generated part --- Block start #Hdr_Name_E2EUBMode#; do not delete this line and do not add application code in this code block!
  /* #ChannelStart# |FR1| #BusStart# |Backbone| */
  /* #ChannelEnd# |FR1| #BusEnd# |Backbone| */
  //--- end generated part --- Block end #Hdr_Name_E2EUBMode#; do not delete this line! Add application code below this line.
  //--- begin generated part --- Block start #Body_Name_E2EUBMode#; do not delete this line and do not add application code in this code block!
  /* #ChannelStart# |FR1| #BusStart# |Backbone| */
  controlValue = (int) @this;
  setBusContext(getBusNameContext(gFR1BusName));
  switch(controlValue)
  {
     Case(this::NodeReal) :
        resultValue = SetOperationMode(1,0); break;
     Case(this::NodePnP) :
        resultValue = SetOperationMode(1,1); break;
     Default :
        resultValue = -1;
  }
  
  /* #ChannelEnd# |FR1| #BusEnd# |Backbone| */
  //--- end generated part --- Block end #Body_Name_E2EUBMode#; do not delete this line! Add application code below this line.
}

on sysvar_update sysvar::CEM::Common::Control::UB
{
  int controlValue;
  long resultValue;
  
  //--- begin generated part --- Block start #Hdr_Name_UB#; do not delete this line and do not add application code in this code block!
  /* #ChannelStart# |FR1| #BusStart# |Backbone| */
  /* #ChannelEnd# |FR1| #BusEnd# |Backbone| */
  //--- end generated part --- Block end #Hdr_Name_UB#; do not delete this line! Add application code below this line.
  //--- begin generated part --- Block start #Body_Name_UB#; do not delete this line and do not add application code in this code block!
  /* #ChannelStart# |FR1| #BusStart# |Backbone| */
  controlValue = (int) @this;
  setBusContext(getBusNameContext(gFR1BusName));
  switch(controlValue)
  {
     Case(this::NodeUBOFF) :
        resultValue = DisturbUB(0,0,-1,0); break;
     Case(this::NodeUBHandled) :
        resultValue = DisturbUB(0,0,0,0); break;
     Case(this::NodeUBON) :
        resultValue = DisturbUB(0,0,-1,1); break;
     Default :
        resultValue = -1;
  }
  
  /* #ChannelEnd# |FR1| #BusEnd# |Backbone| */
  //--- end generated part --- Block end #Body_Name_UB#; do not delete this line! Add application code below this line.
}

//--- begin generated part --- Block start <#Helper_Functions#> do not delete this line and do not add application code in this code block!
/* #ChannelStart# |FR1| #BusStart# |Backbone| */
/* #ChannelEnd# |FR1| #BusEnd# |Backbone| */
//--- end generated part --- Block end <#Helper_Functions#> do not delete this line! Add application code below this line.

//--- begin generated part --- Block start <#SysVar_Handler#> do not delete this line and do not add application code in this code block!
/* #ChannelStart# |FR1| #BusStart# |Backbone| */
on sysvar_update sysvar::CEM::Backbone::SignalGroups::Control::E2E::VehModMngtGlbSafe1Chks_Control
{
  int controlValue;
  long resultValue;
  
  // --- FR ---
  controlValue = (int) @this;
  setBusContext(getBusNameContext(gFR1BusName));
  switch(controlValue)
  {
     Case(this::ChksHandled) :
        resultValue = EnableCRC("VehModMngtGlbSafe1", 1); break;
     Case(this::ChksManual) :
        resultValue = EnableCRC("VehModMngtGlbSafe1", 0); break;
     Default :
        resultValue = -1;
  }
  
}

on sysvar_update sysvar::CEM::Backbone::SignalGroups::Control::E2E::VehModMngtGlbSafe1Cntr_Control
{
  int controlValue;
  long resultValue;
  
  // --- FR ---
  controlValue = (int) @this;
  setBusContext(getBusNameContext(gFR1BusName));
  switch(controlValue)
  {
     Case(this::CntrHandled) :
        resultValue = EnableCounter ("VehModMngtGlbSafe1", 1); break;
     Case(this::CntrManual) :
        resultValue = EnableCounter ("VehModMngtGlbSafe1", 0); break;
     Default :
        resultValue = -1;
  }
  
}

on sysvar_update sysvar::CEM::Backbone::SignalGroups::Control::E2E::IndcrTypExtReqChks_Control
{
  int controlValue;
  long resultValue;
  
  // --- FR ---
  controlValue = (int) @this;
  setBusContext(getBusNameContext(gFR1BusName));
  switch(controlValue)
  {
     Case(this::ChksHandled) :
        resultValue = EnableCRC("IndcrTurnReq", 1); break;
     Case(this::ChksManual) :
        resultValue = EnableCRC("IndcrTurnReq", 0); break;
     Default :
        resultValue = -1;
  }
  
}

on sysvar_update sysvar::CEM::Backbone::SignalGroups::Control::E2E::IndcrTypExtReqCntr_Control
{
  int controlValue;
  long resultValue;
  
  // --- FR ---
  controlValue = (int) @this;
  setBusContext(getBusNameContext(gFR1BusName));
  switch(controlValue)
  {
     Case(this::CntrHandled) :
        resultValue = EnableCounter ("IndcrTurnReq", 1); break;
     Case(this::CntrManual) :
        resultValue = EnableCounter ("IndcrTurnReq", 0); break;
     Default :
        resultValue = -1;
  }
  
}

on sysvar_update sysvar::CEM::Backbone::Signals::Control::UB::HvacEvaprTFrntGroup_UB_Control
{
  long resultValue;
  
  // --- FR ---
  setBusContext(getBusNameContext(gFR1BusName));
  switch(@this)
  {
     Case(this::SignalUBOFF) :
        resultValue = DisturbUB(Backbone::CEM::CEMBackBoneSignalIpdu01::HvacEvaprTFrntGroup_UB,0,-1,0); break;
     Case(this::SignalUBHandled) :
        resultValue = DisturbUB(Backbone::CEM::CEMBackBoneSignalIpdu01::HvacEvaprTFrntGroup_UB,0,0,0); break;
     Case(this::SignalUBON) :
        resultValue = DisturbUB(Backbone::CEM::CEMBackBoneSignalIpdu01::HvacEvaprTFrntGroup_UB,0,-1,1); break;
     Default :
        resultValue = -1;
  }
  
}

on sysvar_update sysvar::CEM::Backbone::Signals::Control::UB::IndcrTurnReq_UB_Control
{
  long resultValue;
  
  // --- FR ---
  setBusContext(getBusNameContext(gFR1BusName));
  switch(@this)
  {
     Case(this::SignalUBOFF) :
        resultValue = DisturbUB(Backbone::CEM::CEMBackBoneSignalIpdu01::IndcrTurnReq_UB,0,-1,0); break;
     Case(this::SignalUBHandled) :
        resultValue = DisturbUB(Backbone::CEM::CEMBackBoneSignalIpdu01::IndcrTurnReq_UB,0,0,0); break;
     Case(this::SignalUBON) :
        resultValue = DisturbUB(Backbone::CEM::CEMBackBoneSignalIpdu01::IndcrTurnReq_UB,0,-1,1); break;
     Default :
        resultValue = -1;
  }
  
}

on sysvar_update sysvar::CEM::Backbone::Signals::Control::UB::VehModMngtGlbSafe1_UB_Control
{
  long resultValue;
  
  // --- FR ---
  setBusContext(getBusNameContext(gFR1BusName));
  switch(@this)
  {
     Case(this::SignalUBOFF) :
        resultValue = DisturbUB(Backbone::CEM::CEMBackBoneSignalIpdu01::VehModMngtGlbSafe1_UB,0,-1,0); break;
     Case(this::SignalUBHandled) :
        resultValue = DisturbUB(Backbone::CEM::CEMBackBoneSignalIpdu01::VehModMngtGlbSafe1_UB,0,0,0); break;
     Case(this::SignalUBON) :
        resultValue = DisturbUB(Backbone::CEM::CEMBackBoneSignalIpdu01::VehModMngtGlbSafe1_UB,0,-1,1); break;
     Default :
        resultValue = -1;
  }
  
}

on sysvar_update sysvar::CEM::Backbone::Signals::Control::UB::ChrgHndlStrtEna_UB_Control
{
  long resultValue;
  
  // --- FR ---
  setBusContext(getBusNameContext(gFR1BusName));
  switch(@this)
  {
     Case(this::SignalUBOFF) :
        resultValue = DisturbUB(Backbone::CEM::CEMBackBoneSignalIpdu01::ChrgHndlStrtEna_UB,0,-1,0); break;
     Case(this::SignalUBHandled) :
        resultValue = DisturbUB(Backbone::CEM::CEMBackBoneSignalIpdu01::ChrgHndlStrtEna_UB,0,0,0); break;
     Case(this::SignalUBON) :
        resultValue = DisturbUB(Backbone::CEM::CEMBackBoneSignalIpdu01::ChrgHndlStrtEna_UB,0,-1,1); break;
     Default :
        resultValue = -1;
  }
  
}

on sysvar_update sysvar::CEM::Backbone::Signals::Control::UB::DoorDrvrSts_UB_Control
{
  long resultValue;
  
  // --- FR ---
  setBusContext(getBusNameContext(gFR1BusName));
  switch(@this)
  {
     Case(this::SignalUBOFF) :
        resultValue = DisturbUB(Backbone::CEM::CEMBackBoneSignalIpdu01::DoorDrvrSts_UB,0,-1,0); break;
     Case(this::SignalUBHandled) :
        resultValue = DisturbUB(Backbone::CEM::CEMBackBoneSignalIpdu01::DoorDrvrSts_UB,0,0,0); break;
     Case(this::SignalUBON) :
        resultValue = DisturbUB(Backbone::CEM::CEMBackBoneSignalIpdu01::DoorDrvrSts_UB,0,-1,1); break;
     Default :
        resultValue = -1;
  }
  
}

on sysvar_update sysvar::CEM::Backbone::Signals::Control::UB::DoorPassReSts_UB_Control
{
  long resultValue;
  
  // --- FR ---
  setBusContext(getBusNameContext(gFR1BusName));
  switch(@this)
  {
     Case(this::SignalUBOFF) :
        resultValue = DisturbUB(Backbone::CEM::CEMBackBoneSignalIpdu01::DoorPassReSts_UB,0,-1,0); break;
     Case(this::SignalUBHandled) :
        resultValue = DisturbUB(Backbone::CEM::CEMBackBoneSignalIpdu01::DoorPassReSts_UB,0,0,0); break;
     Case(this::SignalUBON) :
        resultValue = DisturbUB(Backbone::CEM::CEMBackBoneSignalIpdu01::DoorPassReSts_UB,0,-1,1); break;
     Default :
        resultValue = -1;
  }
  
}

on sysvar_update sysvar::CEM::Backbone::Signals::Control::UB::DoorPassSts_UB_Control
{
  long resultValue;
  
  // --- FR ---
  setBusContext(getBusNameContext(gFR1BusName));
  switch(@this)
  {
     Case(this::SignalUBOFF) :
        resultValue = DisturbUB(Backbone::CEM::CEMBackBoneSignalIpdu01::DoorPassSts_UB,0,-1,0); break;
     Case(this::SignalUBHandled) :
        resultValue = DisturbUB(Backbone::CEM::CEMBackBoneSignalIpdu01::DoorPassSts_UB,0,0,0); break;
     Case(this::SignalUBON) :
        resultValue = DisturbUB(Backbone::CEM::CEMBackBoneSignalIpdu01::DoorPassSts_UB,0,-1,1); break;
     Default :
        resultValue = -1;
  }
  
}

on sysvar_update sysvar::CEM::Backbone::Signals::Control::UB::DrvrCtrlOfPassSeatFrntSts_UB_Control
{
  long resultValue;
  
  // --- FR ---
  setBusContext(getBusNameContext(gFR1BusName));
  switch(@this)
  {
     Case(this::SignalUBOFF) :
        resultValue = DisturbUB(Backbone::CEM::CEMBackBoneSignalIpdu01::DrvrCtrlOfPassSeatFrntSts_UB,0,-1,0); break;
     Case(this::SignalUBHandled) :
        resultValue = DisturbUB(Backbone::CEM::CEMBackBoneSignalIpdu01::DrvrCtrlOfPassSeatFrntSts_UB,0,0,0); break;
     Case(this::SignalUBON) :
        resultValue = DisturbUB(Backbone::CEM::CEMBackBoneSignalIpdu01::DrvrCtrlOfPassSeatFrntSts_UB,0,-1,1); break;
     Default :
        resultValue = -1;
  }
  
}

on sysvar_update sysvar::CEM::Backbone::Signals::Control::UB::HeatrIntkCooltTEstimd_UB_Control
{
  long resultValue;
  
  // --- FR ---
  setBusContext(getBusNameContext(gFR1BusName));
  switch(@this)
  {
     Case(this::SignalUBOFF) :
        resultValue = DisturbUB(Backbone::CEM::CEMBackBoneSignalIpdu01::HeatrIntkCooltTEstimd_UB,0,-1,0); break;
     Case(this::SignalUBHandled) :
        resultValue = DisturbUB(Backbone::CEM::CEMBackBoneSignalIpdu01::HeatrIntkCooltTEstimd_UB,0,0,0); break;
     Case(this::SignalUBON) :
        resultValue = DisturbUB(Backbone::CEM::CEMBackBoneSignalIpdu01::HeatrIntkCooltTEstimd_UB,0,-1,1); break;
     Default :
        resultValue = -1;
  }
  
}

on sysvar_update sysvar::CEM::Backbone::Signals::Control::UB::HoodSts_UB_Control
{
  long resultValue;
  
  // --- FR ---
  setBusContext(getBusNameContext(gFR1BusName));
  switch(@this)
  {
     Case(this::SignalUBOFF) :
        resultValue = DisturbUB(Backbone::CEM::CEMBackBoneSignalIpdu01::HoodSts_UB,0,-1,0); break;
     Case(this::SignalUBHandled) :
        resultValue = DisturbUB(Backbone::CEM::CEMBackBoneSignalIpdu01::HoodSts_UB,0,0,0); break;
     Case(this::SignalUBON) :
        resultValue = DisturbUB(Backbone::CEM::CEMBackBoneSignalIpdu01::HoodSts_UB,0,-1,1); break;
     Default :
        resultValue = -1;
  }
  
}

on sysvar_update sysvar::CEM::Backbone::Signals::Control::UB::HvacCoolgEnaFrnt_UB_Control
{
  long resultValue;
  
  // --- FR ---
  setBusContext(getBusNameContext(gFR1BusName));
  switch(@this)
  {
     Case(this::SignalUBOFF) :
        resultValue = DisturbUB(Backbone::CEM::CEMBackBoneSignalIpdu01::HvacCoolgEnaFrnt_UB,0,-1,0); break;
     Case(this::SignalUBHandled) :
        resultValue = DisturbUB(Backbone::CEM::CEMBackBoneSignalIpdu01::HvacCoolgEnaFrnt_UB,0,0,0); break;
     Case(this::SignalUBON) :
        resultValue = DisturbUB(Backbone::CEM::CEMBackBoneSignalIpdu01::HvacCoolgEnaFrnt_UB,0,-1,1); break;
     Default :
        resultValue = -1;
  }
  
}

on sysvar_update sysvar::CEM::Backbone::Signals::Control::UB::HybFacyStart_UB_Control
{
  long resultValue;
  
  // --- FR ---
  setBusContext(getBusNameContext(gFR1BusName));
  switch(@this)
  {
     Case(this::SignalUBOFF) :
        resultValue = DisturbUB(Backbone::CEM::CEMBackBoneSignalIpdu01::HybFacyStart_UB,0,-1,0); break;
     Case(this::SignalUBHandled) :
        resultValue = DisturbUB(Backbone::CEM::CEMBackBoneSignalIpdu01::HybFacyStart_UB,0,0,0); break;
     Case(this::SignalUBON) :
        resultValue = DisturbUB(Backbone::CEM::CEMBackBoneSignalIpdu01::HybFacyStart_UB,0,-1,1); break;
     Default :
        resultValue = -1;
  }
  
}

on sysvar_update sysvar::CEM::Backbone::Signals::Control::UB::IndcrTurnSts1WdSts_UB_Control
{
  long resultValue;
  
  // --- FR ---
  setBusContext(getBusNameContext(gFR1BusName));
  switch(@this)
  {
     Case(this::SignalUBOFF) :
        resultValue = DisturbUB(Backbone::CEM::CEMBackBoneSignalIpdu01::IndcrTurnSts1WdSts_UB,0,-1,0); break;
     Case(this::SignalUBHandled) :
        resultValue = DisturbUB(Backbone::CEM::CEMBackBoneSignalIpdu01::IndcrTurnSts1WdSts_UB,0,0,0); break;
     Case(this::SignalUBON) :
        resultValue = DisturbUB(Backbone::CEM::CEMBackBoneSignalIpdu01::IndcrTurnSts1WdSts_UB,0,-1,1); break;
     Default :
        resultValue = -1;
  }
  
}

on sysvar_update sysvar::CEM::Backbone::Signals::Control::UB::IntrBriSts_UB_Control
{
  long resultValue;
  
  // --- FR ---
  setBusContext(getBusNameContext(gFR1BusName));
  switch(@this)
  {
     Case(this::SignalUBOFF) :
        resultValue = DisturbUB(Backbone::CEM::CEMBackBoneSignalIpdu01::IntrBriSts_UB,0,-1,0); break;
     Case(this::SignalUBHandled) :
        resultValue = DisturbUB(Backbone::CEM::CEMBackBoneSignalIpdu01::IntrBriSts_UB,0,0,0); break;
     Case(this::SignalUBON) :
        resultValue = DisturbUB(Backbone::CEM::CEMBackBoneSignalIpdu01::IntrBriSts_UB,0,-1,1); break;
     Default :
        resultValue = -1;
  }
  
}

on sysvar_update sysvar::CEM::Backbone::Signals::Control::UB::LiLvrSwt1_UB_Control
{
  long resultValue;
  
  // --- FR ---
  setBusContext(getBusNameContext(gFR1BusName));
  switch(@this)
  {
     Case(this::SignalUBOFF) :
        resultValue = DisturbUB(Backbone::CEM::CEMBackBoneSignalIpdu01::LiLvrSwt1_UB,0,-1,0); break;
     Case(this::SignalUBHandled) :
        resultValue = DisturbUB(Backbone::CEM::CEMBackBoneSignalIpdu01::LiLvrSwt1_UB,0,0,0); break;
     Case(this::SignalUBON) :
        resultValue = DisturbUB(Backbone::CEM::CEMBackBoneSignalIpdu01::LiLvrSwt1_UB,0,-1,1); break;
     Default :
        resultValue = -1;
  }
  
}

on sysvar_update sysvar::CEM::Backbone::Signals::Control::UB::MirrFoldStsAtDrvr_UB_Control
{
  long resultValue;
  
  // --- FR ---
  setBusContext(getBusNameContext(gFR1BusName));
  switch(@this)
  {
     Case(this::SignalUBOFF) :
        resultValue = DisturbUB(Backbone::CEM::CEMBackBoneSignalIpdu01::MirrFoldStsAtDrvr_UB,0,-1,0); break;
     Case(this::SignalUBHandled) :
        resultValue = DisturbUB(Backbone::CEM::CEMBackBoneSignalIpdu01::MirrFoldStsAtDrvr_UB,0,0,0); break;
     Case(this::SignalUBON) :
        resultValue = DisturbUB(Backbone::CEM::CEMBackBoneSignalIpdu01::MirrFoldStsAtDrvr_UB,0,-1,1); break;
     Default :
        resultValue = -1;
  }
  
}

on sysvar_update sysvar::CEM::Backbone::Signals::Control::UB::PtActvnReq1WdPtActvnReq_UB_Control
{
  long resultValue;
  
  // --- FR ---
  setBusContext(getBusNameContext(gFR1BusName));
  switch(@this)
  {
     Case(this::SignalUBOFF) :
        resultValue = DisturbUB(Backbone::CEM::CEMBackBoneSignalIpdu01::PtActvnReq1WdPtActvnReq_UB,0,-1,0); break;
     Case(this::SignalUBHandled) :
        resultValue = DisturbUB(Backbone::CEM::CEMBackBoneSignalIpdu01::PtActvnReq1WdPtActvnReq_UB,0,0,0); break;
     Case(this::SignalUBON) :
        resultValue = DisturbUB(Backbone::CEM::CEMBackBoneSignalIpdu01::PtActvnReq1WdPtActvnReq_UB,0,-1,1); break;
     Default :
        resultValue = -1;
  }
  
}

on sysvar_update sysvar::CEM::Backbone::Signals::Control::UB::SeatFoldFctStsThrdGlb_UB_Control
{
  long resultValue;
  
  // --- FR ---
  setBusContext(getBusNameContext(gFR1BusName));
  switch(@this)
  {
     Case(this::SignalUBOFF) :
        resultValue = DisturbUB(Backbone::CEM::CEMBackBoneSignalIpdu01::SeatFoldFctStsThrdGlb_UB,0,-1,0); break;
     Case(this::SignalUBHandled) :
        resultValue = DisturbUB(Backbone::CEM::CEMBackBoneSignalIpdu01::SeatFoldFctStsThrdGlb_UB,0,0,0); break;
     Case(this::SignalUBON) :
        resultValue = DisturbUB(Backbone::CEM::CEMBackBoneSignalIpdu01::SeatFoldFctStsThrdGlb_UB,0,-1,1); break;
     Default :
        resultValue = -1;
  }
  
}

on sysvar_update sysvar::CEM::Backbone::Signals::Control::UB::SteerLockEnagOfPrpsn_UB_Control
{
  long resultValue;
  
  // --- FR ---
  setBusContext(getBusNameContext(gFR1BusName));
  switch(@this)
  {
     Case(this::SignalUBOFF) :
        resultValue = DisturbUB(Backbone::CEM::CEMBackBoneSignalIpdu01::SteerLockEnagOfPrpsn_UB,0,-1,0); break;
     Case(this::SignalUBHandled) :
        resultValue = DisturbUB(Backbone::CEM::CEMBackBoneSignalIpdu01::SteerLockEnagOfPrpsn_UB,0,0,0); break;
     Case(this::SignalUBON) :
        resultValue = DisturbUB(Backbone::CEM::CEMBackBoneSignalIpdu01::SteerLockEnagOfPrpsn_UB,0,-1,1); break;
     Default :
        resultValue = -1;
  }
  
}

on sysvar_update sysvar::CEM::Backbone::Signals::Control::UB::TInCooltAtStrtOfClima_UB_Control
{
  long resultValue;
  
  // --- FR ---
  setBusContext(getBusNameContext(gFR1BusName));
  switch(@this)
  {
     Case(this::SignalUBOFF) :
        resultValue = DisturbUB(Backbone::CEM::CEMBackBoneSignalIpdu01::TInCooltAtStrtOfClima_UB,0,-1,0); break;
     Case(this::SignalUBHandled) :
        resultValue = DisturbUB(Backbone::CEM::CEMBackBoneSignalIpdu01::TInCooltAtStrtOfClima_UB,0,0,0); break;
     Case(this::SignalUBON) :
        resultValue = DisturbUB(Backbone::CEM::CEMBackBoneSignalIpdu01::TInCooltAtStrtOfClima_UB,0,-1,1); break;
     Default :
        resultValue = -1;
  }
  
}

on sysvar_update sysvar::CEM::Backbone::Signals::Control::UB::TrSts_UB_Control
{
  long resultValue;
  
  // --- FR ---
  setBusContext(getBusNameContext(gFR1BusName));
  switch(@this)
  {
     Case(this::SignalUBOFF) :
        resultValue = DisturbUB(Backbone::CEM::CEMBackBoneSignalIpdu01::TrSts_UB,0,-1,0); break;
     Case(this::SignalUBHandled) :
        resultValue = DisturbUB(Backbone::CEM::CEMBackBoneSignalIpdu01::TrSts_UB,0,0,0); break;
     Case(this::SignalUBON) :
        resultValue = DisturbUB(Backbone::CEM::CEMBackBoneSignalIpdu01::TrSts_UB,0,-1,1); break;
     Default :
        resultValue = -1;
  }
  
}

on sysvar_update sysvar::CEM::Backbone::Signals::Control::UB::TwliBriSts_UB_Control
{
  long resultValue;
  
  // --- FR ---
  setBusContext(getBusNameContext(gFR1BusName));
  switch(@this)
  {
     Case(this::SignalUBOFF) :
        resultValue = DisturbUB(Backbone::CEM::CEMBackBoneSignalIpdu01::TwliBriSts_UB,0,-1,0); break;
     Case(this::SignalUBHandled) :
        resultValue = DisturbUB(Backbone::CEM::CEMBackBoneSignalIpdu01::TwliBriSts_UB,0,0,0); break;
     Case(this::SignalUBON) :
        resultValue = DisturbUB(Backbone::CEM::CEMBackBoneSignalIpdu01::TwliBriSts_UB,0,-1,1); break;
     Default :
        resultValue = -1;
  }
  
}

on sysvar_update sysvar::CEM::Backbone::SignalGroups::Control::E2E::AmbIllmnFwdStsChks_Control
{
  int controlValue;
  long resultValue;
  
  // --- FR ---
  controlValue = (int) @this;
  setBusContext(getBusNameContext(gFR1BusName));
  switch(controlValue)
  {
     Case(this::ChksHandled) :
        resultValue = EnableCRC("AmbIllmnFwdSts", 1); break;
     Case(this::ChksManual) :
        resultValue = EnableCRC("AmbIllmnFwdSts", 0); break;
     Default :
        resultValue = -1;
  }
  
}

on sysvar_update sysvar::CEM::Backbone::SignalGroups::Control::E2E::AmbIllmnFwdStsCntr_Control
{
  int controlValue;
  long resultValue;
  
  // --- FR ---
  controlValue = (int) @this;
  setBusContext(getBusNameContext(gFR1BusName));
  switch(controlValue)
  {
     Case(this::CntrHandled) :
        resultValue = EnableCounter ("AmbIllmnFwdSts", 1); break;
     Case(this::CntrManual) :
        resultValue = EnableCounter ("AmbIllmnFwdSts", 0); break;
     Default :
        resultValue = -1;
  }
  
}

on sysvar_update sysvar::CEM::Backbone::SignalGroups::Control::E2E::DrvrPrsntStsDrvrPrsntChks_Control
{
  int controlValue;
  long resultValue;
  
  // --- FR ---
  controlValue = (int) @this;
  setBusContext(getBusNameContext(gFR1BusName));
  switch(controlValue)
  {
     Case(this::ChksHandled) :
        resultValue = EnableCRC("DrvrPrsntGroup", 1); break;
     Case(this::ChksManual) :
        resultValue = EnableCRC("DrvrPrsntGroup", 0); break;
     Default :
        resultValue = -1;
  }
  
}

on sysvar_update sysvar::CEM::Backbone::SignalGroups::Control::E2E::DrvrPrsntStsDrvrPrsntCntr_Control
{
  int controlValue;
  long resultValue;
  
  // --- FR ---
  controlValue = (int) @this;
  setBusContext(getBusNameContext(gFR1BusName));
  switch(controlValue)
  {
     Case(this::CntrHandled) :
        resultValue = EnableCounter ("DrvrPrsntGroup", 1); break;
     Case(this::CntrManual) :
        resultValue = EnableCounter ("DrvrPrsntGroup", 0); break;
     Default :
        resultValue = -1;
  }
  
}

on sysvar_update sysvar::CEM::Backbone::Signals::Control::UB::AmbIllmnFwdSts_UB_Control
{
  long resultValue;
  
  // --- FR ---
  setBusContext(getBusNameContext(gFR1BusName));
  switch(@this)
  {
     Case(this::SignalUBOFF) :
        resultValue = DisturbUB(Backbone::CEM::CEMBackBoneSignalIpdu02::AmbIllmnFwdSts_UB,0,-1,0); break;
     Case(this::SignalUBHandled) :
        resultValue = DisturbUB(Backbone::CEM::CEMBackBoneSignalIpdu02::AmbIllmnFwdSts_UB,0,0,0); break;
     Case(this::SignalUBON) :
        resultValue = DisturbUB(Backbone::CEM::CEMBackBoneSignalIpdu02::AmbIllmnFwdSts_UB,0,-1,1); break;
     Default :
        resultValue = -1;
  }
  
}

on sysvar_update sysvar::CEM::Backbone::Signals::Control::UB::BrkPedlVal_UB_Control
{
  long resultValue;
  
  // --- FR ---
  setBusContext(getBusNameContext(gFR1BusName));
  switch(@this)
  {
     Case(this::SignalUBOFF) :
        resultValue = DisturbUB(Backbone::CEM::CEMBackBoneSignalIpdu02::BrkPedlVal_UB,0,-1,0); break;
     Case(this::SignalUBHandled) :
        resultValue = DisturbUB(Backbone::CEM::CEMBackBoneSignalIpdu02::BrkPedlVal_UB,0,0,0); break;
     Case(this::SignalUBON) :
        resultValue = DisturbUB(Backbone::CEM::CEMBackBoneSignalIpdu02::BrkPedlVal_UB,0,-1,1); break;
     Default :
        resultValue = -1;
  }
  
}

on sysvar_update sysvar::CEM::Backbone::Signals::Control::UB::DoorDrvrStsWithFacQly_UB_Control
{
  long resultValue;
  
  // --- FR ---
  setBusContext(getBusNameContext(gFR1BusName));
  switch(@this)
  {
     Case(this::SignalUBOFF) :
        resultValue = DisturbUB(Backbone::CEM::CEMBackBoneSignalIpdu02::DoorDrvrStsWithFacQly_UB,0,-1,0); break;
     Case(this::SignalUBHandled) :
        resultValue = DisturbUB(Backbone::CEM::CEMBackBoneSignalIpdu02::DoorDrvrStsWithFacQly_UB,0,0,0); break;
     Case(this::SignalUBON) :
        resultValue = DisturbUB(Backbone::CEM::CEMBackBoneSignalIpdu02::DoorDrvrStsWithFacQly_UB,0,-1,1); break;
     Default :
        resultValue = -1;
  }
  
}

on sysvar_update sysvar::CEM::Backbone::Signals::Control::UB::DrvrPrsntGroup_UB_Control
{
  long resultValue;
  
  // --- FR ---
  setBusContext(getBusNameContext(gFR1BusName));
  switch(@this)
  {
     Case(this::SignalUBOFF) :
        resultValue = DisturbUB(Backbone::CEM::CEMBackBoneSignalIpdu02::DrvrPrsntGroup_UB,0,-1,0); break;
     Case(this::SignalUBHandled) :
        resultValue = DisturbUB(Backbone::CEM::CEMBackBoneSignalIpdu02::DrvrPrsntGroup_UB,0,0,0); break;
     Case(this::SignalUBON) :
        resultValue = DisturbUB(Backbone::CEM::CEMBackBoneSignalIpdu02::DrvrPrsntGroup_UB,0,-1,1); break;
     Default :
        resultValue = -1;
  }
  
}

on sysvar_update sysvar::CEM::Backbone::Signals::Control::UB::DrvrSeatSwtSts_UB_Control
{
  long resultValue;
  
  // --- FR ---
  setBusContext(getBusNameContext(gFR1BusName));
  switch(@this)
  {
     Case(this::SignalUBOFF) :
        resultValue = DisturbUB(Backbone::CEM::CEMBackBoneSignalIpdu02::DrvrSeatSwtSts_UB,0,-1,0); break;
     Case(this::SignalUBHandled) :
        resultValue = DisturbUB(Backbone::CEM::CEMBackBoneSignalIpdu02::DrvrSeatSwtSts_UB,0,0,0); break;
     Case(this::SignalUBON) :
        resultValue = DisturbUB(Backbone::CEM::CEMBackBoneSignalIpdu02::DrvrSeatSwtSts_UB,0,-1,1); break;
     Default :
        resultValue = -1;
  }
  
}

on sysvar_update sysvar::CEM::Backbone::Signals::Control::UB::LockgCenSts_UB_Control
{
  long resultValue;
  
  // --- FR ---
  setBusContext(getBusNameContext(gFR1BusName));
  switch(@this)
  {
     Case(this::SignalUBOFF) :
        resultValue = DisturbUB(Backbone::CEM::CEMBackBoneSignalIpdu02::LockgCenSts_UB,0,-1,0); break;
     Case(this::SignalUBHandled) :
        resultValue = DisturbUB(Backbone::CEM::CEMBackBoneSignalIpdu02::LockgCenSts_UB,0,0,0); break;
     Case(this::SignalUBON) :
        resultValue = DisturbUB(Backbone::CEM::CEMBackBoneSignalIpdu02::LockgCenSts_UB,0,-1,1); break;
     Default :
        resultValue = -1;
  }
  
}

on sysvar_update sysvar::CEM::Backbone::Signals::Control::UB::PassSeatSwtSts2_UB_Control
{
  long resultValue;
  
  // --- FR ---
  setBusContext(getBusNameContext(gFR1BusName));
  switch(@this)
  {
     Case(this::SignalUBOFF) :
        resultValue = DisturbUB(Backbone::CEM::CEMBackBoneSignalIpdu02::PassSeatSwtSts2_UB,0,-1,0); break;
     Case(this::SignalUBHandled) :
        resultValue = DisturbUB(Backbone::CEM::CEMBackBoneSignalIpdu02::PassSeatSwtSts2_UB,0,0,0); break;
     Case(this::SignalUBON) :
        resultValue = DisturbUB(Backbone::CEM::CEMBackBoneSignalIpdu02::PassSeatSwtSts2_UB,0,-1,1); break;
     Default :
        resultValue = -1;
  }
  
}

on sysvar_update sysvar::CEM::Backbone::Signals::Control::UB::TwliBriRawGroup_UB_Control
{
  long resultValue;
  
  // --- FR ---
  setBusContext(getBusNameContext(gFR1BusName));
  switch(@this)
  {
     Case(this::SignalUBOFF) :
        resultValue = DisturbUB(Backbone::CEM::CEMBackBoneSignalIpdu02::TwliBriRawGroup_UB,0,-1,0); break;
     Case(this::SignalUBHandled) :
        resultValue = DisturbUB(Backbone::CEM::CEMBackBoneSignalIpdu02::TwliBriRawGroup_UB,0,0,0); break;
     Case(this::SignalUBON) :
        resultValue = DisturbUB(Backbone::CEM::CEMBackBoneSignalIpdu02::TwliBriRawGroup_UB,0,-1,1); break;
     Default :
        resultValue = -1;
  }
  
}

on sysvar_update sysvar::CEM::Backbone::Signals::Control::UB::ChdLockgProtnFailrStsToHmi_UB_Control
{
  long resultValue;
  
  // --- FR ---
  setBusContext(getBusNameContext(gFR1BusName));
  switch(@this)
  {
     Case(this::SignalUBOFF) :
        resultValue = DisturbUB(Backbone::CEM::CEMBackBoneSignalIpdu02::ChdLockgProtnFailrStsToHmi_UB,0,-1,0); break;
     Case(this::SignalUBHandled) :
        resultValue = DisturbUB(Backbone::CEM::CEMBackBoneSignalIpdu02::ChdLockgProtnFailrStsToHmi_UB,0,0,0); break;
     Case(this::SignalUBON) :
        resultValue = DisturbUB(Backbone::CEM::CEMBackBoneSignalIpdu02::ChdLockgProtnFailrStsToHmi_UB,0,-1,1); break;
     Default :
        resultValue = -1;
  }
  
}

on sysvar_update sysvar::CEM::Backbone::Signals::Control::UB::ChrgnUReqMin_UB_Control
{
  long resultValue;
  
  // --- FR ---
  setBusContext(getBusNameContext(gFR1BusName));
  switch(@this)
  {
     Case(this::SignalUBOFF) :
        resultValue = DisturbUB(Backbone::CEM::CEMBackBoneSignalIpdu02::ChrgnUReqMin_UB,0,-1,0); break;
     Case(this::SignalUBHandled) :
        resultValue = DisturbUB(Backbone::CEM::CEMBackBoneSignalIpdu02::ChrgnUReqMin_UB,0,0,0); break;
     Case(this::SignalUBON) :
        resultValue = DisturbUB(Backbone::CEM::CEMBackBoneSignalIpdu02::ChrgnUReqMin_UB,0,-1,1); break;
     Default :
        resultValue = -1;
  }
  
}

on sysvar_update sysvar::CEM::Backbone::Signals::Control::UB::CmptmtAirTEstimdAtRowFirstLoResl_UB_Control
{
  long resultValue;
  
  // --- FR ---
  setBusContext(getBusNameContext(gFR1BusName));
  switch(@this)
  {
     Case(this::SignalUBOFF) :
        resultValue = DisturbUB(Backbone::CEM::CEMBackBoneSignalIpdu02::CmptmtAirTEstimdAtRowFirstLoResl_UB,0,-1,0); break;
     Case(this::SignalUBHandled) :
        resultValue = DisturbUB(Backbone::CEM::CEMBackBoneSignalIpdu02::CmptmtAirTEstimdAtRowFirstLoResl_UB,0,0,0); break;
     Case(this::SignalUBON) :
        resultValue = DisturbUB(Backbone::CEM::CEMBackBoneSignalIpdu02::CmptmtAirTEstimdAtRowFirstLoResl_UB,0,-1,1); break;
     Default :
        resultValue = -1;
  }
  
}

on sysvar_update sysvar::CEM::Backbone::Signals::Control::UB::EngActvnMod1WdReq_UB_Control
{
  long resultValue;
  
  // --- FR ---
  setBusContext(getBusNameContext(gFR1BusName));
  switch(@this)
  {
     Case(this::SignalUBOFF) :
        resultValue = DisturbUB(Backbone::CEM::CEMBackBoneSignalIpdu02::EngActvnMod1WdReq_UB,0,-1,0); break;
     Case(this::SignalUBHandled) :
        resultValue = DisturbUB(Backbone::CEM::CEMBackBoneSignalIpdu02::EngActvnMod1WdReq_UB,0,0,0); break;
     Case(this::SignalUBON) :
        resultValue = DisturbUB(Backbone::CEM::CEMBackBoneSignalIpdu02::EngActvnMod1WdReq_UB,0,-1,1); break;
     Default :
        resultValue = -1;
  }
  
}

on sysvar_update sysvar::CEM::Backbone::Signals::Control::UB::FltBrkLiReq_UB_Control
{
  long resultValue;
  
  // --- FR ---
  setBusContext(getBusNameContext(gFR1BusName));
  switch(@this)
  {
     Case(this::SignalUBOFF) :
        resultValue = DisturbUB(Backbone::CEM::CEMBackBoneSignalIpdu02::FltBrkLiReq_UB,0,-1,0); break;
     Case(this::SignalUBHandled) :
        resultValue = DisturbUB(Backbone::CEM::CEMBackBoneSignalIpdu02::FltBrkLiReq_UB,0,0,0); break;
     Case(this::SignalUBON) :
        resultValue = DisturbUB(Backbone::CEM::CEMBackBoneSignalIpdu02::FltBrkLiReq_UB,0,-1,1); break;
     Default :
        resultValue = -1;
  }
  
}

on sysvar_update sysvar::CEM::Backbone::Signals::Control::UB::IndcrDisp1WdSts_UB_Control
{
  long resultValue;
  
  // --- FR ---
  setBusContext(getBusNameContext(gFR1BusName));
  switch(@this)
  {
     Case(this::SignalUBOFF) :
        resultValue = DisturbUB(Backbone::CEM::CEMBackBoneSignalIpdu02::IndcrDisp1WdSts_UB,0,-1,0); break;
     Case(this::SignalUBHandled) :
        resultValue = DisturbUB(Backbone::CEM::CEMBackBoneSignalIpdu02::IndcrDisp1WdSts_UB,0,0,0); break;
     Case(this::SignalUBON) :
        resultValue = DisturbUB(Backbone::CEM::CEMBackBoneSignalIpdu02::IndcrDisp1WdSts_UB,0,-1,1); break;
     Default :
        resultValue = -1;
  }
  
}

on sysvar_update sysvar::CEM::Backbone::Signals::Control::UB::KeyLostWarnIndcn_UB_Control
{
  long resultValue;
  
  // --- FR ---
  setBusContext(getBusNameContext(gFR1BusName));
  switch(@this)
  {
     Case(this::SignalUBOFF) :
        resultValue = DisturbUB(Backbone::CEM::CEMBackBoneSignalIpdu02::KeyLostWarnIndcn_UB,0,-1,0); break;
     Case(this::SignalUBHandled) :
        resultValue = DisturbUB(Backbone::CEM::CEMBackBoneSignalIpdu02::KeyLostWarnIndcn_UB,0,0,0); break;
     Case(this::SignalUBON) :
        resultValue = DisturbUB(Backbone::CEM::CEMBackBoneSignalIpdu02::KeyLostWarnIndcn_UB,0,-1,1); break;
     Default :
        resultValue = -1;
  }
  
}

on sysvar_update sysvar::CEM::Backbone::Signals::Control::UB::KeyRmnIndcn_UB_Control
{
  long resultValue;
  
  // --- FR ---
  setBusContext(getBusNameContext(gFR1BusName));
  switch(@this)
  {
     Case(this::SignalUBOFF) :
        resultValue = DisturbUB(Backbone::CEM::CEMBackBoneSignalIpdu02::KeyRmnIndcn_UB,0,-1,0); break;
     Case(this::SignalUBHandled) :
        resultValue = DisturbUB(Backbone::CEM::CEMBackBoneSignalIpdu02::KeyRmnIndcn_UB,0,0,0); break;
     Case(this::SignalUBON) :
        resultValue = DisturbUB(Backbone::CEM::CEMBackBoneSignalIpdu02::KeyRmnIndcn_UB,0,-1,1); break;
     Default :
        resultValue = -1;
  }
  
}

on sysvar_update sysvar::CEM::Backbone::Signals::Control::UB::MirrFoldStsAtPass_UB_Control
{
  long resultValue;
  
  // --- FR ---
  setBusContext(getBusNameContext(gFR1BusName));
  switch(@this)
  {
     Case(this::SignalUBOFF) :
        resultValue = DisturbUB(Backbone::CEM::CEMBackBoneSignalIpdu02::MirrFoldStsAtPass_UB,0,-1,0); break;
     Case(this::SignalUBHandled) :
        resultValue = DisturbUB(Backbone::CEM::CEMBackBoneSignalIpdu02::MirrFoldStsAtPass_UB,0,0,0); break;
     Case(this::SignalUBON) :
        resultValue = DisturbUB(Backbone::CEM::CEMBackBoneSignalIpdu02::MirrFoldStsAtPass_UB,0,-1,1); break;
     Default :
        resultValue = -1;
  }
  
}

on sysvar_update sysvar::CEM::Backbone::Signals::Control::UB::SpprtBattOkForCrkCold_UB_Control
{
  long resultValue;
  
  // --- FR ---
  setBusContext(getBusNameContext(gFR1BusName));
  switch(@this)
  {
     Case(this::SignalUBOFF) :
        resultValue = DisturbUB(Backbone::CEM::CEMBackBoneSignalIpdu02::SpprtBattOkForCrkCold_UB,0,-1,0); break;
     Case(this::SignalUBHandled) :
        resultValue = DisturbUB(Backbone::CEM::CEMBackBoneSignalIpdu02::SpprtBattOkForCrkCold_UB,0,0,0); break;
     Case(this::SignalUBON) :
        resultValue = DisturbUB(Backbone::CEM::CEMBackBoneSignalIpdu02::SpprtBattOkForCrkCold_UB,0,-1,1); break;
     Default :
        resultValue = -1;
  }
  
}

on sysvar_update sysvar::CEM::Backbone::Signals::Control::UB::TrlrLampChkSts_UB_Control
{
  long resultValue;
  
  // --- FR ---
  setBusContext(getBusNameContext(gFR1BusName));
  switch(@this)
  {
     Case(this::SignalUBOFF) :
        resultValue = DisturbUB(Backbone::CEM::CEMBackBoneSignalIpdu02::TrlrLampChkSts_UB,0,-1,0); break;
     Case(this::SignalUBHandled) :
        resultValue = DisturbUB(Backbone::CEM::CEMBackBoneSignalIpdu02::TrlrLampChkSts_UB,0,0,0); break;
     Case(this::SignalUBON) :
        resultValue = DisturbUB(Backbone::CEM::CEMBackBoneSignalIpdu02::TrlrLampChkSts_UB,0,-1,1); break;
     Default :
        resultValue = -1;
  }
  
}

on sysvar_update sysvar::CEM::Backbone::Signals::Control::UB::TwbrWarnSts_UB_Control
{
  long resultValue;
  
  // --- FR ---
  setBusContext(getBusNameContext(gFR1BusName));
  switch(@this)
  {
     Case(this::SignalUBOFF) :
        resultValue = DisturbUB(Backbone::CEM::CEMBackBoneSignalIpdu02::TwbrWarnSts_UB,0,-1,0); break;
     Case(this::SignalUBHandled) :
        resultValue = DisturbUB(Backbone::CEM::CEMBackBoneSignalIpdu02::TwbrWarnSts_UB,0,0,0); break;
     Case(this::SignalUBON) :
        resultValue = DisturbUB(Backbone::CEM::CEMBackBoneSignalIpdu02::TwbrWarnSts_UB,0,-1,1); break;
     Default :
        resultValue = -1;
  }
  
}

on sysvar_update sysvar::CEM::Backbone::SignalGroups::Control::E2E::BrkPedlSnsrChks_Control
{
  int controlValue;
  long resultValue;
  
  // --- FR ---
  controlValue = (int) @this;
  setBusContext(getBusNameContext(gFR1BusName));
  switch(controlValue)
  {
     Case(this::ChksHandled) :
        resultValue = EnableCRC("BrkPedlSnsr", 1); break;
     Case(this::ChksManual) :
        resultValue = EnableCRC("BrkPedlSnsr", 0); break;
     Default :
        resultValue = -1;
  }
  
}

on sysvar_update sysvar::CEM::Backbone::SignalGroups::Control::E2E::BrkPedlSnsrCntr_Control
{
  int controlValue;
  long resultValue;
  
  // --- FR ---
  controlValue = (int) @this;
  setBusContext(getBusNameContext(gFR1BusName));
  switch(controlValue)
  {
     Case(this::CntrHandled) :
        resultValue = EnableCounter ("BrkPedlSnsr", 1); break;
     Case(this::CntrManual) :
        resultValue = EnableCounter ("BrkPedlSnsr", 0); break;
     Default :
        resultValue = -1;
  }
  
}

on sysvar_update sysvar::CEM::Backbone::Signals::Control::UB::BrkPedlSnsr_UB_Control
{
  long resultValue;
  
  // --- FR ---
  setBusContext(getBusNameContext(gFR1BusName));
  switch(@this)
  {
     Case(this::SignalUBOFF) :
        resultValue = DisturbUB(Backbone::CEM::CEMBackBoneSignalIpdu03::BrkPedlSnsr_UB,0,-1,0); break;
     Case(this::SignalUBHandled) :
        resultValue = DisturbUB(Backbone::CEM::CEMBackBoneSignalIpdu03::BrkPedlSnsr_UB,0,0,0); break;
     Case(this::SignalUBON) :
        resultValue = DisturbUB(Backbone::CEM::CEMBackBoneSignalIpdu03::BrkPedlSnsr_UB,0,-1,1); break;
     Default :
        resultValue = -1;
  }
  
}

on sysvar_update sysvar::CEM::Backbone::Signals::Control::UB::EngRunngReqByVehModMgr_UB_Control
{
  long resultValue;
  
  // --- FR ---
  setBusContext(getBusNameContext(gFR1BusName));
  switch(@this)
  {
     Case(this::SignalUBOFF) :
        resultValue = DisturbUB(Backbone::CEM::CEMBackBoneSignalIpdu03::EngRunngReqByVehModMgr_UB,0,-1,0); break;
     Case(this::SignalUBHandled) :
        resultValue = DisturbUB(Backbone::CEM::CEMBackBoneSignalIpdu03::EngRunngReqByVehModMgr_UB,0,0,0); break;
     Case(this::SignalUBON) :
        resultValue = DisturbUB(Backbone::CEM::CEMBackBoneSignalIpdu03::EngRunngReqByVehModMgr_UB,0,-1,1); break;
     Default :
        resultValue = -1;
  }
  
}

on sysvar_update sysvar::CEM::Backbone::Signals::Control::UB::KeyReadStsToProfCtrl_UB_Control
{
  long resultValue;
  
  // --- FR ---
  setBusContext(getBusNameContext(gFR1BusName));
  switch(@this)
  {
     Case(this::SignalUBOFF) :
        resultValue = DisturbUB(Backbone::CEM::CEMBackBoneSignalIpdu03::KeyReadStsToProfCtrl_UB,0,-1,0); break;
     Case(this::SignalUBHandled) :
        resultValue = DisturbUB(Backbone::CEM::CEMBackBoneSignalIpdu03::KeyReadStsToProfCtrl_UB,0,0,0); break;
     Case(this::SignalUBON) :
        resultValue = DisturbUB(Backbone::CEM::CEMBackBoneSignalIpdu03::KeyReadStsToProfCtrl_UB,0,-1,1); break;
     Default :
        resultValue = -1;
  }
  
}

on sysvar_update sysvar::CEM::Backbone::Signals::Control::UB::LoadAndStoreReq_UB_Control
{
  long resultValue;
  
  // --- FR ---
  setBusContext(getBusNameContext(gFR1BusName));
  switch(@this)
  {
     Case(this::SignalUBOFF) :
        resultValue = DisturbUB(Backbone::CEM::CEMBackBoneSignalIpdu03::LoadAndStoreReq_UB,0,-1,0); break;
     Case(this::SignalUBHandled) :
        resultValue = DisturbUB(Backbone::CEM::CEMBackBoneSignalIpdu03::LoadAndStoreReq_UB,0,0,0); break;
     Case(this::SignalUBON) :
        resultValue = DisturbUB(Backbone::CEM::CEMBackBoneSignalIpdu03::LoadAndStoreReq_UB,0,-1,1); break;
     Default :
        resultValue = -1;
  }
  
}

on sysvar_update sysvar::CEM::Backbone::Signals::Control::UB::NetTelmActvt_UB_Control
{
  long resultValue;
  
  // --- FR ---
  setBusContext(getBusNameContext(gFR1BusName));
  switch(@this)
  {
     Case(this::SignalUBOFF) :
        resultValue = DisturbUB(Backbone::CEM::CEMBackBoneSignalIpdu03::NetTelmActvt_UB,0,-1,0); break;
     Case(this::SignalUBHandled) :
        resultValue = DisturbUB(Backbone::CEM::CEMBackBoneSignalIpdu03::NetTelmActvt_UB,0,0,0); break;
     Case(this::SignalUBON) :
        resultValue = DisturbUB(Backbone::CEM::CEMBackBoneSignalIpdu03::NetTelmActvt_UB,0,-1,1); break;
     Default :
        resultValue = -1;
  }
  
}

on sysvar_update sysvar::CEM::Backbone::Signals::Control::UB::ProfLimd_UB_Control
{
  long resultValue;
  
  // --- FR ---
  setBusContext(getBusNameContext(gFR1BusName));
  switch(@this)
  {
     Case(this::SignalUBOFF) :
        resultValue = DisturbUB(Backbone::CEM::CEMBackBoneSignalIpdu03::ProfLimd_UB,0,-1,0); break;
     Case(this::SignalUBHandled) :
        resultValue = DisturbUB(Backbone::CEM::CEMBackBoneSignalIpdu03::ProfLimd_UB,0,0,0); break;
     Case(this::SignalUBON) :
        resultValue = DisturbUB(Backbone::CEM::CEMBackBoneSignalIpdu03::ProfLimd_UB,0,-1,1); break;
     Default :
        resultValue = -1;
  }
  
}

on sysvar_update sysvar::CEM::Backbone::Signals::Control::UB::SteerLockReq_UB_Control
{
  long resultValue;
  
  // --- FR ---
  setBusContext(getBusNameContext(gFR1BusName));
  switch(@this)
  {
     Case(this::SignalUBOFF) :
        resultValue = DisturbUB(Backbone::CEM::CEMBackBoneSignalIpdu03::SteerLockReq_UB,0,-1,0); break;
     Case(this::SignalUBHandled) :
        resultValue = DisturbUB(Backbone::CEM::CEMBackBoneSignalIpdu03::SteerLockReq_UB,0,0,0); break;
     Case(this::SignalUBON) :
        resultValue = DisturbUB(Backbone::CEM::CEMBackBoneSignalIpdu03::SteerLockReq_UB,0,-1,1); break;
     Default :
        resultValue = -1;
  }
  
}

on sysvar_update sysvar::CEM::Backbone::Signals::Control::UB::ChdLockgProtnStsToHmi_UB_Control
{
  long resultValue;
  
  // --- FR ---
  setBusContext(getBusNameContext(gFR1BusName));
  switch(@this)
  {
     Case(this::SignalUBOFF) :
        resultValue = DisturbUB(Backbone::CEM::CEMBackBoneSignalIpdu03::ChdLockgProtnStsToHmi_UB,0,-1,0); break;
     Case(this::SignalUBHandled) :
        resultValue = DisturbUB(Backbone::CEM::CEMBackBoneSignalIpdu03::ChdLockgProtnStsToHmi_UB,0,0,0); break;
     Case(this::SignalUBON) :
        resultValue = DisturbUB(Backbone::CEM::CEMBackBoneSignalIpdu03::ChdLockgProtnStsToHmi_UB,0,-1,1); break;
     Default :
        resultValue = -1;
  }
  
}

on sysvar_update sysvar::CEM::Backbone::Signals::Control::UB::ChrgnUReq_UB_Control
{
  long resultValue;
  
  // --- FR ---
  setBusContext(getBusNameContext(gFR1BusName));
  switch(@this)
  {
     Case(this::SignalUBOFF) :
        resultValue = DisturbUB(Backbone::CEM::CEMBackBoneSignalIpdu03::ChrgnUReq_UB,0,-1,0); break;
     Case(this::SignalUBHandled) :
        resultValue = DisturbUB(Backbone::CEM::CEMBackBoneSignalIpdu03::ChrgnUReq_UB,0,0,0); break;
     Case(this::SignalUBON) :
        resultValue = DisturbUB(Backbone::CEM::CEMBackBoneSignalIpdu03::ChrgnUReq_UB,0,-1,1); break;
     Default :
        resultValue = -1;
  }
  
}

on sysvar_update sysvar::CEM::Backbone::Signals::Control::UB::ClimaActv_UB_Control
{
  long resultValue;
  
  // --- FR ---
  setBusContext(getBusNameContext(gFR1BusName));
  switch(@this)
  {
     Case(this::SignalUBOFF) :
        resultValue = DisturbUB(Backbone::CEM::CEMBackBoneSignalIpdu03::ClimaActv_UB,0,-1,0); break;
     Case(this::SignalUBHandled) :
        resultValue = DisturbUB(Backbone::CEM::CEMBackBoneSignalIpdu03::ClimaActv_UB,0,0,0); break;
     Case(this::SignalUBON) :
        resultValue = DisturbUB(Backbone::CEM::CEMBackBoneSignalIpdu03::ClimaActv_UB,0,-1,1); break;
     Default :
        resultValue = -1;
  }
  
}

on sysvar_update sysvar::CEM::Backbone::Signals::Control::UB::ClimaTiOfEnd_UB_Control
{
  long resultValue;
  
  // --- FR ---
  setBusContext(getBusNameContext(gFR1BusName));
  switch(@this)
  {
     Case(this::SignalUBOFF) :
        resultValue = DisturbUB(Backbone::CEM::CEMBackBoneSignalIpdu03::ClimaTiOfEnd_UB,0,-1,0); break;
     Case(this::SignalUBHandled) :
        resultValue = DisturbUB(Backbone::CEM::CEMBackBoneSignalIpdu03::ClimaTiOfEnd_UB,0,0,0); break;
     Case(this::SignalUBON) :
        resultValue = DisturbUB(Backbone::CEM::CEMBackBoneSignalIpdu03::ClimaTiOfEnd_UB,0,-1,1); break;
     Default :
        resultValue = -1;
  }
  
}

on sysvar_update sysvar::CEM::Backbone::Signals::Control::UB::DispRAinSnsrActvn_UB_Control
{
  long resultValue;
  
  // --- FR ---
  setBusContext(getBusNameContext(gFR1BusName));
  switch(@this)
  {
     Case(this::SignalUBOFF) :
        resultValue = DisturbUB(Backbone::CEM::CEMBackBoneSignalIpdu03::DispRAinSnsrActvn_UB,0,-1,0); break;
     Case(this::SignalUBHandled) :
        resultValue = DisturbUB(Backbone::CEM::CEMBackBoneSignalIpdu03::DispRAinSnsrActvn_UB,0,0,0); break;
     Case(this::SignalUBON) :
        resultValue = DisturbUB(Backbone::CEM::CEMBackBoneSignalIpdu03::DispRAinSnsrActvn_UB,0,-1,1); break;
     Default :
        resultValue = -1;
  }
  
}

on sysvar_update sysvar::CEM::Backbone::Signals::Control::UB::DoorDrvrReSts_UB_Control
{
  long resultValue;
  
  // --- FR ---
  setBusContext(getBusNameContext(gFR1BusName));
  switch(@this)
  {
     Case(this::SignalUBOFF) :
        resultValue = DisturbUB(Backbone::CEM::CEMBackBoneSignalIpdu03::DoorDrvrReSts_UB,0,-1,0); break;
     Case(this::SignalUBHandled) :
        resultValue = DisturbUB(Backbone::CEM::CEMBackBoneSignalIpdu03::DoorDrvrReSts_UB,0,0,0); break;
     Case(this::SignalUBON) :
        resultValue = DisturbUB(Backbone::CEM::CEMBackBoneSignalIpdu03::DoorDrvrReSts_UB,0,-1,1); break;
     Default :
        resultValue = -1;
  }
  
}

on sysvar_update sysvar::CEM::Backbone::Signals::Control::UB::EmgyBrkDstParkAut_UB_Control
{
  long resultValue;
  
  // --- FR ---
  setBusContext(getBusNameContext(gFR1BusName));
  switch(@this)
  {
     Case(this::SignalUBOFF) :
        resultValue = DisturbUB(Backbone::CEM::CEMBackBoneSignalIpdu03::EmgyBrkDstParkAut_UB,0,-1,0); break;
     Case(this::SignalUBHandled) :
        resultValue = DisturbUB(Backbone::CEM::CEMBackBoneSignalIpdu03::EmgyBrkDstParkAut_UB,0,0,0); break;
     Case(this::SignalUBON) :
        resultValue = DisturbUB(Backbone::CEM::CEMBackBoneSignalIpdu03::EmgyBrkDstParkAut_UB,0,-1,1); break;
     Default :
        resultValue = -1;
  }
  
}

on sysvar_update sysvar::CEM::Backbone::Signals::Control::UB::EngSpdIncIdleForClima_UB_Control
{
  long resultValue;
  
  // --- FR ---
  setBusContext(getBusNameContext(gFR1BusName));
  switch(@this)
  {
     Case(this::SignalUBOFF) :
        resultValue = DisturbUB(Backbone::CEM::CEMBackBoneSignalIpdu03::EngSpdIncIdleForClima_UB,0,-1,0); break;
     Case(this::SignalUBHandled) :
        resultValue = DisturbUB(Backbone::CEM::CEMBackBoneSignalIpdu03::EngSpdIncIdleForClima_UB,0,0,0); break;
     Case(this::SignalUBON) :
        resultValue = DisturbUB(Backbone::CEM::CEMBackBoneSignalIpdu03::EngSpdIncIdleForClima_UB,0,-1,1); break;
     Default :
        resultValue = -1;
  }
  
}

on sysvar_update sysvar::CEM::Backbone::Signals::Control::UB::HvacAirMFlowEstimd_UB_Control
{
  long resultValue;
  
  // --- FR ---
  setBusContext(getBusNameContext(gFR1BusName));
  switch(@this)
  {
     Case(this::SignalUBOFF) :
        resultValue = DisturbUB(Backbone::CEM::CEMBackBoneSignalIpdu03::HvacAirMFlowEstimd_UB,0,-1,0); break;
     Case(this::SignalUBHandled) :
        resultValue = DisturbUB(Backbone::CEM::CEMBackBoneSignalIpdu03::HvacAirMFlowEstimd_UB,0,0,0); break;
     Case(this::SignalUBON) :
        resultValue = DisturbUB(Backbone::CEM::CEMBackBoneSignalIpdu03::HvacAirMFlowEstimd_UB,0,-1,1); break;
     Default :
        resultValue = -1;
  }
  
}

on sysvar_update sysvar::CEM::Backbone::Signals::Control::UB::HvacRecircAct_UB_Control
{
  long resultValue;
  
  // --- FR ---
  setBusContext(getBusNameContext(gFR1BusName));
  switch(@this)
  {
     Case(this::SignalUBOFF) :
        resultValue = DisturbUB(Backbone::CEM::CEMBackBoneSignalIpdu03::HvacRecircAct_UB,0,-1,0); break;
     Case(this::SignalUBHandled) :
        resultValue = DisturbUB(Backbone::CEM::CEMBackBoneSignalIpdu03::HvacRecircAct_UB,0,0,0); break;
     Case(this::SignalUBON) :
        resultValue = DisturbUB(Backbone::CEM::CEMBackBoneSignalIpdu03::HvacRecircAct_UB,0,-1,1); break;
     Default :
        resultValue = -1;
  }
  
}

on sysvar_update sysvar::CEM::Backbone::Signals::Control::UB::ProfPenSts1_UB_Control
{
  long resultValue;
  
  // --- FR ---
  setBusContext(getBusNameContext(gFR1BusName));
  switch(@this)
  {
     Case(this::SignalUBOFF) :
        resultValue = DisturbUB(Backbone::CEM::CEMBackBoneSignalIpdu03::ProfPenSts1_UB,0,-1,0); break;
     Case(this::SignalUBHandled) :
        resultValue = DisturbUB(Backbone::CEM::CEMBackBoneSignalIpdu03::ProfPenSts1_UB,0,0,0); break;
     Case(this::SignalUBON) :
        resultValue = DisturbUB(Backbone::CEM::CEMBackBoneSignalIpdu03::ProfPenSts1_UB,0,-1,1); break;
     Default :
        resultValue = -1;
  }
  
}

on sysvar_update sysvar::CEM::Backbone::Signals::Control::UB::StrtMsgToDrvr_UB_Control
{
  long resultValue;
  
  // --- FR ---
  setBusContext(getBusNameContext(gFR1BusName));
  switch(@this)
  {
     Case(this::SignalUBOFF) :
        resultValue = DisturbUB(Backbone::CEM::CEMBackBoneSignalIpdu03::StrtMsgToDrvr_UB,0,-1,0); break;
     Case(this::SignalUBHandled) :
        resultValue = DisturbUB(Backbone::CEM::CEMBackBoneSignalIpdu03::StrtMsgToDrvr_UB,0,0,0); break;
     Case(this::SignalUBON) :
        resultValue = DisturbUB(Backbone::CEM::CEMBackBoneSignalIpdu03::StrtMsgToDrvr_UB,0,-1,1); break;
     Default :
        resultValue = -1;
  }
  
}

on sysvar_update sysvar::CEM::Backbone::Signals::Control::UB::SunRoofPosnSts_UB_Control
{
  long resultValue;
  
  // --- FR ---
  setBusContext(getBusNameContext(gFR1BusName));
  switch(@this)
  {
     Case(this::SignalUBOFF) :
        resultValue = DisturbUB(Backbone::CEM::CEMBackBoneSignalIpdu03::SunRoofPosnSts_UB,0,-1,0); break;
     Case(this::SignalUBHandled) :
        resultValue = DisturbUB(Backbone::CEM::CEMBackBoneSignalIpdu03::SunRoofPosnSts_UB,0,0,0); break;
     Case(this::SignalUBON) :
        resultValue = DisturbUB(Backbone::CEM::CEMBackBoneSignalIpdu03::SunRoofPosnSts_UB,0,-1,1); break;
     Default :
        resultValue = -1;
  }
  
}

on sysvar_update sysvar::CEM::Backbone::Signals::Control::UB::TrlrLampActvtChk_UB_Control
{
  long resultValue;
  
  // --- FR ---
  setBusContext(getBusNameContext(gFR1BusName));
  switch(@this)
  {
     Case(this::SignalUBOFF) :
        resultValue = DisturbUB(Backbone::CEM::CEMBackBoneSignalIpdu03::TrlrLampActvtChk_UB,0,-1,0); break;
     Case(this::SignalUBHandled) :
        resultValue = DisturbUB(Backbone::CEM::CEMBackBoneSignalIpdu03::TrlrLampActvtChk_UB,0,0,0); break;
     Case(this::SignalUBON) :
        resultValue = DisturbUB(Backbone::CEM::CEMBackBoneSignalIpdu03::TrlrLampActvtChk_UB,0,-1,1); break;
     Default :
        resultValue = -1;
  }
  
}

on sysvar_update sysvar::CEM::Backbone::Signals::Control::UB::WhlCircum_UB_Control
{
  long resultValue;
  
  // --- FR ---
  setBusContext(getBusNameContext(gFR1BusName));
  switch(@this)
  {
     Case(this::SignalUBOFF) :
        resultValue = DisturbUB(Backbone::CEM::CEMBackBoneSignalIpdu03::WhlCircum_UB,0,-1,0); break;
     Case(this::SignalUBHandled) :
        resultValue = DisturbUB(Backbone::CEM::CEMBackBoneSignalIpdu03::WhlCircum_UB,0,0,0); break;
     Case(this::SignalUBON) :
        resultValue = DisturbUB(Backbone::CEM::CEMBackBoneSignalIpdu03::WhlCircum_UB,0,-1,1); break;
     Default :
        resultValue = -1;
  }
  
}

on sysvar_update sysvar::CEM::Backbone::Signals::Control::UB::ImobEngMgrReq1_UB_Control
{
  long resultValue;
  
  // --- FR ---
  setBusContext(getBusNameContext(gFR1BusName));
  switch(@this)
  {
     Case(this::SignalUBOFF) :
        resultValue = DisturbUB(Backbone::CEM::CEMBackBoneSignalIpdu04::ImobEngMgrReq1_UB,0,-1,0); break;
     Case(this::SignalUBHandled) :
        resultValue = DisturbUB(Backbone::CEM::CEMBackBoneSignalIpdu04::ImobEngMgrReq1_UB,0,0,0); break;
     Case(this::SignalUBON) :
        resultValue = DisturbUB(Backbone::CEM::CEMBackBoneSignalIpdu04::ImobEngMgrReq1_UB,0,-1,1); break;
     Default :
        resultValue = -1;
  }
  
}

on sysvar_update sysvar::CEM::Backbone::Signals::Control::UB::ImobEngMgrReq2_UB_Control
{
  long resultValue;
  
  // --- FR ---
  setBusContext(getBusNameContext(gFR1BusName));
  switch(@this)
  {
     Case(this::SignalUBOFF) :
        resultValue = DisturbUB(Backbone::CEM::CEMBackBoneSignalIpdu04::ImobEngMgrReq2_UB,0,-1,0); break;
     Case(this::SignalUBHandled) :
        resultValue = DisturbUB(Backbone::CEM::CEMBackBoneSignalIpdu04::ImobEngMgrReq2_UB,0,0,0); break;
     Case(this::SignalUBON) :
        resultValue = DisturbUB(Backbone::CEM::CEMBackBoneSignalIpdu04::ImobEngMgrReq2_UB,0,-1,1); break;
     Default :
        resultValue = -1;
  }
  
}

on sysvar_update sysvar::CEM::Backbone::Signals::Control::UB::ImobEngMgrReq3_UB_Control
{
  long resultValue;
  
  // --- FR ---
  setBusContext(getBusNameContext(gFR1BusName));
  switch(@this)
  {
     Case(this::SignalUBOFF) :
        resultValue = DisturbUB(Backbone::CEM::CEMBackBoneSignalIpdu04::ImobEngMgrReq3_UB,0,-1,0); break;
     Case(this::SignalUBHandled) :
        resultValue = DisturbUB(Backbone::CEM::CEMBackBoneSignalIpdu04::ImobEngMgrReq3_UB,0,0,0); break;
     Case(this::SignalUBON) :
        resultValue = DisturbUB(Backbone::CEM::CEMBackBoneSignalIpdu04::ImobEngMgrReq3_UB,0,-1,1); break;
     Default :
        resultValue = -1;
  }
  
}

on sysvar_update sysvar::CEM::Backbone::Signals::Control::UB::VehCfgPrm_UB_Control
{
  long resultValue;
  
  // --- FR ---
  setBusContext(getBusNameContext(gFR1BusName));
  switch(@this)
  {
     Case(this::SignalUBOFF) :
        resultValue = DisturbUB(Backbone::CEM::CEMBackBoneSignalIpdu04::VehCfgPrm_UB,0,-1,0); break;
     Case(this::SignalUBHandled) :
        resultValue = DisturbUB(Backbone::CEM::CEMBackBoneSignalIpdu04::VehCfgPrm_UB,0,0,0); break;
     Case(this::SignalUBON) :
        resultValue = DisturbUB(Backbone::CEM::CEMBackBoneSignalIpdu04::VehCfgPrm_UB,0,-1,1); break;
     Default :
        resultValue = -1;
  }
  
}

on sysvar_update sysvar::CEM::Backbone::Signals::Control::UB::ClimaWarn_UB_Control
{
  long resultValue;
  
  // --- FR ---
  setBusContext(getBusNameContext(gFR1BusName));
  switch(@this)
  {
     Case(this::SignalUBOFF) :
        resultValue = DisturbUB(Backbone::CEM::CEMBackBoneSignalIpdu04::ClimaWarn_UB,0,-1,0); break;
     Case(this::SignalUBHandled) :
        resultValue = DisturbUB(Backbone::CEM::CEMBackBoneSignalIpdu04::ClimaWarn_UB,0,0,0); break;
     Case(this::SignalUBON) :
        resultValue = DisturbUB(Backbone::CEM::CEMBackBoneSignalIpdu04::ClimaWarn_UB,0,-1,1); break;
     Default :
        resultValue = -1;
  }
  
}

on sysvar_update sysvar::CEM::Backbone::Signals::Control::UB::EmgyAsscSts_UB_Control
{
  long resultValue;
  
  // --- FR ---
  setBusContext(getBusNameContext(gFR1BusName));
  switch(@this)
  {
     Case(this::SignalUBOFF) :
        resultValue = DisturbUB(Backbone::CEM::CEMBackBoneSignalIpdu04::EmgyAsscSts_UB,0,-1,0); break;
     Case(this::SignalUBHandled) :
        resultValue = DisturbUB(Backbone::CEM::CEMBackBoneSignalIpdu04::EmgyAsscSts_UB,0,0,0); break;
     Case(this::SignalUBON) :
        resultValue = DisturbUB(Backbone::CEM::CEMBackBoneSignalIpdu04::EmgyAsscSts_UB,0,-1,1); break;
     Default :
        resultValue = -1;
  }
  
}

on sysvar_update sysvar::CEM::Backbone::Signals::Control::UB::PwrSplyErrSts_UB_Control
{
  long resultValue;
  
  // --- FR ---
  setBusContext(getBusNameContext(gFR1BusName));
  switch(@this)
  {
     Case(this::SignalUBOFF) :
        resultValue = DisturbUB(Backbone::CEM::CEMBackBoneSignalIpdu04::PwrSplyErrSts_UB,0,-1,0); break;
     Case(this::SignalUBHandled) :
        resultValue = DisturbUB(Backbone::CEM::CEMBackBoneSignalIpdu04::PwrSplyErrSts_UB,0,0,0); break;
     Case(this::SignalUBON) :
        resultValue = DisturbUB(Backbone::CEM::CEMBackBoneSignalIpdu04::PwrSplyErrSts_UB,0,-1,1); break;
     Default :
        resultValue = -1;
  }
  
}

on sysvar_update sysvar::CEM::Backbone::SignalGroups::Control::E2E::PassAirbLampStsChks_Control
{
  int controlValue;
  long resultValue;
  
  // --- FR ---
  controlValue = (int) @this;
  setBusContext(getBusNameContext(gFR1BusName));
  switch(controlValue)
  {
     Case(this::ChksHandled) :
        resultValue = EnableCRC("PassAirbLampStsRec", 1); break;
     Case(this::ChksManual) :
        resultValue = EnableCRC("PassAirbLampStsRec", 0); break;
     Default :
        resultValue = -1;
  }
  
}

on sysvar_update sysvar::CEM::Backbone::SignalGroups::Control::E2E::PassAirbLampStsCntr_Control
{
  int controlValue;
  long resultValue;
  
  // --- FR ---
  controlValue = (int) @this;
  setBusContext(getBusNameContext(gFR1BusName));
  switch(controlValue)
  {
     Case(this::CntrHandled) :
        resultValue = EnableCounter ("PassAirbLampStsRec", 1); break;
     Case(this::CntrManual) :
        resultValue = EnableCounter ("PassAirbLampStsRec", 0); break;
     Default :
        resultValue = -1;
  }
  
}

on sysvar_update sysvar::CEM::Backbone::Signals::Control::UB::PassAirbLampStsRec_UB_Control
{
  long resultValue;
  
  // --- FR ---
  setBusContext(getBusNameContext(gFR1BusName));
  switch(@this)
  {
     Case(this::SignalUBOFF) :
        resultValue = DisturbUB(Backbone::CEM::CEMBackBoneSignalIpdu05::PassAirbLampStsRec_UB,0,-1,0); break;
     Case(this::SignalUBHandled) :
        resultValue = DisturbUB(Backbone::CEM::CEMBackBoneSignalIpdu05::PassAirbLampStsRec_UB,0,0,0); break;
     Case(this::SignalUBON) :
        resultValue = DisturbUB(Backbone::CEM::CEMBackBoneSignalIpdu05::PassAirbLampStsRec_UB,0,-1,1); break;
     Default :
        resultValue = -1;
  }
  
}

on sysvar_update sysvar::CEM::Backbone::Signals::Control::UB::ProfAct_UB_Control
{
  long resultValue;
  
  // --- FR ---
  setBusContext(getBusNameContext(gFR1BusName));
  switch(@this)
  {
     Case(this::SignalUBOFF) :
        resultValue = DisturbUB(Backbone::CEM::CEMBackBoneSignalIpdu05::ProfAct_UB,0,-1,0); break;
     Case(this::SignalUBHandled) :
        resultValue = DisturbUB(Backbone::CEM::CEMBackBoneSignalIpdu05::ProfAct_UB,0,0,0); break;
     Case(this::SignalUBON) :
        resultValue = DisturbUB(Backbone::CEM::CEMBackBoneSignalIpdu05::ProfAct_UB,0,-1,1); break;
     Default :
        resultValue = -1;
  }
  
}

on sysvar_update sysvar::CEM::Backbone::Signals::Control::UB::TrsmLockMgrReq_UB_Control
{
  long resultValue;
  
  // --- FR ---
  setBusContext(getBusNameContext(gFR1BusName));
  switch(@this)
  {
     Case(this::SignalUBOFF) :
        resultValue = DisturbUB(Backbone::CEM::CEMBackBoneSignalIpdu05::TrsmLockMgrReq_UB,0,-1,0); break;
     Case(this::SignalUBHandled) :
        resultValue = DisturbUB(Backbone::CEM::CEMBackBoneSignalIpdu05::TrsmLockMgrReq_UB,0,0,0); break;
     Case(this::SignalUBON) :
        resultValue = DisturbUB(Backbone::CEM::CEMBackBoneSignalIpdu05::TrsmLockMgrReq_UB,0,-1,1); break;
     Default :
        resultValue = -1;
  }
  
}

on sysvar_update sysvar::CEM::Backbone::Signals::Control::UB::WipgInfo_UB_Control
{
  long resultValue;
  
  // --- FR ---
  setBusContext(getBusNameContext(gFR1BusName));
  switch(@this)
  {
     Case(this::SignalUBOFF) :
        resultValue = DisturbUB(Backbone::CEM::CEMBackBoneSignalIpdu05::WipgInfo_UB,0,-1,0); break;
     Case(this::SignalUBHandled) :
        resultValue = DisturbUB(Backbone::CEM::CEMBackBoneSignalIpdu05::WipgInfo_UB,0,0,0); break;
     Case(this::SignalUBON) :
        resultValue = DisturbUB(Backbone::CEM::CEMBackBoneSignalIpdu05::WipgInfo_UB,0,-1,1); break;
     Default :
        resultValue = -1;
  }
  
}

on sysvar_update sysvar::CEM::Backbone::Signals::Control::UB::AhbcIndcnDisp_UB_Control
{
  long resultValue;
  
  // --- FR ---
  setBusContext(getBusNameContext(gFR1BusName));
  switch(@this)
  {
     Case(this::SignalUBOFF) :
        resultValue = DisturbUB(Backbone::CEM::CEMBackBoneSignalIpdu05::AhbcIndcnDisp_UB,0,-1,0); break;
     Case(this::SignalUBHandled) :
        resultValue = DisturbUB(Backbone::CEM::CEMBackBoneSignalIpdu05::AhbcIndcnDisp_UB,0,0,0); break;
     Case(this::SignalUBON) :
        resultValue = DisturbUB(Backbone::CEM::CEMBackBoneSignalIpdu05::AhbcIndcnDisp_UB,0,-1,1); break;
     Default :
        resultValue = -1;
  }
  
}

on sysvar_update sysvar::CEM::Backbone::Signals::Control::UB::AudWarn_UB_Control
{
  long resultValue;
  
  // --- FR ---
  setBusContext(getBusNameContext(gFR1BusName));
  switch(@this)
  {
     Case(this::SignalUBOFF) :
        resultValue = DisturbUB(Backbone::CEM::CEMBackBoneSignalIpdu05::AudWarn_UB,0,-1,0); break;
     Case(this::SignalUBHandled) :
        resultValue = DisturbUB(Backbone::CEM::CEMBackBoneSignalIpdu05::AudWarn_UB,0,0,0); break;
     Case(this::SignalUBON) :
        resultValue = DisturbUB(Backbone::CEM::CEMBackBoneSignalIpdu05::AudWarn_UB,0,-1,1); break;
     Default :
        resultValue = -1;
  }
  
}

on sysvar_update sysvar::CEM::Backbone::Signals::Control::UB::BeamHiIndcnDisp_UB_Control
{
  long resultValue;
  
  // --- FR ---
  setBusContext(getBusNameContext(gFR1BusName));
  switch(@this)
  {
     Case(this::SignalUBOFF) :
        resultValue = DisturbUB(Backbone::CEM::CEMBackBoneSignalIpdu05::BeamHiIndcnDisp_UB,0,-1,0); break;
     Case(this::SignalUBHandled) :
        resultValue = DisturbUB(Backbone::CEM::CEMBackBoneSignalIpdu05::BeamHiIndcnDisp_UB,0,0,0); break;
     Case(this::SignalUBON) :
        resultValue = DisturbUB(Backbone::CEM::CEMBackBoneSignalIpdu05::BeamHiIndcnDisp_UB,0,-1,1); break;
     Default :
        resultValue = -1;
  }
  
}

on sysvar_update sysvar::CEM::Backbone::Signals::Control::UB::CarTiGlb_UB_Control
{
  long resultValue;
  
  // --- FR ---
  setBusContext(getBusNameContext(gFR1BusName));
  switch(@this)
  {
     Case(this::SignalUBOFF) :
        resultValue = DisturbUB(Backbone::CEM::CEMBackBoneSignalIpdu05::CarTiGlb_UB,0,-1,0); break;
     Case(this::SignalUBHandled) :
        resultValue = DisturbUB(Backbone::CEM::CEMBackBoneSignalIpdu05::CarTiGlb_UB,0,0,0); break;
     Case(this::SignalUBON) :
        resultValue = DisturbUB(Backbone::CEM::CEMBackBoneSignalIpdu05::CarTiGlb_UB,0,-1,1); break;
     Default :
        resultValue = -1;
  }
  
}

on sysvar_update sysvar::CEM::Backbone::Signals::Control::UB::ChrgMod_UB_Control
{
  long resultValue;
  
  // --- FR ---
  setBusContext(getBusNameContext(gFR1BusName));
  switch(@this)
  {
     Case(this::SignalUBOFF) :
        resultValue = DisturbUB(Backbone::CEM::CEMBackBoneSignalIpdu05::ChrgMod_UB,0,-1,0); break;
     Case(this::SignalUBHandled) :
        resultValue = DisturbUB(Backbone::CEM::CEMBackBoneSignalIpdu05::ChrgMod_UB,0,0,0); break;
     Case(this::SignalUBON) :
        resultValue = DisturbUB(Backbone::CEM::CEMBackBoneSignalIpdu05::ChrgMod_UB,0,-1,1); break;
     Default :
        resultValue = -1;
  }
  
}

on sysvar_update sysvar::CEM::Backbone::Signals::Control::UB::ChrgnUReqMax_UB_Control
{
  long resultValue;
  
  // --- FR ---
  setBusContext(getBusNameContext(gFR1BusName));
  switch(@this)
  {
     Case(this::SignalUBOFF) :
        resultValue = DisturbUB(Backbone::CEM::CEMBackBoneSignalIpdu05::ChrgnUReqMax_UB,0,-1,0); break;
     Case(this::SignalUBHandled) :
        resultValue = DisturbUB(Backbone::CEM::CEMBackBoneSignalIpdu05::ChrgnUReqMax_UB,0,0,0); break;
     Case(this::SignalUBON) :
        resultValue = DisturbUB(Backbone::CEM::CEMBackBoneSignalIpdu05::ChrgnUReqMax_UB,0,-1,1); break;
     Default :
        resultValue = -1;
  }
  
}

on sysvar_update sysvar::CEM::Backbone::Signals::Control::UB::CrashUnlckFailrSts_UB_Control
{
  long resultValue;
  
  // --- FR ---
  setBusContext(getBusNameContext(gFR1BusName));
  switch(@this)
  {
     Case(this::SignalUBOFF) :
        resultValue = DisturbUB(Backbone::CEM::CEMBackBoneSignalIpdu05::CrashUnlckFailrSts_UB,0,-1,0); break;
     Case(this::SignalUBHandled) :
        resultValue = DisturbUB(Backbone::CEM::CEMBackBoneSignalIpdu05::CrashUnlckFailrSts_UB,0,0,0); break;
     Case(this::SignalUBON) :
        resultValue = DisturbUB(Backbone::CEM::CEMBackBoneSignalIpdu05::CrashUnlckFailrSts_UB,0,-1,1); break;
     Default :
        resultValue = -1;
  }
  
}

on sysvar_update sysvar::CEM::Backbone::Signals::Control::UB::DoorBtnPsdAtDrvr_UB_Control
{
  long resultValue;
  
  // --- FR ---
  setBusContext(getBusNameContext(gFR1BusName));
  switch(@this)
  {
     Case(this::SignalUBOFF) :
        resultValue = DisturbUB(Backbone::CEM::CEMBackBoneSignalIpdu05::DoorBtnPsdAtDrvr_UB,0,-1,0); break;
     Case(this::SignalUBHandled) :
        resultValue = DisturbUB(Backbone::CEM::CEMBackBoneSignalIpdu05::DoorBtnPsdAtDrvr_UB,0,0,0); break;
     Case(this::SignalUBON) :
        resultValue = DisturbUB(Backbone::CEM::CEMBackBoneSignalIpdu05::DoorBtnPsdAtDrvr_UB,0,-1,1); break;
     Default :
        resultValue = -1;
  }
  
}

on sysvar_update sysvar::CEM::Backbone::Signals::Control::UB::FogIndcnFrnt_UB_Control
{
  long resultValue;
  
  // --- FR ---
  setBusContext(getBusNameContext(gFR1BusName));
  switch(@this)
  {
     Case(this::SignalUBOFF) :
        resultValue = DisturbUB(Backbone::CEM::CEMBackBoneSignalIpdu05::FogIndcnFrnt_UB,0,-1,0); break;
     Case(this::SignalUBHandled) :
        resultValue = DisturbUB(Backbone::CEM::CEMBackBoneSignalIpdu05::FogIndcnFrnt_UB,0,0,0); break;
     Case(this::SignalUBON) :
        resultValue = DisturbUB(Backbone::CEM::CEMBackBoneSignalIpdu05::FogIndcnFrnt_UB,0,-1,1); break;
     Default :
        resultValue = -1;
  }
  
}

on sysvar_update sysvar::CEM::Backbone::Signals::Control::UB::FogIndcnReDisp_UB_Control
{
  long resultValue;
  
  // --- FR ---
  setBusContext(getBusNameContext(gFR1BusName));
  switch(@this)
  {
     Case(this::SignalUBOFF) :
        resultValue = DisturbUB(Backbone::CEM::CEMBackBoneSignalIpdu05::FogIndcnReDisp_UB,0,-1,0); break;
     Case(this::SignalUBHandled) :
        resultValue = DisturbUB(Backbone::CEM::CEMBackBoneSignalIpdu05::FogIndcnReDisp_UB,0,0,0); break;
     Case(this::SignalUBON) :
        resultValue = DisturbUB(Backbone::CEM::CEMBackBoneSignalIpdu05::FogIndcnReDisp_UB,0,-1,1); break;
     Default :
        resultValue = -1;
  }
  
}

on sysvar_update sysvar::CEM::Backbone::Signals::Control::UB::HvacCoolgEnaRe_UB_Control
{
  long resultValue;
  
  // --- FR ---
  setBusContext(getBusNameContext(gFR1BusName));
  switch(@this)
  {
     Case(this::SignalUBOFF) :
        resultValue = DisturbUB(Backbone::CEM::CEMBackBoneSignalIpdu05::HvacCoolgEnaRe_UB,0,-1,0); break;
     Case(this::SignalUBHandled) :
        resultValue = DisturbUB(Backbone::CEM::CEMBackBoneSignalIpdu05::HvacCoolgEnaRe_UB,0,0,0); break;
     Case(this::SignalUBON) :
        resultValue = DisturbUB(Backbone::CEM::CEMBackBoneSignalIpdu05::HvacCoolgEnaRe_UB,0,-1,1); break;
     Default :
        resultValue = -1;
  }
  
}

on sysvar_update sysvar::CEM::Backbone::Signals::Control::UB::LcmaLedStsDrvrSide_UB_Control
{
  long resultValue;
  
  // --- FR ---
  setBusContext(getBusNameContext(gFR1BusName));
  switch(@this)
  {
     Case(this::SignalUBOFF) :
        resultValue = DisturbUB(Backbone::CEM::CEMBackBoneSignalIpdu05::LcmaLedStsDrvrSide_UB,0,-1,0); break;
     Case(this::SignalUBHandled) :
        resultValue = DisturbUB(Backbone::CEM::CEMBackBoneSignalIpdu05::LcmaLedStsDrvrSide_UB,0,0,0); break;
     Case(this::SignalUBON) :
        resultValue = DisturbUB(Backbone::CEM::CEMBackBoneSignalIpdu05::LcmaLedStsDrvrSide_UB,0,-1,1); break;
     Default :
        resultValue = -1;
  }
  
}

on sysvar_update sysvar::CEM::Backbone::Signals::Control::UB::LcmaLedStsPassSide_UB_Control
{
  long resultValue;
  
  // --- FR ---
  setBusContext(getBusNameContext(gFR1BusName));
  switch(@this)
  {
     Case(this::SignalUBOFF) :
        resultValue = DisturbUB(Backbone::CEM::CEMBackBoneSignalIpdu05::LcmaLedStsPassSide_UB,0,-1,0); break;
     Case(this::SignalUBHandled) :
        resultValue = DisturbUB(Backbone::CEM::CEMBackBoneSignalIpdu05::LcmaLedStsPassSide_UB,0,0,0); break;
     Case(this::SignalUBON) :
        resultValue = DisturbUB(Backbone::CEM::CEMBackBoneSignalIpdu05::LcmaLedStsPassSide_UB,0,-1,1); break;
     Default :
        resultValue = -1;
  }
  
}

on sysvar_update sysvar::CEM::Backbone::Signals::Control::UB::LiPosnIndcnDisp_UB_Control
{
  long resultValue;
  
  // --- FR ---
  setBusContext(getBusNameContext(gFR1BusName));
  switch(@this)
  {
     Case(this::SignalUBOFF) :
        resultValue = DisturbUB(Backbone::CEM::CEMBackBoneSignalIpdu05::LiPosnIndcnDisp_UB,0,-1,0); break;
     Case(this::SignalUBHandled) :
        resultValue = DisturbUB(Backbone::CEM::CEMBackBoneSignalIpdu05::LiPosnIndcnDisp_UB,0,0,0); break;
     Case(this::SignalUBON) :
        resultValue = DisturbUB(Backbone::CEM::CEMBackBoneSignalIpdu05::LiPosnIndcnDisp_UB,0,-1,1); break;
     Default :
        resultValue = -1;
  }
  
}

on sysvar_update sysvar::CEM::Backbone::Signals::Control::UB::LockgPrsnlSts_UB_Control
{
  long resultValue;
  
  // --- FR ---
  setBusContext(getBusNameContext(gFR1BusName));
  switch(@this)
  {
     Case(this::SignalUBOFF) :
        resultValue = DisturbUB(Backbone::CEM::CEMBackBoneSignalIpdu05::LockgPrsnlSts_UB,0,-1,0); break;
     Case(this::SignalUBHandled) :
        resultValue = DisturbUB(Backbone::CEM::CEMBackBoneSignalIpdu05::LockgPrsnlSts_UB,0,0,0); break;
     Case(this::SignalUBON) :
        resultValue = DisturbUB(Backbone::CEM::CEMBackBoneSignalIpdu05::LockgPrsnlSts_UB,0,-1,1); break;
     Default :
        resultValue = -1;
  }
  
}

on sysvar_update sysvar::CEM::Backbone::Signals::Control::UB::MemBtnSound_UB_Control
{
  long resultValue;
  
  // --- FR ---
  setBusContext(getBusNameContext(gFR1BusName));
  switch(@this)
  {
     Case(this::SignalUBOFF) :
        resultValue = DisturbUB(Backbone::CEM::CEMBackBoneSignalIpdu05::MemBtnSound_UB,0,-1,0); break;
     Case(this::SignalUBHandled) :
        resultValue = DisturbUB(Backbone::CEM::CEMBackBoneSignalIpdu05::MemBtnSound_UB,0,0,0); break;
     Case(this::SignalUBON) :
        resultValue = DisturbUB(Backbone::CEM::CEMBackBoneSignalIpdu05::MemBtnSound_UB,0,-1,1); break;
     Default :
        resultValue = -1;
  }
  
}

on sysvar_update sysvar::CEM::Backbone::Signals::Control::UB::NrOfKeyAvl_UB_Control
{
  long resultValue;
  
  // --- FR ---
  setBusContext(getBusNameContext(gFR1BusName));
  switch(@this)
  {
     Case(this::SignalUBOFF) :
        resultValue = DisturbUB(Backbone::CEM::CEMBackBoneSignalIpdu05::NrOfKeyAvl_UB,0,-1,0); break;
     Case(this::SignalUBHandled) :
        resultValue = DisturbUB(Backbone::CEM::CEMBackBoneSignalIpdu05::NrOfKeyAvl_UB,0,0,0); break;
     Case(this::SignalUBON) :
        resultValue = DisturbUB(Backbone::CEM::CEMBackBoneSignalIpdu05::NrOfKeyAvl_UB,0,-1,1); break;
     Default :
        resultValue = -1;
  }
  
}

on sysvar_update sysvar::CEM::Backbone::Signals::Control::UB::RmnLockgPrsnlReq_UB_Control
{
  long resultValue;
  
  // --- FR ---
  setBusContext(getBusNameContext(gFR1BusName));
  switch(@this)
  {
     Case(this::SignalUBOFF) :
        resultValue = DisturbUB(Backbone::CEM::CEMBackBoneSignalIpdu05::RmnLockgPrsnlReq_UB,0,-1,0); break;
     Case(this::SignalUBHandled) :
        resultValue = DisturbUB(Backbone::CEM::CEMBackBoneSignalIpdu05::RmnLockgPrsnlReq_UB,0,0,0); break;
     Case(this::SignalUBON) :
        resultValue = DisturbUB(Backbone::CEM::CEMBackBoneSignalIpdu05::RmnLockgPrsnlReq_UB,0,-1,1); break;
     Default :
        resultValue = -1;
  }
  
}

on sysvar_update sysvar::CEM::Backbone::Signals::Control::UB::SeatHeatgAutCdn_UB_Control
{
  long resultValue;
  
  // --- FR ---
  setBusContext(getBusNameContext(gFR1BusName));
  switch(@this)
  {
     Case(this::SignalUBOFF) :
        resultValue = DisturbUB(Backbone::CEM::CEMBackBoneSignalIpdu05::SeatHeatgAutCdn_UB,0,-1,0); break;
     Case(this::SignalUBHandled) :
        resultValue = DisturbUB(Backbone::CEM::CEMBackBoneSignalIpdu05::SeatHeatgAutCdn_UB,0,0,0); break;
     Case(this::SignalUBON) :
        resultValue = DisturbUB(Backbone::CEM::CEMBackBoneSignalIpdu05::SeatHeatgAutCdn_UB,0,-1,1); break;
     Default :
        resultValue = -1;
  }
  
}

on sysvar_update sysvar::CEM::Backbone::Signals::Control::UB::SteerLockMgrWarnIndcn_UB_Control
{
  long resultValue;
  
  // --- FR ---
  setBusContext(getBusNameContext(gFR1BusName));
  switch(@this)
  {
     Case(this::SignalUBOFF) :
        resultValue = DisturbUB(Backbone::CEM::CEMBackBoneSignalIpdu05::SteerLockMgrWarnIndcn_UB,0,-1,0); break;
     Case(this::SignalUBHandled) :
        resultValue = DisturbUB(Backbone::CEM::CEMBackBoneSignalIpdu05::SteerLockMgrWarnIndcn_UB,0,0,0); break;
     Case(this::SignalUBON) :
        resultValue = DisturbUB(Backbone::CEM::CEMBackBoneSignalIpdu05::SteerLockMgrWarnIndcn_UB,0,-1,1); break;
     Default :
        resultValue = -1;
  }
  
}

on sysvar_update sysvar::CEM::Backbone::Signals::Control::UB::TankFlapSts_UB_Control
{
  long resultValue;
  
  // --- FR ---
  setBusContext(getBusNameContext(gFR1BusName));
  switch(@this)
  {
     Case(this::SignalUBOFF) :
        resultValue = DisturbUB(Backbone::CEM::CEMBackBoneSignalIpdu05::TankFlapSts_UB,0,-1,0); break;
     Case(this::SignalUBHandled) :
        resultValue = DisturbUB(Backbone::CEM::CEMBackBoneSignalIpdu05::TankFlapSts_UB,0,0,0); break;
     Case(this::SignalUBON) :
        resultValue = DisturbUB(Backbone::CEM::CEMBackBoneSignalIpdu05::TankFlapSts_UB,0,-1,1); break;
     Default :
        resultValue = -1;
  }
  
}

on sysvar_update sysvar::CEM::Backbone::Signals::Control::UB::TiDrvgCycOff_UB_Control
{
  long resultValue;
  
  // --- FR ---
  setBusContext(getBusNameContext(gFR1BusName));
  switch(@this)
  {
     Case(this::SignalUBOFF) :
        resultValue = DisturbUB(Backbone::CEM::CEMBackBoneSignalIpdu05::TiDrvgCycOff_UB,0,-1,0); break;
     Case(this::SignalUBHandled) :
        resultValue = DisturbUB(Backbone::CEM::CEMBackBoneSignalIpdu05::TiDrvgCycOff_UB,0,0,0); break;
     Case(this::SignalUBON) :
        resultValue = DisturbUB(Backbone::CEM::CEMBackBoneSignalIpdu05::TiDrvgCycOff_UB,0,-1,1); break;
     Default :
        resultValue = -1;
  }
  
}

on sysvar_update sysvar::CEM::Backbone::Signals::Control::UB::TrlrLiSts_UB_Control
{
  long resultValue;
  
  // --- FR ---
  setBusContext(getBusNameContext(gFR1BusName));
  switch(@this)
  {
     Case(this::SignalUBOFF) :
        resultValue = DisturbUB(Backbone::CEM::CEMBackBoneSignalIpdu05::TrlrLiSts_UB,0,-1,0); break;
     Case(this::SignalUBHandled) :
        resultValue = DisturbUB(Backbone::CEM::CEMBackBoneSignalIpdu05::TrlrLiSts_UB,0,0,0); break;
     Case(this::SignalUBON) :
        resultValue = DisturbUB(Backbone::CEM::CEMBackBoneSignalIpdu05::TrlrLiSts_UB,0,-1,1); break;
     Default :
        resultValue = -1;
  }
  
}

on sysvar_update sysvar::CEM::Backbone::Signals::Control::UB::TrlrPrsnt_UB_Control
{
  long resultValue;
  
  // --- FR ---
  setBusContext(getBusNameContext(gFR1BusName));
  switch(@this)
  {
     Case(this::SignalUBOFF) :
        resultValue = DisturbUB(Backbone::CEM::CEMBackBoneSignalIpdu05::TrlrPrsnt_UB,0,-1,0); break;
     Case(this::SignalUBHandled) :
        resultValue = DisturbUB(Backbone::CEM::CEMBackBoneSignalIpdu05::TrlrPrsnt_UB,0,0,0); break;
     Case(this::SignalUBON) :
        resultValue = DisturbUB(Backbone::CEM::CEMBackBoneSignalIpdu05::TrlrPrsnt_UB,0,-1,1); break;
     Default :
        resultValue = -1;
  }
  
}

on sysvar_update sysvar::CEM::Backbone::Signals::Control::UB::TrlrSrvReq_UB_Control
{
  long resultValue;
  
  // --- FR ---
  setBusContext(getBusNameContext(gFR1BusName));
  switch(@this)
  {
     Case(this::SignalUBOFF) :
        resultValue = DisturbUB(Backbone::CEM::CEMBackBoneSignalIpdu05::TrlrSrvReq_UB,0,-1,0); break;
     Case(this::SignalUBHandled) :
        resultValue = DisturbUB(Backbone::CEM::CEMBackBoneSignalIpdu05::TrlrSrvReq_UB,0,0,0); break;
     Case(this::SignalUBON) :
        resultValue = DisturbUB(Backbone::CEM::CEMBackBoneSignalIpdu05::TrlrSrvReq_UB,0,-1,1); break;
     Default :
        resultValue = -1;
  }
  
}

on sysvar_update sysvar::CEM::Backbone::Signals::Control::UB::URateUpRampMax_UB_Control
{
  long resultValue;
  
  // --- FR ---
  setBusContext(getBusNameContext(gFR1BusName));
  switch(@this)
  {
     Case(this::SignalUBOFF) :
        resultValue = DisturbUB(Backbone::CEM::CEMBackBoneSignalIpdu05::URateUpRampMax_UB,0,-1,0); break;
     Case(this::SignalUBHandled) :
        resultValue = DisturbUB(Backbone::CEM::CEMBackBoneSignalIpdu05::URateUpRampMax_UB,0,0,0); break;
     Case(this::SignalUBON) :
        resultValue = DisturbUB(Backbone::CEM::CEMBackBoneSignalIpdu05::URateUpRampMax_UB,0,-1,1); break;
     Default :
        resultValue = -1;
  }
  
}

on sysvar_update sysvar::CEM::Backbone::Signals::Control::UB::VehParkNotActvd_UB_Control
{
  long resultValue;
  
  // --- FR ---
  setBusContext(getBusNameContext(gFR1BusName));
  switch(@this)
  {
     Case(this::SignalUBOFF) :
        resultValue = DisturbUB(Backbone::CEM::CEMBackBoneSignalIpdu05::VehParkNotActvd_UB,0,-1,0); break;
     Case(this::SignalUBHandled) :
        resultValue = DisturbUB(Backbone::CEM::CEMBackBoneSignalIpdu05::VehParkNotActvd_UB,0,0,0); break;
     Case(this::SignalUBON) :
        resultValue = DisturbUB(Backbone::CEM::CEMBackBoneSignalIpdu05::VehParkNotActvd_UB,0,-1,1); break;
     Default :
        resultValue = -1;
  }
  
}

on sysvar_update sysvar::CEM::Backbone::Signals::Control::UB::WinPosnStsAtDrvrRe_UB_Control
{
  long resultValue;
  
  // --- FR ---
  setBusContext(getBusNameContext(gFR1BusName));
  switch(@this)
  {
     Case(this::SignalUBOFF) :
        resultValue = DisturbUB(Backbone::CEM::CEMBackBoneSignalIpdu05::WinPosnStsAtDrvrRe_UB,0,-1,0); break;
     Case(this::SignalUBHandled) :
        resultValue = DisturbUB(Backbone::CEM::CEMBackBoneSignalIpdu05::WinPosnStsAtDrvrRe_UB,0,0,0); break;
     Case(this::SignalUBON) :
        resultValue = DisturbUB(Backbone::CEM::CEMBackBoneSignalIpdu05::WinPosnStsAtDrvrRe_UB,0,-1,1); break;
     Default :
        resultValue = -1;
  }
  
}

on sysvar_update sysvar::CEM::Backbone::Signals::Control::UB::WinWshrLvrCmd_UB_Control
{
  long resultValue;
  
  // --- FR ---
  setBusContext(getBusNameContext(gFR1BusName));
  switch(@this)
  {
     Case(this::SignalUBOFF) :
        resultValue = DisturbUB(Backbone::CEM::CEMBackBoneSignalIpdu05::WinWshrLvrCmd_UB,0,-1,0); break;
     Case(this::SignalUBHandled) :
        resultValue = DisturbUB(Backbone::CEM::CEMBackBoneSignalIpdu05::WinWshrLvrCmd_UB,0,0,0); break;
     Case(this::SignalUBON) :
        resultValue = DisturbUB(Backbone::CEM::CEMBackBoneSignalIpdu05::WinWshrLvrCmd_UB,0,-1,1); break;
     Default :
        resultValue = -1;
  }
  
}

on sysvar_update sysvar::CEM::Backbone::SignalGroups::Control::E2E::FrntWiprLvrReq2FrntWiprLvrCntr_Control
{
  int controlValue;
  long resultValue;
  
  // --- FR ---
  controlValue = (int) @this;
  setBusContext(getBusNameContext(gFR1BusName));
  switch(controlValue)
  {
     Case(this::CntrHandled) :
        resultValue = EnableCounter ("FrntWiprLvrReq2", 1); break;
     Case(this::CntrManual) :
        resultValue = EnableCounter ("FrntWiprLvrReq2", 0); break;
     Default :
        resultValue = -1;
  }
  
}

on sysvar_update sysvar::CEM::Backbone::Signals::Control::UB::DrvrSeatMassgFct_UB_Control
{
  long resultValue;
  
  // --- FR ---
  setBusContext(getBusNameContext(gFR1BusName));
  switch(@this)
  {
     Case(this::SignalUBOFF) :
        resultValue = DisturbUB(Backbone::CEM::CEMBackBoneSignalIpdu06::DrvrSeatMassgFct_UB,0,-1,0); break;
     Case(this::SignalUBHandled) :
        resultValue = DisturbUB(Backbone::CEM::CEMBackBoneSignalIpdu06::DrvrSeatMassgFct_UB,0,0,0); break;
     Case(this::SignalUBON) :
        resultValue = DisturbUB(Backbone::CEM::CEMBackBoneSignalIpdu06::DrvrSeatMassgFct_UB,0,-1,1); break;
     Default :
        resultValue = -1;
  }
  
}

on sysvar_update sysvar::CEM::Backbone::Signals::Control::UB::EvaprVlvReStsExtd_UB_Control
{
  long resultValue;
  
  // --- FR ---
  setBusContext(getBusNameContext(gFR1BusName));
  switch(@this)
  {
     Case(this::SignalUBOFF) :
        resultValue = DisturbUB(Backbone::CEM::CEMBackBoneSignalIpdu06::EvaprVlvReStsExtd_UB,0,-1,0); break;
     Case(this::SignalUBHandled) :
        resultValue = DisturbUB(Backbone::CEM::CEMBackBoneSignalIpdu06::EvaprVlvReStsExtd_UB,0,0,0); break;
     Case(this::SignalUBON) :
        resultValue = DisturbUB(Backbone::CEM::CEMBackBoneSignalIpdu06::EvaprVlvReStsExtd_UB,0,-1,1); break;
     Default :
        resultValue = -1;
  }
  
}

on sysvar_update sysvar::CEM::Backbone::Signals::Control::UB::FrntWiprLvrReq2_UB_Control
{
  long resultValue;
  
  // --- FR ---
  setBusContext(getBusNameContext(gFR1BusName));
  switch(@this)
  {
     Case(this::SignalUBOFF) :
        resultValue = DisturbUB(Backbone::CEM::CEMBackBoneSignalIpdu06::FrntWiprLvrReq2_UB,0,-1,0); break;
     Case(this::SignalUBHandled) :
        resultValue = DisturbUB(Backbone::CEM::CEMBackBoneSignalIpdu06::FrntWiprLvrReq2_UB,0,0,0); break;
     Case(this::SignalUBON) :
        resultValue = DisturbUB(Backbone::CEM::CEMBackBoneSignalIpdu06::FrntWiprLvrReq2_UB,0,-1,1); break;
     Default :
        resultValue = -1;
  }
  
}

on sysvar_update sysvar::CEM::Backbone::Signals::Control::UB::PassSeatMassgFct_UB_Control
{
  long resultValue;
  
  // --- FR ---
  setBusContext(getBusNameContext(gFR1BusName));
  switch(@this)
  {
     Case(this::SignalUBOFF) :
        resultValue = DisturbUB(Backbone::CEM::CEMBackBoneSignalIpdu06::PassSeatMassgFct_UB,0,-1,0); break;
     Case(this::SignalUBHandled) :
        resultValue = DisturbUB(Backbone::CEM::CEMBackBoneSignalIpdu06::PassSeatMassgFct_UB,0,0,0); break;
     Case(this::SignalUBON) :
        resultValue = DisturbUB(Backbone::CEM::CEMBackBoneSignalIpdu06::PassSeatMassgFct_UB,0,-1,1); break;
     Default :
        resultValue = -1;
  }
  
}

on sysvar_update sysvar::CEM::Backbone::Signals::Control::UB::TiAndDateIndcn_UB_Control
{
  long resultValue;
  
  // --- FR ---
  setBusContext(getBusNameContext(gFR1BusName));
  switch(@this)
  {
     Case(this::SignalUBOFF) :
        resultValue = DisturbUB(Backbone::CEM::CEMBackBoneSignalIpdu06::TiAndDateIndcn_UB,0,-1,0); break;
     Case(this::SignalUBHandled) :
        resultValue = DisturbUB(Backbone::CEM::CEMBackBoneSignalIpdu06::TiAndDateIndcn_UB,0,0,0); break;
     Case(this::SignalUBON) :
        resultValue = DisturbUB(Backbone::CEM::CEMBackBoneSignalIpdu06::TiAndDateIndcn_UB,0,-1,1); break;
     Default :
        resultValue = -1;
  }
  
}

on sysvar_update sysvar::CEM::Backbone::Signals::Control::UB::TirePAbsltValFrntLe_UB_Control
{
  long resultValue;
  
  // --- FR ---
  setBusContext(getBusNameContext(gFR1BusName));
  switch(@this)
  {
     Case(this::SignalUBOFF) :
        resultValue = DisturbUB(Backbone::CEM::CEMBackBoneSignalIpdu06::TirePAbsltValFrntLe_UB,0,-1,0); break;
     Case(this::SignalUBHandled) :
        resultValue = DisturbUB(Backbone::CEM::CEMBackBoneSignalIpdu06::TirePAbsltValFrntLe_UB,0,0,0); break;
     Case(this::SignalUBON) :
        resultValue = DisturbUB(Backbone::CEM::CEMBackBoneSignalIpdu06::TirePAbsltValFrntLe_UB,0,-1,1); break;
     Default :
        resultValue = -1;
  }
  
}

on sysvar_update sysvar::CEM::Backbone::Signals::Control::UB::TirePAbsltValFrntRi_UB_Control
{
  long resultValue;
  
  // --- FR ---
  setBusContext(getBusNameContext(gFR1BusName));
  switch(@this)
  {
     Case(this::SignalUBOFF) :
        resultValue = DisturbUB(Backbone::CEM::CEMBackBoneSignalIpdu06::TirePAbsltValFrntRi_UB,0,-1,0); break;
     Case(this::SignalUBHandled) :
        resultValue = DisturbUB(Backbone::CEM::CEMBackBoneSignalIpdu06::TirePAbsltValFrntRi_UB,0,0,0); break;
     Case(this::SignalUBON) :
        resultValue = DisturbUB(Backbone::CEM::CEMBackBoneSignalIpdu06::TirePAbsltValFrntRi_UB,0,-1,1); break;
     Default :
        resultValue = -1;
  }
  
}

on sysvar_update sysvar::CEM::Backbone::Signals::Control::UB::TirePAbsltValReLe_UB_Control
{
  long resultValue;
  
  // --- FR ---
  setBusContext(getBusNameContext(gFR1BusName));
  switch(@this)
  {
     Case(this::SignalUBOFF) :
        resultValue = DisturbUB(Backbone::CEM::CEMBackBoneSignalIpdu06::TirePAbsltValReLe_UB,0,-1,0); break;
     Case(this::SignalUBHandled) :
        resultValue = DisturbUB(Backbone::CEM::CEMBackBoneSignalIpdu06::TirePAbsltValReLe_UB,0,0,0); break;
     Case(this::SignalUBON) :
        resultValue = DisturbUB(Backbone::CEM::CEMBackBoneSignalIpdu06::TirePAbsltValReLe_UB,0,-1,1); break;
     Default :
        resultValue = -1;
  }
  
}

on sysvar_update sysvar::CEM::Backbone::Signals::Control::UB::TirePAbsltValReRi_UB_Control
{
  long resultValue;
  
  // --- FR ---
  setBusContext(getBusNameContext(gFR1BusName));
  switch(@this)
  {
     Case(this::SignalUBOFF) :
        resultValue = DisturbUB(Backbone::CEM::CEMBackBoneSignalIpdu06::TirePAbsltValReRi_UB,0,-1,0); break;
     Case(this::SignalUBHandled) :
        resultValue = DisturbUB(Backbone::CEM::CEMBackBoneSignalIpdu06::TirePAbsltValReRi_UB,0,0,0); break;
     Case(this::SignalUBON) :
        resultValue = DisturbUB(Backbone::CEM::CEMBackBoneSignalIpdu06::TirePAbsltValReRi_UB,0,-1,1); break;
     Default :
        resultValue = -1;
  }
  
}

on sysvar_update sysvar::CEM::Backbone::Signals::Control::UB::TirePMonData_UB_Control
{
  long resultValue;
  
  // --- FR ---
  setBusContext(getBusNameContext(gFR1BusName));
  switch(@this)
  {
     Case(this::SignalUBOFF) :
        resultValue = DisturbUB(Backbone::CEM::CEMBackBoneSignalIpdu06::TirePMonData_UB,0,-1,0); break;
     Case(this::SignalUBHandled) :
        resultValue = DisturbUB(Backbone::CEM::CEMBackBoneSignalIpdu06::TirePMonData_UB,0,0,0); break;
     Case(this::SignalUBON) :
        resultValue = DisturbUB(Backbone::CEM::CEMBackBoneSignalIpdu06::TirePMonData_UB,0,-1,1); break;
     Default :
        resultValue = -1;
  }
  
}

on sysvar_update sysvar::CEM::Backbone::Signals::Control::UB::UsrIntxcnChkIndcn_UB_Control
{
  long resultValue;
  
  // --- FR ---
  setBusContext(getBusNameContext(gFR1BusName));
  switch(@this)
  {
     Case(this::SignalUBOFF) :
        resultValue = DisturbUB(Backbone::CEM::CEMBackBoneSignalIpdu06::UsrIntxcnChkIndcn_UB,0,-1,0); break;
     Case(this::SignalUBHandled) :
        resultValue = DisturbUB(Backbone::CEM::CEMBackBoneSignalIpdu06::UsrIntxcnChkIndcn_UB,0,0,0); break;
     Case(this::SignalUBON) :
        resultValue = DisturbUB(Backbone::CEM::CEMBackBoneSignalIpdu06::UsrIntxcnChkIndcn_UB,0,-1,1); break;
     Default :
        resultValue = -1;
  }
  
}

on sysvar_update sysvar::CEM::Backbone::Signals::Control::UB::AprchAndHomeSafeLiSts_UB_Control
{
  long resultValue;
  
  // --- FR ---
  setBusContext(getBusNameContext(gFR1BusName));
  switch(@this)
  {
     Case(this::SignalUBOFF) :
        resultValue = DisturbUB(Backbone::CEM::CEMBackBoneSignalIpdu06::AprchAndHomeSafeLiSts_UB,0,-1,0); break;
     Case(this::SignalUBHandled) :
        resultValue = DisturbUB(Backbone::CEM::CEMBackBoneSignalIpdu06::AprchAndHomeSafeLiSts_UB,0,0,0); break;
     Case(this::SignalUBON) :
        resultValue = DisturbUB(Backbone::CEM::CEMBackBoneSignalIpdu06::AprchAndHomeSafeLiSts_UB,0,-1,1); break;
     Default :
        resultValue = -1;
  }
  
}

on sysvar_update sysvar::CEM::Backbone::Signals::Control::UB::ClimaPwrCns_UB_Control
{
  long resultValue;
  
  // --- FR ---
  setBusContext(getBusNameContext(gFR1BusName));
  switch(@this)
  {
     Case(this::SignalUBOFF) :
        resultValue = DisturbUB(Backbone::CEM::CEMBackBoneSignalIpdu06::ClimaPwrCns_UB,0,-1,0); break;
     Case(this::SignalUBHandled) :
        resultValue = DisturbUB(Backbone::CEM::CEMBackBoneSignalIpdu06::ClimaPwrCns_UB,0,0,0); break;
     Case(this::SignalUBON) :
        resultValue = DisturbUB(Backbone::CEM::CEMBackBoneSignalIpdu06::ClimaPwrCns_UB,0,-1,1); break;
     Default :
        resultValue = -1;
  }
  
}

on sysvar_update sysvar::CEM::Backbone::Signals::Control::UB::DrvrSeatBtnPsd_UB_Control
{
  long resultValue;
  
  // --- FR ---
  setBusContext(getBusNameContext(gFR1BusName));
  switch(@this)
  {
     Case(this::SignalUBOFF) :
        resultValue = DisturbUB(Backbone::CEM::CEMBackBoneSignalIpdu06::DrvrSeatBtnPsd_UB,0,-1,0); break;
     Case(this::SignalUBHandled) :
        resultValue = DisturbUB(Backbone::CEM::CEMBackBoneSignalIpdu06::DrvrSeatBtnPsd_UB,0,0,0); break;
     Case(this::SignalUBON) :
        resultValue = DisturbUB(Backbone::CEM::CEMBackBoneSignalIpdu06::DrvrSeatBtnPsd_UB,0,-1,1); break;
     Default :
        resultValue = -1;
  }
  
}

on sysvar_update sysvar::CEM::Backbone::Signals::Control::UB::DstTrvldVldFromBodyBkp_UB_Control
{
  long resultValue;
  
  // --- FR ---
  setBusContext(getBusNameContext(gFR1BusName));
  switch(@this)
  {
     Case(this::SignalUBOFF) :
        resultValue = DisturbUB(Backbone::CEM::CEMBackBoneSignalIpdu06::DstTrvldVldFromBodyBkp_UB,0,-1,0); break;
     Case(this::SignalUBHandled) :
        resultValue = DisturbUB(Backbone::CEM::CEMBackBoneSignalIpdu06::DstTrvldVldFromBodyBkp_UB,0,0,0); break;
     Case(this::SignalUBON) :
        resultValue = DisturbUB(Backbone::CEM::CEMBackBoneSignalIpdu06::DstTrvldVldFromBodyBkp_UB,0,-1,1); break;
     Default :
        resultValue = -1;
  }
  
}

on sysvar_update sysvar::CEM::Backbone::Signals::Control::UB::EmgyBrkParkAutSts_UB_Control
{
  long resultValue;
  
  // --- FR ---
  setBusContext(getBusNameContext(gFR1BusName));
  switch(@this)
  {
     Case(this::SignalUBOFF) :
        resultValue = DisturbUB(Backbone::CEM::CEMBackBoneSignalIpdu06::EmgyBrkParkAutSts_UB,0,-1,0); break;
     Case(this::SignalUBHandled) :
        resultValue = DisturbUB(Backbone::CEM::CEMBackBoneSignalIpdu06::EmgyBrkParkAutSts_UB,0,0,0); break;
     Case(this::SignalUBON) :
        resultValue = DisturbUB(Backbone::CEM::CEMBackBoneSignalIpdu06::EmgyBrkParkAutSts_UB,0,-1,1); break;
     Default :
        resultValue = -1;
  }
  
}

on sysvar_update sysvar::CEM::Backbone::Signals::Control::UB::EngRunngReqByClima_UB_Control
{
  long resultValue;
  
  // --- FR ---
  setBusContext(getBusNameContext(gFR1BusName));
  switch(@this)
  {
     Case(this::SignalUBOFF) :
        resultValue = DisturbUB(Backbone::CEM::CEMBackBoneSignalIpdu06::EngRunngReqByClima_UB,0,-1,0); break;
     Case(this::SignalUBHandled) :
        resultValue = DisturbUB(Backbone::CEM::CEMBackBoneSignalIpdu06::EngRunngReqByClima_UB,0,0,0); break;
     Case(this::SignalUBON) :
        resultValue = DisturbUB(Backbone::CEM::CEMBackBoneSignalIpdu06::EngRunngReqByClima_UB,0,-1,1); break;
     Default :
        resultValue = -1;
  }
  
}

on sysvar_update sysvar::CEM::Backbone::Signals::Control::UB::FrntAxleWarn_UB_Control
{
  long resultValue;
  
  // --- FR ---
  setBusContext(getBusNameContext(gFR1BusName));
  switch(@this)
  {
     Case(this::SignalUBOFF) :
        resultValue = DisturbUB(Backbone::CEM::CEMBackBoneSignalIpdu06::FrntAxleWarn_UB,0,-1,0); break;
     Case(this::SignalUBHandled) :
        resultValue = DisturbUB(Backbone::CEM::CEMBackBoneSignalIpdu06::FrntAxleWarn_UB,0,0,0); break;
     Case(this::SignalUBON) :
        resultValue = DisturbUB(Backbone::CEM::CEMBackBoneSignalIpdu06::FrntAxleWarn_UB,0,-1,1); break;
     Default :
        resultValue = -1;
  }
  
}

on sysvar_update sysvar::CEM::Backbone::Signals::Control::UB::FuHeatrFuCns1_UB_Control
{
  long resultValue;
  
  // --- FR ---
  setBusContext(getBusNameContext(gFR1BusName));
  switch(@this)
  {
     Case(this::SignalUBOFF) :
        resultValue = DisturbUB(Backbone::CEM::CEMBackBoneSignalIpdu06::FuHeatrFuCns1_UB,0,-1,0); break;
     Case(this::SignalUBHandled) :
        resultValue = DisturbUB(Backbone::CEM::CEMBackBoneSignalIpdu06::FuHeatrFuCns1_UB,0,0,0); break;
     Case(this::SignalUBON) :
        resultValue = DisturbUB(Backbone::CEM::CEMBackBoneSignalIpdu06::FuHeatrFuCns1_UB,0,-1,1); break;
     Default :
        resultValue = -1;
  }
  
}

on sysvar_update sysvar::CEM::Backbone::Signals::Control::UB::HeatrCooltT_UB_Control
{
  long resultValue;
  
  // --- FR ---
  setBusContext(getBusNameContext(gFR1BusName));
  switch(@this)
  {
     Case(this::SignalUBOFF) :
        resultValue = DisturbUB(Backbone::CEM::CEMBackBoneSignalIpdu06::HeatrCooltT_UB,0,-1,0); break;
     Case(this::SignalUBHandled) :
        resultValue = DisturbUB(Backbone::CEM::CEMBackBoneSignalIpdu06::HeatrCooltT_UB,0,0,0); break;
     Case(this::SignalUBON) :
        resultValue = DisturbUB(Backbone::CEM::CEMBackBoneSignalIpdu06::HeatrCooltT_UB,0,-1,1); break;
     Default :
        resultValue = -1;
  }
  
}

on sysvar_update sysvar::CEM::Backbone::Signals::Control::UB::HvacCooltVlvSts_UB_Control
{
  long resultValue;
  
  // --- FR ---
  setBusContext(getBusNameContext(gFR1BusName));
  switch(@this)
  {
     Case(this::SignalUBOFF) :
        resultValue = DisturbUB(Backbone::CEM::CEMBackBoneSignalIpdu06::HvacCooltVlvSts_UB,0,-1,0); break;
     Case(this::SignalUBHandled) :
        resultValue = DisturbUB(Backbone::CEM::CEMBackBoneSignalIpdu06::HvacCooltVlvSts_UB,0,0,0); break;
     Case(this::SignalUBON) :
        resultValue = DisturbUB(Backbone::CEM::CEMBackBoneSignalIpdu06::HvacCooltVlvSts_UB,0,-1,1); break;
     Default :
        resultValue = -1;
  }
  
}

on sysvar_update sysvar::CEM::Backbone::Signals::Control::UB::HvacEvaprTSpFrnt_UB_Control
{
  long resultValue;
  
  // --- FR ---
  setBusContext(getBusNameContext(gFR1BusName));
  switch(@this)
  {
     Case(this::SignalUBOFF) :
        resultValue = DisturbUB(Backbone::CEM::CEMBackBoneSignalIpdu06::HvacEvaprTSpFrnt_UB,0,-1,0); break;
     Case(this::SignalUBHandled) :
        resultValue = DisturbUB(Backbone::CEM::CEMBackBoneSignalIpdu06::HvacEvaprTSpFrnt_UB,0,0,0); break;
     Case(this::SignalUBON) :
        resultValue = DisturbUB(Backbone::CEM::CEMBackBoneSignalIpdu06::HvacEvaprTSpFrnt_UB,0,-1,1); break;
     Default :
        resultValue = -1;
  }
  
}

on sysvar_update sysvar::CEM::Backbone::Signals::Control::UB::HvacHeatrPwrCns_UB_Control
{
  long resultValue;
  
  // --- FR ---
  setBusContext(getBusNameContext(gFR1BusName));
  switch(@this)
  {
     Case(this::SignalUBOFF) :
        resultValue = DisturbUB(Backbone::CEM::CEMBackBoneSignalIpdu06::HvacHeatrPwrCns_UB,0,-1,0); break;
     Case(this::SignalUBHandled) :
        resultValue = DisturbUB(Backbone::CEM::CEMBackBoneSignalIpdu06::HvacHeatrPwrCns_UB,0,0,0); break;
     Case(this::SignalUBON) :
        resultValue = DisturbUB(Backbone::CEM::CEMBackBoneSignalIpdu06::HvacHeatrPwrCns_UB,0,-1,1); break;
     Default :
        resultValue = -1;
  }
  
}

on sysvar_update sysvar::CEM::Backbone::Signals::Control::UB::HvHeatgPwrCns_UB_Control
{
  long resultValue;
  
  // --- FR ---
  setBusContext(getBusNameContext(gFR1BusName));
  switch(@this)
  {
     Case(this::SignalUBOFF) :
        resultValue = DisturbUB(Backbone::CEM::CEMBackBoneSignalIpdu06::HvHeatgPwrCns_UB,0,-1,0); break;
     Case(this::SignalUBHandled) :
        resultValue = DisturbUB(Backbone::CEM::CEMBackBoneSignalIpdu06::HvHeatgPwrCns_UB,0,0,0); break;
     Case(this::SignalUBON) :
        resultValue = DisturbUB(Backbone::CEM::CEMBackBoneSignalIpdu06::HvHeatgPwrCns_UB,0,-1,1); break;
     Default :
        resultValue = -1;
  }
  
}

on sysvar_update sysvar::CEM::Backbone::Signals::Control::UB::HzrdLiWarnCrashEve_UB_Control
{
  long resultValue;
  
  // --- FR ---
  setBusContext(getBusNameContext(gFR1BusName));
  switch(@this)
  {
     Case(this::SignalUBOFF) :
        resultValue = DisturbUB(Backbone::CEM::CEMBackBoneSignalIpdu06::HzrdLiWarnCrashEve_UB,0,-1,0); break;
     Case(this::SignalUBHandled) :
        resultValue = DisturbUB(Backbone::CEM::CEMBackBoneSignalIpdu06::HzrdLiWarnCrashEve_UB,0,0,0); break;
     Case(this::SignalUBON) :
        resultValue = DisturbUB(Backbone::CEM::CEMBackBoneSignalIpdu06::HzrdLiWarnCrashEve_UB,0,-1,1); break;
     Default :
        resultValue = -1;
  }
  
}

on sysvar_update sysvar::CEM::Backbone::Signals::Control::UB::ImobMgrWarnIndcn_UB_Control
{
  long resultValue;
  
  // --- FR ---
  setBusContext(getBusNameContext(gFR1BusName));
  switch(@this)
  {
     Case(this::SignalUBOFF) :
        resultValue = DisturbUB(Backbone::CEM::CEMBackBoneSignalIpdu06::ImobMgrWarnIndcn_UB,0,-1,0); break;
     Case(this::SignalUBHandled) :
        resultValue = DisturbUB(Backbone::CEM::CEMBackBoneSignalIpdu06::ImobMgrWarnIndcn_UB,0,0,0); break;
     Case(this::SignalUBON) :
        resultValue = DisturbUB(Backbone::CEM::CEMBackBoneSignalIpdu06::ImobMgrWarnIndcn_UB,0,-1,1); break;
     Default :
        resultValue = -1;
  }
  
}

on sysvar_update sysvar::CEM::Backbone::Signals::Control::UB::IncSpdIdleElecReq_UB_Control
{
  long resultValue;
  
  // --- FR ---
  setBusContext(getBusNameContext(gFR1BusName));
  switch(@this)
  {
     Case(this::SignalUBOFF) :
        resultValue = DisturbUB(Backbone::CEM::CEMBackBoneSignalIpdu06::IncSpdIdleElecReq_UB,0,-1,0); break;
     Case(this::SignalUBHandled) :
        resultValue = DisturbUB(Backbone::CEM::CEMBackBoneSignalIpdu06::IncSpdIdleElecReq_UB,0,0,0); break;
     Case(this::SignalUBON) :
        resultValue = DisturbUB(Backbone::CEM::CEMBackBoneSignalIpdu06::IncSpdIdleElecReq_UB,0,-1,1); break;
     Default :
        resultValue = -1;
  }
  
}

on sysvar_update sysvar::CEM::Backbone::Signals::Control::UB::KeyNotPrsntMsgToDrvr_UB_Control
{
  long resultValue;
  
  // --- FR ---
  setBusContext(getBusNameContext(gFR1BusName));
  switch(@this)
  {
     Case(this::SignalUBOFF) :
        resultValue = DisturbUB(Backbone::CEM::CEMBackBoneSignalIpdu06::KeyNotPrsntMsgToDrvr_UB,0,-1,0); break;
     Case(this::SignalUBHandled) :
        resultValue = DisturbUB(Backbone::CEM::CEMBackBoneSignalIpdu06::KeyNotPrsntMsgToDrvr_UB,0,0,0); break;
     Case(this::SignalUBON) :
        resultValue = DisturbUB(Backbone::CEM::CEMBackBoneSignalIpdu06::KeyNotPrsntMsgToDrvr_UB,0,-1,1); break;
     Default :
        resultValue = -1;
  }
  
}

on sysvar_update sysvar::CEM::Backbone::Signals::Control::UB::ReAxleWarn_UB_Control
{
  long resultValue;
  
  // --- FR ---
  setBusContext(getBusNameContext(gFR1BusName));
  switch(@this)
  {
     Case(this::SignalUBOFF) :
        resultValue = DisturbUB(Backbone::CEM::CEMBackBoneSignalIpdu06::ReAxleWarn_UB,0,-1,0); break;
     Case(this::SignalUBHandled) :
        resultValue = DisturbUB(Backbone::CEM::CEMBackBoneSignalIpdu06::ReAxleWarn_UB,0,0,0); break;
     Case(this::SignalUBON) :
        resultValue = DisturbUB(Backbone::CEM::CEMBackBoneSignalIpdu06::ReAxleWarn_UB,0,-1,1); break;
     Default :
        resultValue = -1;
  }
  
}

on sysvar_update sysvar::CEM::Backbone::Signals::Control::UB::RoofAndLiCtrl_UB_Control
{
  long resultValue;
  
  // --- FR ---
  setBusContext(getBusNameContext(gFR1BusName));
  switch(@this)
  {
     Case(this::SignalUBOFF) :
        resultValue = DisturbUB(Backbone::CEM::CEMBackBoneSignalIpdu06::RoofAndLiCtrl_UB,0,-1,0); break;
     Case(this::SignalUBHandled) :
        resultValue = DisturbUB(Backbone::CEM::CEMBackBoneSignalIpdu06::RoofAndLiCtrl_UB,0,0,0); break;
     Case(this::SignalUBON) :
        resultValue = DisturbUB(Backbone::CEM::CEMBackBoneSignalIpdu06::RoofAndLiCtrl_UB,0,-1,1); break;
     Default :
        resultValue = -1;
  }
  
}

on sysvar_update sysvar::CEM::Backbone::Signals::Control::UB::SpprtBattChrgnReq_UB_Control
{
  long resultValue;
  
  // --- FR ---
  setBusContext(getBusNameContext(gFR1BusName));
  switch(@this)
  {
     Case(this::SignalUBOFF) :
        resultValue = DisturbUB(Backbone::CEM::CEMBackBoneSignalIpdu06::SpprtBattChrgnReq_UB,0,-1,0); break;
     Case(this::SignalUBHandled) :
        resultValue = DisturbUB(Backbone::CEM::CEMBackBoneSignalIpdu06::SpprtBattChrgnReq_UB,0,0,0); break;
     Case(this::SignalUBON) :
        resultValue = DisturbUB(Backbone::CEM::CEMBackBoneSignalIpdu06::SpprtBattChrgnReq_UB,0,-1,1); break;
     Default :
        resultValue = -1;
  }
  
}

on sysvar_update sysvar::CEM::Backbone::Signals::Control::UB::SysFltWarn_UB_Control
{
  long resultValue;
  
  // --- FR ---
  setBusContext(getBusNameContext(gFR1BusName));
  switch(@this)
  {
     Case(this::SignalUBOFF) :
        resultValue = DisturbUB(Backbone::CEM::CEMBackBoneSignalIpdu06::SysFltWarn_UB,0,-1,0); break;
     Case(this::SignalUBHandled) :
        resultValue = DisturbUB(Backbone::CEM::CEMBackBoneSignalIpdu06::SysFltWarn_UB,0,0,0); break;
     Case(this::SignalUBON) :
        resultValue = DisturbUB(Backbone::CEM::CEMBackBoneSignalIpdu06::SysFltWarn_UB,0,-1,1); break;
     Default :
        resultValue = -1;
  }
  
}

on sysvar_update sysvar::CEM::Backbone::Signals::Control::UB::TirePCalSts_UB_Control
{
  long resultValue;
  
  // --- FR ---
  setBusContext(getBusNameContext(gFR1BusName));
  switch(@this)
  {
     Case(this::SignalUBOFF) :
        resultValue = DisturbUB(Backbone::CEM::CEMBackBoneSignalIpdu06::TirePCalSts_UB,0,-1,0); break;
     Case(this::SignalUBHandled) :
        resultValue = DisturbUB(Backbone::CEM::CEMBackBoneSignalIpdu06::TirePCalSts_UB,0,0,0); break;
     Case(this::SignalUBON) :
        resultValue = DisturbUB(Backbone::CEM::CEMBackBoneSignalIpdu06::TirePCalSts_UB,0,-1,1); break;
     Default :
        resultValue = -1;
  }
  
}

on sysvar_update sysvar::CEM::Backbone::Signals::Control::UB::VehActvMsgToDrvr_UB_Control
{
  long resultValue;
  
  // --- FR ---
  setBusContext(getBusNameContext(gFR1BusName));
  switch(@this)
  {
     Case(this::SignalUBOFF) :
        resultValue = DisturbUB(Backbone::CEM::CEMBackBoneSignalIpdu06::VehActvMsgToDrvr_UB,0,-1,0); break;
     Case(this::SignalUBHandled) :
        resultValue = DisturbUB(Backbone::CEM::CEMBackBoneSignalIpdu06::VehActvMsgToDrvr_UB,0,0,0); break;
     Case(this::SignalUBON) :
        resultValue = DisturbUB(Backbone::CEM::CEMBackBoneSignalIpdu06::VehActvMsgToDrvr_UB,0,-1,1); break;
     Default :
        resultValue = -1;
  }
  
}

on sysvar_update sysvar::CEM::Backbone::Signals::Control::UB::WinPosnStsRePass_UB_Control
{
  long resultValue;
  
  // --- FR ---
  setBusContext(getBusNameContext(gFR1BusName));
  switch(@this)
  {
     Case(this::SignalUBOFF) :
        resultValue = DisturbUB(Backbone::CEM::CEMBackBoneSignalIpdu06::WinPosnStsRePass_UB,0,-1,0); break;
     Case(this::SignalUBHandled) :
        resultValue = DisturbUB(Backbone::CEM::CEMBackBoneSignalIpdu06::WinPosnStsRePass_UB,0,0,0); break;
     Case(this::SignalUBON) :
        resultValue = DisturbUB(Backbone::CEM::CEMBackBoneSignalIpdu06::WinPosnStsRePass_UB,0,-1,1); break;
     Default :
        resultValue = -1;
  }
  
}

on sysvar_update sysvar::CEM::Backbone::Signals::Control::UB::SeatBackUnlckdThrd_UB_Control
{
  long resultValue;
  
  // --- FR ---
  setBusContext(getBusNameContext(gFR1BusName));
  switch(@this)
  {
     Case(this::SignalUBOFF) :
        resultValue = DisturbUB(Backbone::CEM::CEMBackBoneSignalIpdu07::SeatBackUnlckdThrd_UB,0,-1,0); break;
     Case(this::SignalUBHandled) :
        resultValue = DisturbUB(Backbone::CEM::CEMBackBoneSignalIpdu07::SeatBackUnlckdThrd_UB,0,0,0); break;
     Case(this::SignalUBON) :
        resultValue = DisturbUB(Backbone::CEM::CEMBackBoneSignalIpdu07::SeatBackUnlckdThrd_UB,0,-1,1); break;
     Default :
        resultValue = -1;
  }
  
}

on sysvar_update sysvar::CEM::Backbone::Signals::Control::UB::SeatBlkdThrd_UB_Control
{
  long resultValue;
  
  // --- FR ---
  setBusContext(getBusNameContext(gFR1BusName));
  switch(@this)
  {
     Case(this::SignalUBOFF) :
        resultValue = DisturbUB(Backbone::CEM::CEMBackBoneSignalIpdu07::SeatBlkdThrd_UB,0,-1,0); break;
     Case(this::SignalUBHandled) :
        resultValue = DisturbUB(Backbone::CEM::CEMBackBoneSignalIpdu07::SeatBlkdThrd_UB,0,0,0); break;
     Case(this::SignalUBON) :
        resultValue = DisturbUB(Backbone::CEM::CEMBackBoneSignalIpdu07::SeatBlkdThrd_UB,0,-1,1); break;
     Default :
        resultValue = -1;
  }
  
}

on sysvar_update sysvar::CEM::Backbone::Signals::Control::UB::VehBattUGroup_UB_Control
{
  long resultValue;
  
  // --- FR ---
  setBusContext(getBusNameContext(gFR1BusName));
  switch(@this)
  {
     Case(this::SignalUBOFF) :
        resultValue = DisturbUB(Backbone::CEM::CEMBackBoneSignalIpdu07::VehBattUGroup_UB,0,-1,0); break;
     Case(this::SignalUBHandled) :
        resultValue = DisturbUB(Backbone::CEM::CEMBackBoneSignalIpdu07::VehBattUGroup_UB,0,0,0); break;
     Case(this::SignalUBON) :
        resultValue = DisturbUB(Backbone::CEM::CEMBackBoneSignalIpdu07::VehBattUGroup_UB,0,-1,1); break;
     Default :
        resultValue = -1;
  }
  
}

on sysvar_update sysvar::CEM::Backbone::Signals::Control::UB::Vin_UB_Control
{
  long resultValue;
  
  // --- FR ---
  setBusContext(getBusNameContext(gFR1BusName));
  switch(@this)
  {
     Case(this::SignalUBOFF) :
        resultValue = DisturbUB(Backbone::CEM::CEMBackBoneSignalIpdu07::Vin_UB,0,-1,0); break;
     Case(this::SignalUBHandled) :
        resultValue = DisturbUB(Backbone::CEM::CEMBackBoneSignalIpdu07::Vin_UB,0,0,0); break;
     Case(this::SignalUBON) :
        resultValue = DisturbUB(Backbone::CEM::CEMBackBoneSignalIpdu07::Vin_UB,0,-1,1); break;
     Default :
        resultValue = -1;
  }
  
}

on sysvar_update sysvar::CEM::Backbone::Signals::Control::UB::WindDewTUppr_UB_Control
{
  long resultValue;
  
  // --- FR ---
  setBusContext(getBusNameContext(gFR1BusName));
  switch(@this)
  {
     Case(this::SignalUBOFF) :
        resultValue = DisturbUB(Backbone::CEM::CEMBackBoneSignalIpdu07::WindDewTUppr_UB,0,-1,0); break;
     Case(this::SignalUBHandled) :
        resultValue = DisturbUB(Backbone::CEM::CEMBackBoneSignalIpdu07::WindDewTUppr_UB,0,0,0); break;
     Case(this::SignalUBON) :
        resultValue = DisturbUB(Backbone::CEM::CEMBackBoneSignalIpdu07::WindDewTUppr_UB,0,-1,1); break;
     Default :
        resultValue = -1;
  }
  
}

on sysvar_update sysvar::CEM::Backbone::Signals::Control::UB::WindTGroup_UB_Control
{
  long resultValue;
  
  // --- FR ---
  setBusContext(getBusNameContext(gFR1BusName));
  switch(@this)
  {
     Case(this::SignalUBOFF) :
        resultValue = DisturbUB(Backbone::CEM::CEMBackBoneSignalIpdu07::WindTGroup_UB,0,-1,0); break;
     Case(this::SignalUBHandled) :
        resultValue = DisturbUB(Backbone::CEM::CEMBackBoneSignalIpdu07::WindTGroup_UB,0,0,0); break;
     Case(this::SignalUBON) :
        resultValue = DisturbUB(Backbone::CEM::CEMBackBoneSignalIpdu07::WindTGroup_UB,0,-1,1); break;
     Default :
        resultValue = -1;
  }
  
}

on sysvar_update sysvar::CEM::Backbone::Signals::Control::UB::BattChgInhbReq1WdReq_UB_Control
{
  long resultValue;
  
  // --- FR ---
  setBusContext(getBusNameContext(gFR1BusName));
  switch(@this)
  {
     Case(this::SignalUBOFF) :
        resultValue = DisturbUB(Backbone::CEM::CEMBackBoneSignalIpdu07::BattChgInhbReq1WdReq_UB,0,-1,0); break;
     Case(this::SignalUBHandled) :
        resultValue = DisturbUB(Backbone::CEM::CEMBackBoneSignalIpdu07::BattChgInhbReq1WdReq_UB,0,0,0); break;
     Case(this::SignalUBON) :
        resultValue = DisturbUB(Backbone::CEM::CEMBackBoneSignalIpdu07::BattChgInhbReq1WdReq_UB,0,-1,1); break;
     Default :
        resultValue = -1;
  }
  
}

on sysvar_update sysvar::CEM::Backbone::Signals::Control::UB::ClimaSts_UB_Control
{
  long resultValue;
  
  // --- FR ---
  setBusContext(getBusNameContext(gFR1BusName));
  switch(@this)
  {
     Case(this::SignalUBOFF) :
        resultValue = DisturbUB(Backbone::CEM::CEMBackBoneSignalIpdu07::ClimaSts_UB,0,-1,0); break;
     Case(this::SignalUBHandled) :
        resultValue = DisturbUB(Backbone::CEM::CEMBackBoneSignalIpdu07::ClimaSts_UB,0,0,0); break;
     Case(this::SignalUBON) :
        resultValue = DisturbUB(Backbone::CEM::CEMBackBoneSignalIpdu07::ClimaSts_UB,0,-1,1); break;
     Default :
        resultValue = -1;
  }
  
}

on sysvar_update sysvar::CEM::Backbone::Signals::Control::UB::ClimaTmrSts_UB_Control
{
  long resultValue;
  
  // --- FR ---
  setBusContext(getBusNameContext(gFR1BusName));
  switch(@this)
  {
     Case(this::SignalUBOFF) :
        resultValue = DisturbUB(Backbone::CEM::CEMBackBoneSignalIpdu07::ClimaTmrSts_UB,0,-1,0); break;
     Case(this::SignalUBHandled) :
        resultValue = DisturbUB(Backbone::CEM::CEMBackBoneSignalIpdu07::ClimaTmrSts_UB,0,0,0); break;
     Case(this::SignalUBON) :
        resultValue = DisturbUB(Backbone::CEM::CEMBackBoneSignalIpdu07::ClimaTmrSts_UB,0,-1,1); break;
     Default :
        resultValue = -1;
  }
  
}

on sysvar_update sysvar::CEM::Backbone::Signals::Control::UB::CoolgStsForDisp_UB_Control
{
  long resultValue;
  
  // --- FR ---
  setBusContext(getBusNameContext(gFR1BusName));
  switch(@this)
  {
     Case(this::SignalUBOFF) :
        resultValue = DisturbUB(Backbone::CEM::CEMBackBoneSignalIpdu07::CoolgStsForDisp_UB,0,-1,0); break;
     Case(this::SignalUBHandled) :
        resultValue = DisturbUB(Backbone::CEM::CEMBackBoneSignalIpdu07::CoolgStsForDisp_UB,0,0,0); break;
     Case(this::SignalUBON) :
        resultValue = DisturbUB(Backbone::CEM::CEMBackBoneSignalIpdu07::CoolgStsForDisp_UB,0,-1,1); break;
     Default :
        resultValue = -1;
  }
  
}

on sysvar_update sysvar::CEM::Backbone::Signals::Control::UB::CooltFlowFromWtrPmpAux_UB_Control
{
  long resultValue;
  
  // --- FR ---
  setBusContext(getBusNameContext(gFR1BusName));
  switch(@this)
  {
     Case(this::SignalUBOFF) :
        resultValue = DisturbUB(Backbone::CEM::CEMBackBoneSignalIpdu07::CooltFlowFromWtrPmpAux_UB,0,-1,0); break;
     Case(this::SignalUBHandled) :
        resultValue = DisturbUB(Backbone::CEM::CEMBackBoneSignalIpdu07::CooltFlowFromWtrPmpAux_UB,0,0,0); break;
     Case(this::SignalUBON) :
        resultValue = DisturbUB(Backbone::CEM::CEMBackBoneSignalIpdu07::CooltFlowFromWtrPmpAux_UB,0,-1,1); break;
     Default :
        resultValue = -1;
  }
  
}

on sysvar_update sysvar::CEM::Backbone::Signals::Control::UB::CustClimaOvrdNotifForHmiCpt_UB_Control
{
  long resultValue;
  
  // --- FR ---
  setBusContext(getBusNameContext(gFR1BusName));
  switch(@this)
  {
     Case(this::SignalUBOFF) :
        resultValue = DisturbUB(Backbone::CEM::CEMBackBoneSignalIpdu07::CustClimaOvrdNotifForHmiCpt_UB,0,-1,0); break;
     Case(this::SignalUBHandled) :
        resultValue = DisturbUB(Backbone::CEM::CEMBackBoneSignalIpdu07::CustClimaOvrdNotifForHmiCpt_UB,0,0,0); break;
     Case(this::SignalUBON) :
        resultValue = DisturbUB(Backbone::CEM::CEMBackBoneSignalIpdu07::CustClimaOvrdNotifForHmiCpt_UB,0,-1,1); break;
     Default :
        resultValue = -1;
  }
  
}

on sysvar_update sysvar::CEM::Backbone::Signals::Control::UB::DrvrMassgRunng_UB_Control
{
  long resultValue;
  
  // --- FR ---
  setBusContext(getBusNameContext(gFR1BusName));
  switch(@this)
  {
     Case(this::SignalUBOFF) :
        resultValue = DisturbUB(Backbone::CEM::CEMBackBoneSignalIpdu07::DrvrMassgRunng_UB,0,-1,0); break;
     Case(this::SignalUBHandled) :
        resultValue = DisturbUB(Backbone::CEM::CEMBackBoneSignalIpdu07::DrvrMassgRunng_UB,0,0,0); break;
     Case(this::SignalUBON) :
        resultValue = DisturbUB(Backbone::CEM::CEMBackBoneSignalIpdu07::DrvrMassgRunng_UB,0,-1,1); break;
     Default :
        resultValue = -1;
  }
  
}

on sysvar_update sysvar::CEM::Backbone::Signals::Control::UB::DrvrSeatActvSpplFct_UB_Control
{
  long resultValue;
  
  // --- FR ---
  setBusContext(getBusNameContext(gFR1BusName));
  switch(@this)
  {
     Case(this::SignalUBOFF) :
        resultValue = DisturbUB(Backbone::CEM::CEMBackBoneSignalIpdu07::DrvrSeatActvSpplFct_UB,0,-1,0); break;
     Case(this::SignalUBHandled) :
        resultValue = DisturbUB(Backbone::CEM::CEMBackBoneSignalIpdu07::DrvrSeatActvSpplFct_UB,0,0,0); break;
     Case(this::SignalUBON) :
        resultValue = DisturbUB(Backbone::CEM::CEMBackBoneSignalIpdu07::DrvrSeatActvSpplFct_UB,0,-1,1); break;
     Default :
        resultValue = -1;
  }
  
}

on sysvar_update sysvar::CEM::Backbone::Signals::Control::UB::EngPwrAllwdDeltaWdCmd_UB_Control
{
  long resultValue;
  
  // --- FR ---
  setBusContext(getBusNameContext(gFR1BusName));
  switch(@this)
  {
     Case(this::SignalUBOFF) :
        resultValue = DisturbUB(Backbone::CEM::CEMBackBoneSignalIpdu07::EngPwrAllwdDeltaWdCmd_UB,0,-1,0); break;
     Case(this::SignalUBHandled) :
        resultValue = DisturbUB(Backbone::CEM::CEMBackBoneSignalIpdu07::EngPwrAllwdDeltaWdCmd_UB,0,0,0); break;
     Case(this::SignalUBON) :
        resultValue = DisturbUB(Backbone::CEM::CEMBackBoneSignalIpdu07::EngPwrAllwdDeltaWdCmd_UB,0,-1,1); break;
     Default :
        resultValue = -1;
  }
  
}

on sysvar_update sysvar::CEM::Backbone::Signals::Control::UB::EvaprVlvReSts_UB_Control
{
  long resultValue;
  
  // --- FR ---
  setBusContext(getBusNameContext(gFR1BusName));
  switch(@this)
  {
     Case(this::SignalUBOFF) :
        resultValue = DisturbUB(Backbone::CEM::CEMBackBoneSignalIpdu07::EvaprVlvReSts_UB,0,-1,0); break;
     Case(this::SignalUBHandled) :
        resultValue = DisturbUB(Backbone::CEM::CEMBackBoneSignalIpdu07::EvaprVlvReSts_UB,0,0,0); break;
     Case(this::SignalUBON) :
        resultValue = DisturbUB(Backbone::CEM::CEMBackBoneSignalIpdu07::EvaprVlvReSts_UB,0,-1,1); break;
     Default :
        resultValue = -1;
  }
  
}

on sysvar_update sysvar::CEM::Backbone::Signals::Control::UB::FltOfPuddleLiDrvr_UB_Control
{
  long resultValue;
  
  // --- FR ---
  setBusContext(getBusNameContext(gFR1BusName));
  switch(@this)
  {
     Case(this::SignalUBOFF) :
        resultValue = DisturbUB(Backbone::CEM::CEMBackBoneSignalIpdu07::FltOfPuddleLiDrvr_UB,0,-1,0); break;
     Case(this::SignalUBHandled) :
        resultValue = DisturbUB(Backbone::CEM::CEMBackBoneSignalIpdu07::FltOfPuddleLiDrvr_UB,0,0,0); break;
     Case(this::SignalUBON) :
        resultValue = DisturbUB(Backbone::CEM::CEMBackBoneSignalIpdu07::FltOfPuddleLiDrvr_UB,0,-1,1); break;
     Default :
        resultValue = -1;
  }
  
}

on sysvar_update sysvar::CEM::Backbone::Signals::Control::UB::FltOfPuddleLiPass_UB_Control
{
  long resultValue;
  
  // --- FR ---
  setBusContext(getBusNameContext(gFR1BusName));
  switch(@this)
  {
     Case(this::SignalUBOFF) :
        resultValue = DisturbUB(Backbone::CEM::CEMBackBoneSignalIpdu07::FltOfPuddleLiPass_UB,0,-1,0); break;
     Case(this::SignalUBHandled) :
        resultValue = DisturbUB(Backbone::CEM::CEMBackBoneSignalIpdu07::FltOfPuddleLiPass_UB,0,0,0); break;
     Case(this::SignalUBON) :
        resultValue = DisturbUB(Backbone::CEM::CEMBackBoneSignalIpdu07::FltOfPuddleLiPass_UB,0,-1,1); break;
     Default :
        resultValue = -1;
  }
  
}

on sysvar_update sysvar::CEM::Backbone::Signals::Control::UB::FuHeatrActv_UB_Control
{
  long resultValue;
  
  // --- FR ---
  setBusContext(getBusNameContext(gFR1BusName));
  switch(@this)
  {
     Case(this::SignalUBOFF) :
        resultValue = DisturbUB(Backbone::CEM::CEMBackBoneSignalIpdu07::FuHeatrActv_UB,0,-1,0); break;
     Case(this::SignalUBHandled) :
        resultValue = DisturbUB(Backbone::CEM::CEMBackBoneSignalIpdu07::FuHeatrActv_UB,0,0,0); break;
     Case(this::SignalUBON) :
        resultValue = DisturbUB(Backbone::CEM::CEMBackBoneSignalIpdu07::FuHeatrActv_UB,0,-1,1); break;
     Default :
        resultValue = -1;
  }
  
}

on sysvar_update sysvar::CEM::Backbone::Signals::Control::UB::FuHeatrFuCnsDurgCyc1_UB_Control
{
  long resultValue;
  
  // --- FR ---
  setBusContext(getBusNameContext(gFR1BusName));
  switch(@this)
  {
     Case(this::SignalUBOFF) :
        resultValue = DisturbUB(Backbone::CEM::CEMBackBoneSignalIpdu07::FuHeatrFuCnsDurgCyc1_UB,0,-1,0); break;
     Case(this::SignalUBHandled) :
        resultValue = DisturbUB(Backbone::CEM::CEMBackBoneSignalIpdu07::FuHeatrFuCnsDurgCyc1_UB,0,0,0); break;
     Case(this::SignalUBON) :
        resultValue = DisturbUB(Backbone::CEM::CEMBackBoneSignalIpdu07::FuHeatrFuCnsDurgCyc1_UB,0,-1,1); break;
     Default :
        resultValue = -1;
  }
  
}

on sysvar_update sysvar::CEM::Backbone::Signals::Control::UB::FuTankPRelsForFuHeatrReq_UB_Control
{
  long resultValue;
  
  // --- FR ---
  setBusContext(getBusNameContext(gFR1BusName));
  switch(@this)
  {
     Case(this::SignalUBOFF) :
        resultValue = DisturbUB(Backbone::CEM::CEMBackBoneSignalIpdu07::FuTankPRelsForFuHeatrReq_UB,0,-1,0); break;
     Case(this::SignalUBHandled) :
        resultValue = DisturbUB(Backbone::CEM::CEMBackBoneSignalIpdu07::FuTankPRelsForFuHeatrReq_UB,0,0,0); break;
     Case(this::SignalUBON) :
        resultValue = DisturbUB(Backbone::CEM::CEMBackBoneSignalIpdu07::FuTankPRelsForFuHeatrReq_UB,0,-1,1); break;
     Default :
        resultValue = -1;
  }
  
}

on sysvar_update sysvar::CEM::Backbone::Signals::Control::UB::HvacAirMFlowReEstimd_UB_Control
{
  long resultValue;
  
  // --- FR ---
  setBusContext(getBusNameContext(gFR1BusName));
  switch(@this)
  {
     Case(this::SignalUBOFF) :
        resultValue = DisturbUB(Backbone::CEM::CEMBackBoneSignalIpdu07::HvacAirMFlowReEstimd_UB,0,-1,0); break;
     Case(this::SignalUBHandled) :
        resultValue = DisturbUB(Backbone::CEM::CEMBackBoneSignalIpdu07::HvacAirMFlowReEstimd_UB,0,0,0); break;
     Case(this::SignalUBON) :
        resultValue = DisturbUB(Backbone::CEM::CEMBackBoneSignalIpdu07::HvacAirMFlowReEstimd_UB,0,-1,1); break;
     Default :
        resultValue = -1;
  }
  
}

on sysvar_update sysvar::CEM::Backbone::Signals::Control::UB::HvacCooltFlowReq_UB_Control
{
  long resultValue;
  
  // --- FR ---
  setBusContext(getBusNameContext(gFR1BusName));
  switch(@this)
  {
     Case(this::SignalUBOFF) :
        resultValue = DisturbUB(Backbone::CEM::CEMBackBoneSignalIpdu07::HvacCooltFlowReq_UB,0,-1,0); break;
     Case(this::SignalUBHandled) :
        resultValue = DisturbUB(Backbone::CEM::CEMBackBoneSignalIpdu07::HvacCooltFlowReq_UB,0,0,0); break;
     Case(this::SignalUBON) :
        resultValue = DisturbUB(Backbone::CEM::CEMBackBoneSignalIpdu07::HvacCooltFlowReq_UB,0,-1,1); break;
     Default :
        resultValue = -1;
  }
  
}

on sysvar_update sysvar::CEM::Backbone::Signals::Control::UB::HvHeatgPwrCritDes_UB_Control
{
  long resultValue;
  
  // --- FR ---
  setBusContext(getBusNameContext(gFR1BusName));
  switch(@this)
  {
     Case(this::SignalUBOFF) :
        resultValue = DisturbUB(Backbone::CEM::CEMBackBoneSignalIpdu07::HvHeatgPwrCritDes_UB,0,-1,0); break;
     Case(this::SignalUBHandled) :
        resultValue = DisturbUB(Backbone::CEM::CEMBackBoneSignalIpdu07::HvHeatgPwrCritDes_UB,0,0,0); break;
     Case(this::SignalUBON) :
        resultValue = DisturbUB(Backbone::CEM::CEMBackBoneSignalIpdu07::HvHeatgPwrCritDes_UB,0,-1,1); break;
     Default :
        resultValue = -1;
  }
  
}

on sysvar_update sysvar::CEM::Backbone::Signals::Control::UB::HvHeatgPwrNormDes_UB_Control
{
  long resultValue;
  
  // --- FR ---
  setBusContext(getBusNameContext(gFR1BusName));
  switch(@this)
  {
     Case(this::SignalUBOFF) :
        resultValue = DisturbUB(Backbone::CEM::CEMBackBoneSignalIpdu07::HvHeatgPwrNormDes_UB,0,-1,0); break;
     Case(this::SignalUBHandled) :
        resultValue = DisturbUB(Backbone::CEM::CEMBackBoneSignalIpdu07::HvHeatgPwrNormDes_UB,0,0,0); break;
     Case(this::SignalUBON) :
        resultValue = DisturbUB(Backbone::CEM::CEMBackBoneSignalIpdu07::HvHeatgPwrNormDes_UB,0,-1,1); break;
     Default :
        resultValue = -1;
  }
  
}

on sysvar_update sysvar::CEM::Backbone::Signals::Control::UB::LiDrvrFltIndcrTurn_UB_Control
{
  long resultValue;
  
  // --- FR ---
  setBusContext(getBusNameContext(gFR1BusName));
  switch(@this)
  {
     Case(this::SignalUBOFF) :
        resultValue = DisturbUB(Backbone::CEM::CEMBackBoneSignalIpdu07::LiDrvrFltIndcrTurn_UB,0,-1,0); break;
     Case(this::SignalUBHandled) :
        resultValue = DisturbUB(Backbone::CEM::CEMBackBoneSignalIpdu07::LiDrvrFltIndcrTurn_UB,0,0,0); break;
     Case(this::SignalUBON) :
        resultValue = DisturbUB(Backbone::CEM::CEMBackBoneSignalIpdu07::LiDrvrFltIndcrTurn_UB,0,-1,1); break;
     Default :
        resultValue = -1;
  }
  
}

on sysvar_update sysvar::CEM::Backbone::Signals::Control::UB::LiPassFltIndcrTurn_UB_Control
{
  long resultValue;
  
  // --- FR ---
  setBusContext(getBusNameContext(gFR1BusName));
  switch(@this)
  {
     Case(this::SignalUBOFF) :
        resultValue = DisturbUB(Backbone::CEM::CEMBackBoneSignalIpdu07::LiPassFltIndcrTurn_UB,0,-1,0); break;
     Case(this::SignalUBHandled) :
        resultValue = DisturbUB(Backbone::CEM::CEMBackBoneSignalIpdu07::LiPassFltIndcrTurn_UB,0,0,0); break;
     Case(this::SignalUBON) :
        resultValue = DisturbUB(Backbone::CEM::CEMBackBoneSignalIpdu07::LiPassFltIndcrTurn_UB,0,-1,1); break;
     Default :
        resultValue = -1;
  }
  
}

on sysvar_update sysvar::CEM::Backbone::Signals::Control::UB::MirrDwnStsAtDrvr_UB_Control
{
  long resultValue;
  
  // --- FR ---
  setBusContext(getBusNameContext(gFR1BusName));
  switch(@this)
  {
     Case(this::SignalUBOFF) :
        resultValue = DisturbUB(Backbone::CEM::CEMBackBoneSignalIpdu07::MirrDwnStsAtDrvr_UB,0,-1,0); break;
     Case(this::SignalUBHandled) :
        resultValue = DisturbUB(Backbone::CEM::CEMBackBoneSignalIpdu07::MirrDwnStsAtDrvr_UB,0,0,0); break;
     Case(this::SignalUBON) :
        resultValue = DisturbUB(Backbone::CEM::CEMBackBoneSignalIpdu07::MirrDwnStsAtDrvr_UB,0,-1,1); break;
     Default :
        resultValue = -1;
  }
  
}

on sysvar_update sysvar::CEM::Backbone::Signals::Control::UB::PassMassgRunng_UB_Control
{
  long resultValue;
  
  // --- FR ---
  setBusContext(getBusNameContext(gFR1BusName));
  switch(@this)
  {
     Case(this::SignalUBOFF) :
        resultValue = DisturbUB(Backbone::CEM::CEMBackBoneSignalIpdu07::PassMassgRunng_UB,0,-1,0); break;
     Case(this::SignalUBHandled) :
        resultValue = DisturbUB(Backbone::CEM::CEMBackBoneSignalIpdu07::PassMassgRunng_UB,0,0,0); break;
     Case(this::SignalUBON) :
        resultValue = DisturbUB(Backbone::CEM::CEMBackBoneSignalIpdu07::PassMassgRunng_UB,0,-1,1); break;
     Default :
        resultValue = -1;
  }
  
}

on sysvar_update sysvar::CEM::Backbone::Signals::Control::UB::PassSeatActvSpplFct_UB_Control
{
  long resultValue;
  
  // --- FR ---
  setBusContext(getBusNameContext(gFR1BusName));
  switch(@this)
  {
     Case(this::SignalUBOFF) :
        resultValue = DisturbUB(Backbone::CEM::CEMBackBoneSignalIpdu07::PassSeatActvSpplFct_UB,0,-1,0); break;
     Case(this::SignalUBHandled) :
        resultValue = DisturbUB(Backbone::CEM::CEMBackBoneSignalIpdu07::PassSeatActvSpplFct_UB,0,0,0); break;
     Case(this::SignalUBON) :
        resultValue = DisturbUB(Backbone::CEM::CEMBackBoneSignalIpdu07::PassSeatActvSpplFct_UB,0,-1,1); break;
     Default :
        resultValue = -1;
  }
  
}

on sysvar_update sysvar::CEM::Backbone::Signals::Control::UB::PostDrvgClimaAvl_UB_Control
{
  long resultValue;
  
  // --- FR ---
  setBusContext(getBusNameContext(gFR1BusName));
  switch(@this)
  {
     Case(this::SignalUBOFF) :
        resultValue = DisturbUB(Backbone::CEM::CEMBackBoneSignalIpdu07::PostDrvgClimaAvl_UB,0,-1,0); break;
     Case(this::SignalUBHandled) :
        resultValue = DisturbUB(Backbone::CEM::CEMBackBoneSignalIpdu07::PostDrvgClimaAvl_UB,0,0,0); break;
     Case(this::SignalUBON) :
        resultValue = DisturbUB(Backbone::CEM::CEMBackBoneSignalIpdu07::PostDrvgClimaAvl_UB,0,-1,1); break;
     Default :
        resultValue = -1;
  }
  
}

on sysvar_update sysvar::CEM::Backbone::Signals::Control::UB::PwrAvlRednWdSts_UB_Control
{
  long resultValue;
  
  // --- FR ---
  setBusContext(getBusNameContext(gFR1BusName));
  switch(@this)
  {
     Case(this::SignalUBOFF) :
        resultValue = DisturbUB(Backbone::CEM::CEMBackBoneSignalIpdu07::PwrAvlRednWdSts_UB,0,-1,0); break;
     Case(this::SignalUBHandled) :
        resultValue = DisturbUB(Backbone::CEM::CEMBackBoneSignalIpdu07::PwrAvlRednWdSts_UB,0,0,0); break;
     Case(this::SignalUBON) :
        resultValue = DisturbUB(Backbone::CEM::CEMBackBoneSignalIpdu07::PwrAvlRednWdSts_UB,0,-1,1); break;
     Default :
        resultValue = -1;
  }
  
}

on sysvar_update sysvar::CEM::Backbone::Signals::Control::UB::PwrIncGendWdReq_UB_Control
{
  long resultValue;
  
  // --- FR ---
  setBusContext(getBusNameContext(gFR1BusName));
  switch(@this)
  {
     Case(this::SignalUBOFF) :
        resultValue = DisturbUB(Backbone::CEM::CEMBackBoneSignalIpdu07::PwrIncGendWdReq_UB,0,-1,0); break;
     Case(this::SignalUBHandled) :
        resultValue = DisturbUB(Backbone::CEM::CEMBackBoneSignalIpdu07::PwrIncGendWdReq_UB,0,0,0); break;
     Case(this::SignalUBON) :
        resultValue = DisturbUB(Backbone::CEM::CEMBackBoneSignalIpdu07::PwrIncGendWdReq_UB,0,-1,1); break;
     Default :
        resultValue = -1;
  }
  
}

on sysvar_update sysvar::CEM::Backbone::Signals::Control::UB::RoadAsscSts_UB_Control
{
  long resultValue;
  
  // --- FR ---
  setBusContext(getBusNameContext(gFR1BusName));
  switch(@this)
  {
     Case(this::SignalUBOFF) :
        resultValue = DisturbUB(Backbone::CEM::CEMBackBoneSignalIpdu07::RoadAsscSts_UB,0,-1,0); break;
     Case(this::SignalUBHandled) :
        resultValue = DisturbUB(Backbone::CEM::CEMBackBoneSignalIpdu07::RoadAsscSts_UB,0,0,0); break;
     Case(this::SignalUBON) :
        resultValue = DisturbUB(Backbone::CEM::CEMBackBoneSignalIpdu07::RoadAsscSts_UB,0,-1,1); break;
     Default :
        resultValue = -1;
  }
  
}

on sysvar_update sysvar::CEM::Backbone::Signals::Control::UB::SteerWhlLvrSts_UB_Control
{
  long resultValue;
  
  // --- FR ---
  setBusContext(getBusNameContext(gFR1BusName));
  switch(@this)
  {
     Case(this::SignalUBOFF) :
        resultValue = DisturbUB(Backbone::CEM::CEMBackBoneSignalIpdu07::SteerWhlLvrSts_UB,0,-1,0); break;
     Case(this::SignalUBHandled) :
        resultValue = DisturbUB(Backbone::CEM::CEMBackBoneSignalIpdu07::SteerWhlLvrSts_UB,0,0,0); break;
     Case(this::SignalUBON) :
        resultValue = DisturbUB(Backbone::CEM::CEMBackBoneSignalIpdu07::SteerWhlLvrSts_UB,0,-1,1); break;
     Default :
        resultValue = -1;
  }
  
}

on sysvar_update sysvar::CEM::Backbone::Signals::Control::UB::TankFlapReqFromSwtIntrFild_UB_Control
{
  long resultValue;
  
  // --- FR ---
  setBusContext(getBusNameContext(gFR1BusName));
  switch(@this)
  {
     Case(this::SignalUBOFF) :
        resultValue = DisturbUB(Backbone::CEM::CEMBackBoneSignalIpdu07::TankFlapReqFromSwtIntrFild_UB,0,-1,0); break;
     Case(this::SignalUBHandled) :
        resultValue = DisturbUB(Backbone::CEM::CEMBackBoneSignalIpdu07::TankFlapReqFromSwtIntrFild_UB,0,0,0); break;
     Case(this::SignalUBON) :
        resultValue = DisturbUB(Backbone::CEM::CEMBackBoneSignalIpdu07::TankFlapReqFromSwtIntrFild_UB,0,-1,1); break;
     Default :
        resultValue = -1;
  }
  
}

on sysvar_update sysvar::CEM::Backbone::Signals::Control::UB::TelmSts_UB_Control
{
  long resultValue;
  
  // --- FR ---
  setBusContext(getBusNameContext(gFR1BusName));
  switch(@this)
  {
     Case(this::SignalUBOFF) :
        resultValue = DisturbUB(Backbone::CEM::CEMBackBoneSignalIpdu07::TelmSts_UB,0,-1,0); break;
     Case(this::SignalUBHandled) :
        resultValue = DisturbUB(Backbone::CEM::CEMBackBoneSignalIpdu07::TelmSts_UB,0,0,0); break;
     Case(this::SignalUBON) :
        resultValue = DisturbUB(Backbone::CEM::CEMBackBoneSignalIpdu07::TelmSts_UB,0,-1,1); break;
     Default :
        resultValue = -1;
  }
  
}

on sysvar_update sysvar::CEM::Backbone::SignalGroups::Control::E2E::ULoWarnChks_Control
{
  int controlValue;
  long resultValue;
  
  // --- FR ---
  controlValue = (int) @this;
  setBusContext(getBusNameContext(gFR1BusName));
  switch(controlValue)
  {
     Case(this::ChksHandled) :
        resultValue = EnableCRC("ULoWarn", 1); break;
     Case(this::ChksManual) :
        resultValue = EnableCRC("ULoWarn", 0); break;
     Default :
        resultValue = -1;
  }
  
}

on sysvar_update sysvar::CEM::Backbone::SignalGroups::Control::E2E::ULoWarnCntr_Control
{
  int controlValue;
  long resultValue;
  
  // --- FR ---
  controlValue = (int) @this;
  setBusContext(getBusNameContext(gFR1BusName));
  switch(controlValue)
  {
     Case(this::CntrHandled) :
        resultValue = EnableCounter ("ULoWarn", 1); break;
     Case(this::CntrManual) :
        resultValue = EnableCounter ("ULoWarn", 0); break;
     Default :
        resultValue = -1;
  }
  
}

on sysvar_update sysvar::CEM::Backbone::Signals::Control::UB::AlrmSts1_UB_Control
{
  long resultValue;
  
  // --- FR ---
  setBusContext(getBusNameContext(gFR1BusName));
  switch(@this)
  {
     Case(this::SignalUBOFF) :
        resultValue = DisturbUB(Backbone::CEM::CEMBackBoneSignalIpdu11::AlrmSts1_UB,0,-1,0); break;
     Case(this::SignalUBHandled) :
        resultValue = DisturbUB(Backbone::CEM::CEMBackBoneSignalIpdu11::AlrmSts1_UB,0,0,0); break;
     Case(this::SignalUBON) :
        resultValue = DisturbUB(Backbone::CEM::CEMBackBoneSignalIpdu11::AlrmSts1_UB,0,-1,1); break;
     Default :
        resultValue = -1;
  }
  
}

on sysvar_update sysvar::CEM::Backbone::Signals::Control::UB::AmbTRaw_UB_Control
{
  long resultValue;
  
  // --- FR ---
  setBusContext(getBusNameContext(gFR1BusName));
  switch(@this)
  {
     Case(this::SignalUBOFF) :
        resultValue = DisturbUB(Backbone::CEM::CEMBackBoneSignalIpdu11::AmbTRaw_UB,0,-1,0); break;
     Case(this::SignalUBHandled) :
        resultValue = DisturbUB(Backbone::CEM::CEMBackBoneSignalIpdu11::AmbTRaw_UB,0,0,0); break;
     Case(this::SignalUBON) :
        resultValue = DisturbUB(Backbone::CEM::CEMBackBoneSignalIpdu11::AmbTRaw_UB,0,-1,1); break;
     Default :
        resultValue = -1;
  }
  
}

on sysvar_update sysvar::CEM::Backbone::Signals::Control::UB::CmptmtAirTEstimdExtd_UB_Control
{
  long resultValue;
  
  // --- FR ---
  setBusContext(getBusNameContext(gFR1BusName));
  switch(@this)
  {
     Case(this::SignalUBOFF) :
        resultValue = DisturbUB(Backbone::CEM::CEMBackBoneSignalIpdu11::CmptmtAirTEstimdExtd_UB,0,-1,0); break;
     Case(this::SignalUBHandled) :
        resultValue = DisturbUB(Backbone::CEM::CEMBackBoneSignalIpdu11::CmptmtAirTEstimdExtd_UB,0,0,0); break;
     Case(this::SignalUBON) :
        resultValue = DisturbUB(Backbone::CEM::CEMBackBoneSignalIpdu11::CmptmtAirTEstimdExtd_UB,0,-1,1); break;
     Default :
        resultValue = -1;
  }
  
}

on sysvar_update sysvar::CEM::Backbone::Signals::Control::UB::FuSnsrActvSide_UB_Control
{
  long resultValue;
  
  // --- FR ---
  setBusContext(getBusNameContext(gFR1BusName));
  switch(@this)
  {
     Case(this::SignalUBOFF) :
        resultValue = DisturbUB(Backbone::CEM::CEMBackBoneSignalIpdu11::FuSnsrActvSide_UB,0,-1,0); break;
     Case(this::SignalUBHandled) :
        resultValue = DisturbUB(Backbone::CEM::CEMBackBoneSignalIpdu11::FuSnsrActvSide_UB,0,0,0); break;
     Case(this::SignalUBON) :
        resultValue = DisturbUB(Backbone::CEM::CEMBackBoneSignalIpdu11::FuSnsrActvSide_UB,0,-1,1); break;
     Default :
        resultValue = -1;
  }
  
}

on sysvar_update sysvar::CEM::Backbone::Signals::Control::UB::FuSnsrPasSide_UB_Control
{
  long resultValue;
  
  // --- FR ---
  setBusContext(getBusNameContext(gFR1BusName));
  switch(@this)
  {
     Case(this::SignalUBOFF) :
        resultValue = DisturbUB(Backbone::CEM::CEMBackBoneSignalIpdu11::FuSnsrPasSide_UB,0,-1,0); break;
     Case(this::SignalUBHandled) :
        resultValue = DisturbUB(Backbone::CEM::CEMBackBoneSignalIpdu11::FuSnsrPasSide_UB,0,0,0); break;
     Case(this::SignalUBON) :
        resultValue = DisturbUB(Backbone::CEM::CEMBackBoneSignalIpdu11::FuSnsrPasSide_UB,0,-1,1); break;
     Default :
        resultValue = -1;
  }
  
}

on sysvar_update sysvar::CEM::Backbone::Signals::Control::UB::ULoWarn_UB_Control
{
  long resultValue;
  
  // --- FR ---
  setBusContext(getBusNameContext(gFR1BusName));
  switch(@this)
  {
     Case(this::SignalUBOFF) :
        resultValue = DisturbUB(Backbone::CEM::CEMBackBoneSignalIpdu11::ULoWarn_UB,0,-1,0); break;
     Case(this::SignalUBHandled) :
        resultValue = DisturbUB(Backbone::CEM::CEMBackBoneSignalIpdu11::ULoWarn_UB,0,0,0); break;
     Case(this::SignalUBON) :
        resultValue = DisturbUB(Backbone::CEM::CEMBackBoneSignalIpdu11::ULoWarn_UB,0,-1,1); break;
     Default :
        resultValue = -1;
  }
  
}

on sysvar_update sysvar::CEM::Backbone::Signals::Control::UB::BattPrimAgeSts_UB_Control
{
  long resultValue;
  
  // --- FR ---
  setBusContext(getBusNameContext(gFR1BusName));
  switch(@this)
  {
     Case(this::SignalUBOFF) :
        resultValue = DisturbUB(Backbone::CEM::CEMBackBoneSignalIpdu11::BattPrimAgeSts_UB,0,-1,0); break;
     Case(this::SignalUBHandled) :
        resultValue = DisturbUB(Backbone::CEM::CEMBackBoneSignalIpdu11::BattPrimAgeSts_UB,0,0,0); break;
     Case(this::SignalUBON) :
        resultValue = DisturbUB(Backbone::CEM::CEMBackBoneSignalIpdu11::BattPrimAgeSts_UB,0,-1,1); break;
     Default :
        resultValue = -1;
  }
  
}

on sysvar_update sysvar::CEM::Backbone::Signals::Control::UB::ChdWinProtnStsAtDrvrRe_UB_Control
{
  long resultValue;
  
  // --- FR ---
  setBusContext(getBusNameContext(gFR1BusName));
  switch(@this)
  {
     Case(this::SignalUBOFF) :
        resultValue = DisturbUB(Backbone::CEM::CEMBackBoneSignalIpdu11::ChdWinProtnStsAtDrvrRe_UB,0,-1,0); break;
     Case(this::SignalUBHandled) :
        resultValue = DisturbUB(Backbone::CEM::CEMBackBoneSignalIpdu11::ChdWinProtnStsAtDrvrRe_UB,0,0,0); break;
     Case(this::SignalUBON) :
        resultValue = DisturbUB(Backbone::CEM::CEMBackBoneSignalIpdu11::ChdWinProtnStsAtDrvrRe_UB,0,-1,1); break;
     Default :
        resultValue = -1;
  }
  
}

on sysvar_update sysvar::CEM::Backbone::Signals::Control::UB::ChdWinProtnStsAtPassRe_UB_Control
{
  long resultValue;
  
  // --- FR ---
  setBusContext(getBusNameContext(gFR1BusName));
  switch(@this)
  {
     Case(this::SignalUBOFF) :
        resultValue = DisturbUB(Backbone::CEM::CEMBackBoneSignalIpdu11::ChdWinProtnStsAtPassRe_UB,0,-1,0); break;
     Case(this::SignalUBHandled) :
        resultValue = DisturbUB(Backbone::CEM::CEMBackBoneSignalIpdu11::ChdWinProtnStsAtPassRe_UB,0,0,0); break;
     Case(this::SignalUBON) :
        resultValue = DisturbUB(Backbone::CEM::CEMBackBoneSignalIpdu11::ChdWinProtnStsAtPassRe_UB,0,-1,1); break;
     Default :
        resultValue = -1;
  }
  
}

on sysvar_update sysvar::CEM::Backbone::Signals::Control::UB::ClngActv_UB_Control
{
  long resultValue;
  
  // --- FR ---
  setBusContext(getBusNameContext(gFR1BusName));
  switch(@this)
  {
     Case(this::SignalUBOFF) :
        resultValue = DisturbUB(Backbone::CEM::CEMBackBoneSignalIpdu11::ClngActv_UB,0,-1,0); break;
     Case(this::SignalUBHandled) :
        resultValue = DisturbUB(Backbone::CEM::CEMBackBoneSignalIpdu11::ClngActv_UB,0,0,0); break;
     Case(this::SignalUBON) :
        resultValue = DisturbUB(Backbone::CEM::CEMBackBoneSignalIpdu11::ClngActv_UB,0,-1,1); break;
     Default :
        resultValue = -1;
  }
  
}

on sysvar_update sysvar::CEM::Backbone::Signals::Control::UB::DiagcCouplReqd1_UB_Control
{
  long resultValue;
  
  // --- FR ---
  setBusContext(getBusNameContext(gFR1BusName));
  switch(@this)
  {
     Case(this::SignalUBOFF) :
        resultValue = DisturbUB(Backbone::CEM::CEMBackBoneSignalIpdu11::DiagcCouplReqd1_UB,0,-1,0); break;
     Case(this::SignalUBHandled) :
        resultValue = DisturbUB(Backbone::CEM::CEMBackBoneSignalIpdu11::DiagcCouplReqd1_UB,0,0,0); break;
     Case(this::SignalUBON) :
        resultValue = DisturbUB(Backbone::CEM::CEMBackBoneSignalIpdu11::DiagcCouplReqd1_UB,0,-1,1); break;
     Default :
        resultValue = -1;
  }
  
}

on sysvar_update sysvar::CEM::Backbone::Signals::Control::UB::DoorDrvrLockReSts_UB_Control
{
  long resultValue;
  
  // --- FR ---
  setBusContext(getBusNameContext(gFR1BusName));
  switch(@this)
  {
     Case(this::SignalUBOFF) :
        resultValue = DisturbUB(Backbone::CEM::CEMBackBoneSignalIpdu11::DoorDrvrLockReSts_UB,0,-1,0); break;
     Case(this::SignalUBHandled) :
        resultValue = DisturbUB(Backbone::CEM::CEMBackBoneSignalIpdu11::DoorDrvrLockReSts_UB,0,0,0); break;
     Case(this::SignalUBON) :
        resultValue = DisturbUB(Backbone::CEM::CEMBackBoneSignalIpdu11::DoorDrvrLockReSts_UB,0,-1,1); break;
     Default :
        resultValue = -1;
  }
  
}

on sysvar_update sysvar::CEM::Backbone::Signals::Control::UB::DoorDrvrLockSts_UB_Control
{
  long resultValue;
  
  // --- FR ---
  setBusContext(getBusNameContext(gFR1BusName));
  switch(@this)
  {
     Case(this::SignalUBOFF) :
        resultValue = DisturbUB(Backbone::CEM::CEMBackBoneSignalIpdu11::DoorDrvrLockSts_UB,0,-1,0); break;
     Case(this::SignalUBHandled) :
        resultValue = DisturbUB(Backbone::CEM::CEMBackBoneSignalIpdu11::DoorDrvrLockSts_UB,0,0,0); break;
     Case(this::SignalUBON) :
        resultValue = DisturbUB(Backbone::CEM::CEMBackBoneSignalIpdu11::DoorDrvrLockSts_UB,0,-1,1); break;
     Default :
        resultValue = -1;
  }
  
}

on sysvar_update sysvar::CEM::Backbone::Signals::Control::UB::DoorPassLockReSts_UB_Control
{
  long resultValue;
  
  // --- FR ---
  setBusContext(getBusNameContext(gFR1BusName));
  switch(@this)
  {
     Case(this::SignalUBOFF) :
        resultValue = DisturbUB(Backbone::CEM::CEMBackBoneSignalIpdu11::DoorPassLockReSts_UB,0,-1,0); break;
     Case(this::SignalUBHandled) :
        resultValue = DisturbUB(Backbone::CEM::CEMBackBoneSignalIpdu11::DoorPassLockReSts_UB,0,0,0); break;
     Case(this::SignalUBON) :
        resultValue = DisturbUB(Backbone::CEM::CEMBackBoneSignalIpdu11::DoorPassLockReSts_UB,0,-1,1); break;
     Default :
        resultValue = -1;
  }
  
}

on sysvar_update sysvar::CEM::Backbone::Signals::Control::UB::DoorPassLockSts_UB_Control
{
  long resultValue;
  
  // --- FR ---
  setBusContext(getBusNameContext(gFR1BusName));
  switch(@this)
  {
     Case(this::SignalUBOFF) :
        resultValue = DisturbUB(Backbone::CEM::CEMBackBoneSignalIpdu11::DoorPassLockSts_UB,0,-1,0); break;
     Case(this::SignalUBHandled) :
        resultValue = DisturbUB(Backbone::CEM::CEMBackBoneSignalIpdu11::DoorPassLockSts_UB,0,0,0); break;
     Case(this::SignalUBON) :
        resultValue = DisturbUB(Backbone::CEM::CEMBackBoneSignalIpdu11::DoorPassLockSts_UB,0,-1,1); break;
     Default :
        resultValue = -1;
  }
  
}

on sysvar_update sysvar::CEM::Backbone::Signals::Control::UB::DstTrvldFromBodyBkp_UB_Control
{
  long resultValue;
  
  // --- FR ---
  setBusContext(getBusNameContext(gFR1BusName));
  switch(@this)
  {
     Case(this::SignalUBOFF) :
        resultValue = DisturbUB(Backbone::CEM::CEMBackBoneSignalIpdu11::DstTrvldFromBodyBkp_UB,0,-1,0); break;
     Case(this::SignalUBHandled) :
        resultValue = DisturbUB(Backbone::CEM::CEMBackBoneSignalIpdu11::DstTrvldFromBodyBkp_UB,0,0,0); break;
     Case(this::SignalUBON) :
        resultValue = DisturbUB(Backbone::CEM::CEMBackBoneSignalIpdu11::DstTrvldFromBodyBkp_UB,0,-1,1); break;
     Default :
        resultValue = -1;
  }
  
}

on sysvar_update sysvar::CEM::Backbone::Signals::Control::UB::EngHeatgReq_UB_Control
{
  long resultValue;
  
  // --- FR ---
  setBusContext(getBusNameContext(gFR1BusName));
  switch(@this)
  {
     Case(this::SignalUBOFF) :
        resultValue = DisturbUB(Backbone::CEM::CEMBackBoneSignalIpdu11::EngHeatgReq_UB,0,-1,0); break;
     Case(this::SignalUBHandled) :
        resultValue = DisturbUB(Backbone::CEM::CEMBackBoneSignalIpdu11::EngHeatgReq_UB,0,0,0); break;
     Case(this::SignalUBON) :
        resultValue = DisturbUB(Backbone::CEM::CEMBackBoneSignalIpdu11::EngHeatgReq_UB,0,-1,1); break;
     Default :
        resultValue = -1;
  }
  
}

on sysvar_update sysvar::CEM::Backbone::Signals::Control::UB::FltOfBeamLoLe_UB_Control
{
  long resultValue;
  
  // --- FR ---
  setBusContext(getBusNameContext(gFR1BusName));
  switch(@this)
  {
     Case(this::SignalUBOFF) :
        resultValue = DisturbUB(Backbone::CEM::CEMBackBoneSignalIpdu11::FltOfBeamLoLe_UB,0,-1,0); break;
     Case(this::SignalUBHandled) :
        resultValue = DisturbUB(Backbone::CEM::CEMBackBoneSignalIpdu11::FltOfBeamLoLe_UB,0,0,0); break;
     Case(this::SignalUBON) :
        resultValue = DisturbUB(Backbone::CEM::CEMBackBoneSignalIpdu11::FltOfBeamLoLe_UB,0,-1,1); break;
     Default :
        resultValue = -1;
  }
  
}

on sysvar_update sysvar::CEM::Backbone::Signals::Control::UB::FltOfBeamLoRi_UB_Control
{
  long resultValue;
  
  // --- FR ---
  setBusContext(getBusNameContext(gFR1BusName));
  switch(@this)
  {
     Case(this::SignalUBOFF) :
        resultValue = DisturbUB(Backbone::CEM::CEMBackBoneSignalIpdu11::FltOfBeamLoRi_UB,0,-1,0); break;
     Case(this::SignalUBHandled) :
        resultValue = DisturbUB(Backbone::CEM::CEMBackBoneSignalIpdu11::FltOfBeamLoRi_UB,0,0,0); break;
     Case(this::SignalUBON) :
        resultValue = DisturbUB(Backbone::CEM::CEMBackBoneSignalIpdu11::FltOfBeamLoRi_UB,0,-1,1); break;
     Default :
        resultValue = -1;
  }
  
}

on sysvar_update sysvar::CEM::Backbone::Signals::Control::UB::HdlampSysFailr_UB_Control
{
  long resultValue;
  
  // --- FR ---
  setBusContext(getBusNameContext(gFR1BusName));
  switch(@this)
  {
     Case(this::SignalUBOFF) :
        resultValue = DisturbUB(Backbone::CEM::CEMBackBoneSignalIpdu11::HdlampSysFailr_UB,0,-1,0); break;
     Case(this::SignalUBHandled) :
        resultValue = DisturbUB(Backbone::CEM::CEMBackBoneSignalIpdu11::HdlampSysFailr_UB,0,0,0); break;
     Case(this::SignalUBON) :
        resultValue = DisturbUB(Backbone::CEM::CEMBackBoneSignalIpdu11::HdlampSysFailr_UB,0,-1,1); break;
     Default :
        resultValue = -1;
  }
  
}

on sysvar_update sysvar::CEM::Backbone::Signals::Control::UB::HeatgForHvBattSts_UB_Control
{
  long resultValue;
  
  // --- FR ---
  setBusContext(getBusNameContext(gFR1BusName));
  switch(@this)
  {
     Case(this::SignalUBOFF) :
        resultValue = DisturbUB(Backbone::CEM::CEMBackBoneSignalIpdu11::HeatgForHvBattSts_UB,0,-1,0); break;
     Case(this::SignalUBHandled) :
        resultValue = DisturbUB(Backbone::CEM::CEMBackBoneSignalIpdu11::HeatgForHvBattSts_UB,0,0,0); break;
     Case(this::SignalUBON) :
        resultValue = DisturbUB(Backbone::CEM::CEMBackBoneSignalIpdu11::HeatgForHvBattSts_UB,0,-1,1); break;
     Default :
        resultValue = -1;
  }
  
}

on sysvar_update sysvar::CEM::Backbone::Signals::Control::UB::HvacCooltVlvReqExt_UB_Control
{
  long resultValue;
  
  // --- FR ---
  setBusContext(getBusNameContext(gFR1BusName));
  switch(@this)
  {
     Case(this::SignalUBOFF) :
        resultValue = DisturbUB(Backbone::CEM::CEMBackBoneSignalIpdu11::HvacCooltVlvReqExt_UB,0,-1,0); break;
     Case(this::SignalUBHandled) :
        resultValue = DisturbUB(Backbone::CEM::CEMBackBoneSignalIpdu11::HvacCooltVlvReqExt_UB,0,0,0); break;
     Case(this::SignalUBON) :
        resultValue = DisturbUB(Backbone::CEM::CEMBackBoneSignalIpdu11::HvacCooltVlvReqExt_UB,0,-1,1); break;
     Default :
        resultValue = -1;
  }
  
}

on sysvar_update sysvar::CEM::Backbone::Signals::Control::UB::HvacFanLvlFb_UB_Control
{
  long resultValue;
  
  // --- FR ---
  setBusContext(getBusNameContext(gFR1BusName));
  switch(@this)
  {
     Case(this::SignalUBOFF) :
        resultValue = DisturbUB(Backbone::CEM::CEMBackBoneSignalIpdu11::HvacFanLvlFb_UB,0,-1,0); break;
     Case(this::SignalUBHandled) :
        resultValue = DisturbUB(Backbone::CEM::CEMBackBoneSignalIpdu11::HvacFanLvlFb_UB,0,0,0); break;
     Case(this::SignalUBON) :
        resultValue = DisturbUB(Backbone::CEM::CEMBackBoneSignalIpdu11::HvacFanLvlFb_UB,0,-1,1); break;
     Default :
        resultValue = -1;
  }
  
}

on sysvar_update sysvar::CEM::Backbone::Signals::Control::UB::HvEgyDesForClima_UB_Control
{
  long resultValue;
  
  // --- FR ---
  setBusContext(getBusNameContext(gFR1BusName));
  switch(@this)
  {
     Case(this::SignalUBOFF) :
        resultValue = DisturbUB(Backbone::CEM::CEMBackBoneSignalIpdu11::HvEgyDesForClima_UB,0,-1,0); break;
     Case(this::SignalUBHandled) :
        resultValue = DisturbUB(Backbone::CEM::CEMBackBoneSignalIpdu11::HvEgyDesForClima_UB,0,0,0); break;
     Case(this::SignalUBON) :
        resultValue = DisturbUB(Backbone::CEM::CEMBackBoneSignalIpdu11::HvEgyDesForClima_UB,0,-1,1); break;
     Default :
        resultValue = -1;
  }
  
}

on sysvar_update sysvar::CEM::Backbone::Signals::Control::UB::ImobFailrMsgToDrvr_UB_Control
{
  long resultValue;
  
  // --- FR ---
  setBusContext(getBusNameContext(gFR1BusName));
  switch(@this)
  {
     Case(this::SignalUBOFF) :
        resultValue = DisturbUB(Backbone::CEM::CEMBackBoneSignalIpdu11::ImobFailrMsgToDrvr_UB,0,-1,0); break;
     Case(this::SignalUBHandled) :
        resultValue = DisturbUB(Backbone::CEM::CEMBackBoneSignalIpdu11::ImobFailrMsgToDrvr_UB,0,0,0); break;
     Case(this::SignalUBON) :
        resultValue = DisturbUB(Backbone::CEM::CEMBackBoneSignalIpdu11::ImobFailrMsgToDrvr_UB,0,-1,1); break;
     Default :
        resultValue = -1;
  }
  
}

on sysvar_update sysvar::CEM::Backbone::Signals::Control::UB::LvlOfClimaCmft_UB_Control
{
  long resultValue;
  
  // --- FR ---
  setBusContext(getBusNameContext(gFR1BusName));
  switch(@this)
  {
     Case(this::SignalUBOFF) :
        resultValue = DisturbUB(Backbone::CEM::CEMBackBoneSignalIpdu11::LvlOfClimaCmft_UB,0,-1,0); break;
     Case(this::SignalUBHandled) :
        resultValue = DisturbUB(Backbone::CEM::CEMBackBoneSignalIpdu11::LvlOfClimaCmft_UB,0,0,0); break;
     Case(this::SignalUBON) :
        resultValue = DisturbUB(Backbone::CEM::CEMBackBoneSignalIpdu11::LvlOfClimaCmft_UB,0,-1,1); break;
     Default :
        resultValue = -1;
  }
  
}

on sysvar_update sysvar::CEM::Backbone::Signals::Control::UB::PasAlrmSts_UB_Control
{
  long resultValue;
  
  // --- FR ---
  setBusContext(getBusNameContext(gFR1BusName));
  switch(@this)
  {
     Case(this::SignalUBOFF) :
        resultValue = DisturbUB(Backbone::CEM::CEMBackBoneSignalIpdu11::PasAlrmSts_UB,0,-1,0); break;
     Case(this::SignalUBHandled) :
        resultValue = DisturbUB(Backbone::CEM::CEMBackBoneSignalIpdu11::PasAlrmSts_UB,0,0,0); break;
     Case(this::SignalUBON) :
        resultValue = DisturbUB(Backbone::CEM::CEMBackBoneSignalIpdu11::PasAlrmSts_UB,0,-1,1); break;
     Default :
        resultValue = -1;
  }
  
}

on sysvar_update sysvar::CEM::Backbone::Signals::Control::UB::PreClngNotif_UB_Control
{
  long resultValue;
  
  // --- FR ---
  setBusContext(getBusNameContext(gFR1BusName));
  switch(@this)
  {
     Case(this::SignalUBOFF) :
        resultValue = DisturbUB(Backbone::CEM::CEMBackBoneSignalIpdu11::PreClngNotif_UB,0,-1,0); break;
     Case(this::SignalUBHandled) :
        resultValue = DisturbUB(Backbone::CEM::CEMBackBoneSignalIpdu11::PreClngNotif_UB,0,0,0); break;
     Case(this::SignalUBON) :
        resultValue = DisturbUB(Backbone::CEM::CEMBackBoneSignalIpdu11::PreClngNotif_UB,0,-1,1); break;
     Default :
        resultValue = -1;
  }
  
}

on sysvar_update sysvar::CEM::Backbone::Signals::Control::UB::PwrChrgDetdForPrkgHeatrElec_UB_Control
{
  long resultValue;
  
  // --- FR ---
  setBusContext(getBusNameContext(gFR1BusName));
  switch(@this)
  {
     Case(this::SignalUBOFF) :
        resultValue = DisturbUB(Backbone::CEM::CEMBackBoneSignalIpdu11::PwrChrgDetdForPrkgHeatrElec_UB,0,-1,0); break;
     Case(this::SignalUBHandled) :
        resultValue = DisturbUB(Backbone::CEM::CEMBackBoneSignalIpdu11::PwrChrgDetdForPrkgHeatrElec_UB,0,0,0); break;
     Case(this::SignalUBON) :
        resultValue = DisturbUB(Backbone::CEM::CEMBackBoneSignalIpdu11::PwrChrgDetdForPrkgHeatrElec_UB,0,-1,1); break;
     Default :
        resultValue = -1;
  }
  
}

on sysvar_update sysvar::CEM::Backbone::Signals::Control::UB::RcwmLiActvd_UB_Control
{
  long resultValue;
  
  // --- FR ---
  setBusContext(getBusNameContext(gFR1BusName));
  switch(@this)
  {
     Case(this::SignalUBOFF) :
        resultValue = DisturbUB(Backbone::CEM::CEMBackBoneSignalIpdu11::RcwmLiActvd_UB,0,-1,0); break;
     Case(this::SignalUBHandled) :
        resultValue = DisturbUB(Backbone::CEM::CEMBackBoneSignalIpdu11::RcwmLiActvd_UB,0,0,0); break;
     Case(this::SignalUBON) :
        resultValue = DisturbUB(Backbone::CEM::CEMBackBoneSignalIpdu11::RcwmLiActvd_UB,0,-1,1); break;
     Default :
        resultValue = -1;
  }
  
}

on sysvar_update sysvar::CEM::Backbone::Signals::Control::UB::RlyPwrDistbnCmd1WdBattSaveCmd_UB_Control
{
  long resultValue;
  
  // --- FR ---
  setBusContext(getBusNameContext(gFR1BusName));
  switch(@this)
  {
     Case(this::SignalUBOFF) :
        resultValue = DisturbUB(Backbone::CEM::CEMBackBoneSignalIpdu11::RlyPwrDistbnCmd1WdBattSaveCmd_UB,0,-1,0); break;
     Case(this::SignalUBHandled) :
        resultValue = DisturbUB(Backbone::CEM::CEMBackBoneSignalIpdu11::RlyPwrDistbnCmd1WdBattSaveCmd_UB,0,0,0); break;
     Case(this::SignalUBON) :
        resultValue = DisturbUB(Backbone::CEM::CEMBackBoneSignalIpdu11::RlyPwrDistbnCmd1WdBattSaveCmd_UB,0,-1,1); break;
     Default :
        resultValue = -1;
  }
  
}

on sysvar_update sysvar::CEM::Backbone::Signals::Control::UB::RlyPwrDistbnCmd1WdPreBattSaveCmd_UB_Control
{
  long resultValue;
  
  // --- FR ---
  setBusContext(getBusNameContext(gFR1BusName));
  switch(@this)
  {
     Case(this::SignalUBOFF) :
        resultValue = DisturbUB(Backbone::CEM::CEMBackBoneSignalIpdu11::RlyPwrDistbnCmd1WdPreBattSaveCmd_UB,0,-1,0); break;
     Case(this::SignalUBHandled) :
        resultValue = DisturbUB(Backbone::CEM::CEMBackBoneSignalIpdu11::RlyPwrDistbnCmd1WdPreBattSaveCmd_UB,0,0,0); break;
     Case(this::SignalUBON) :
        resultValue = DisturbUB(Backbone::CEM::CEMBackBoneSignalIpdu11::RlyPwrDistbnCmd1WdPreBattSaveCmd_UB,0,-1,1); break;
     Default :
        resultValue = -1;
  }
  
}

on sysvar_update sysvar::CEM::Backbone::Signals::Control::UB::SteerWhlHeatgStrtAutCdnOk_UB_Control
{
  long resultValue;
  
  // --- FR ---
  setBusContext(getBusNameContext(gFR1BusName));
  switch(@this)
  {
     Case(this::SignalUBOFF) :
        resultValue = DisturbUB(Backbone::CEM::CEMBackBoneSignalIpdu11::SteerWhlHeatgStrtAutCdnOk_UB,0,-1,0); break;
     Case(this::SignalUBHandled) :
        resultValue = DisturbUB(Backbone::CEM::CEMBackBoneSignalIpdu11::SteerWhlHeatgStrtAutCdnOk_UB,0,0,0); break;
     Case(this::SignalUBON) :
        resultValue = DisturbUB(Backbone::CEM::CEMBackBoneSignalIpdu11::SteerWhlHeatgStrtAutCdnOk_UB,0,-1,1); break;
     Default :
        resultValue = -1;
  }
  
}

on sysvar_update sysvar::CEM::Backbone::Signals::Control::UB::SysBrkLiFailr_UB_Control
{
  long resultValue;
  
  // --- FR ---
  setBusContext(getBusNameContext(gFR1BusName));
  switch(@this)
  {
     Case(this::SignalUBOFF) :
        resultValue = DisturbUB(Backbone::CEM::CEMBackBoneSignalIpdu11::SysBrkLiFailr_UB,0,-1,0); break;
     Case(this::SignalUBHandled) :
        resultValue = DisturbUB(Backbone::CEM::CEMBackBoneSignalIpdu11::SysBrkLiFailr_UB,0,0,0); break;
     Case(this::SignalUBON) :
        resultValue = DisturbUB(Backbone::CEM::CEMBackBoneSignalIpdu11::SysBrkLiFailr_UB,0,-1,1); break;
     Default :
        resultValue = -1;
  }
  
}

on sysvar_update sysvar::CEM::Backbone::Signals::Control::UB::SysDirIndcnFailr_UB_Control
{
  long resultValue;
  
  // --- FR ---
  setBusContext(getBusNameContext(gFR1BusName));
  switch(@this)
  {
     Case(this::SignalUBOFF) :
        resultValue = DisturbUB(Backbone::CEM::CEMBackBoneSignalIpdu11::SysDirIndcnFailr_UB,0,-1,0); break;
     Case(this::SignalUBHandled) :
        resultValue = DisturbUB(Backbone::CEM::CEMBackBoneSignalIpdu11::SysDirIndcnFailr_UB,0,0,0); break;
     Case(this::SignalUBON) :
        resultValue = DisturbUB(Backbone::CEM::CEMBackBoneSignalIpdu11::SysDirIndcnFailr_UB,0,-1,1); break;
     Default :
        resultValue = -1;
  }
  
}

on sysvar_update sysvar::CEM::Backbone::Signals::Control::UB::WinPosnStsDrv_UB_Control
{
  long resultValue;
  
  // --- FR ---
  setBusContext(getBusNameContext(gFR1BusName));
  switch(@this)
  {
     Case(this::SignalUBOFF) :
        resultValue = DisturbUB(Backbone::CEM::CEMBackBoneSignalIpdu11::WinPosnStsDrv_UB,0,-1,0); break;
     Case(this::SignalUBHandled) :
        resultValue = DisturbUB(Backbone::CEM::CEMBackBoneSignalIpdu11::WinPosnStsDrv_UB,0,0,0); break;
     Case(this::SignalUBON) :
        resultValue = DisturbUB(Backbone::CEM::CEMBackBoneSignalIpdu11::WinPosnStsDrv_UB,0,-1,1); break;
     Default :
        resultValue = -1;
  }
  
}

on sysvar_update sysvar::CEM::Backbone::Signals::Control::UB::WinPosnStsPass_UB_Control
{
  long resultValue;
  
  // --- FR ---
  setBusContext(getBusNameContext(gFR1BusName));
  switch(@this)
  {
     Case(this::SignalUBOFF) :
        resultValue = DisturbUB(Backbone::CEM::CEMBackBoneSignalIpdu11::WinPosnStsPass_UB,0,-1,0); break;
     Case(this::SignalUBHandled) :
        resultValue = DisturbUB(Backbone::CEM::CEMBackBoneSignalIpdu11::WinPosnStsPass_UB,0,0,0); break;
     Case(this::SignalUBON) :
        resultValue = DisturbUB(Backbone::CEM::CEMBackBoneSignalIpdu11::WinPosnStsPass_UB,0,-1,1); break;
     Default :
        resultValue = -1;
  }
  
}

on sysvar_update sysvar::CEM::Backbone::Signals::Control::UB::WiprInPosnForSrv_UB_Control
{
  long resultValue;
  
  // --- FR ---
  setBusContext(getBusNameContext(gFR1BusName));
  switch(@this)
  {
     Case(this::SignalUBOFF) :
        resultValue = DisturbUB(Backbone::CEM::CEMBackBoneSignalIpdu11::WiprInPosnForSrv_UB,0,-1,0); break;
     Case(this::SignalUBHandled) :
        resultValue = DisturbUB(Backbone::CEM::CEMBackBoneSignalIpdu11::WiprInPosnForSrv_UB,0,0,0); break;
     Case(this::SignalUBON) :
        resultValue = DisturbUB(Backbone::CEM::CEMBackBoneSignalIpdu11::WiprInPosnForSrv_UB,0,-1,1); break;
     Default :
        resultValue = -1;
  }
  
}

on sysvar_update sysvar::CEM::Backbone::Signals::Control::UB::WiprSysFailrDetdSafe_UB_Control
{
  long resultValue;
  
  // --- FR ---
  setBusContext(getBusNameContext(gFR1BusName));
  switch(@this)
  {
     Case(this::SignalUBOFF) :
        resultValue = DisturbUB(Backbone::CEM::CEMBackBoneSignalIpdu11::WiprSysFailrDetdSafe_UB,0,-1,0); break;
     Case(this::SignalUBHandled) :
        resultValue = DisturbUB(Backbone::CEM::CEMBackBoneSignalIpdu11::WiprSysFailrDetdSafe_UB,0,0,0); break;
     Case(this::SignalUBON) :
        resultValue = DisturbUB(Backbone::CEM::CEMBackBoneSignalIpdu11::WiprSysFailrDetdSafe_UB,0,-1,1); break;
     Default :
        resultValue = -1;
  }
  
}

on sysvar_update sysvar::CEM::Backbone::Signals::Control::UB::WshrFldSts_UB_Control
{
  long resultValue;
  
  // --- FR ---
  setBusContext(getBusNameContext(gFR1BusName));
  switch(@this)
  {
     Case(this::SignalUBOFF) :
        resultValue = DisturbUB(Backbone::CEM::CEMBackBoneSignalIpdu11::WshrFldSts_UB,0,-1,0); break;
     Case(this::SignalUBHandled) :
        resultValue = DisturbUB(Backbone::CEM::CEMBackBoneSignalIpdu11::WshrFldSts_UB,0,0,0); break;
     Case(this::SignalUBON) :
        resultValue = DisturbUB(Backbone::CEM::CEMBackBoneSignalIpdu11::WshrFldSts_UB,0,-1,1); break;
     Default :
        resultValue = -1;
  }
  
}

on sysvar_update sysvar::CEM::Backbone::Signals::Control::UB::HMIDefrstSts_UB_Control
{
  long resultValue;
  
  // --- FR ---
  setBusContext(getBusNameContext(gFR1BusName));
  switch(@this)
  {
     Case(this::SignalUBOFF) :
        resultValue = DisturbUB(Backbone::CEM::CEMBackBoneSignalIpdu13::HMIDefrstSts_UB,0,-1,0); break;
     Case(this::SignalUBHandled) :
        resultValue = DisturbUB(Backbone::CEM::CEMBackBoneSignalIpdu13::HMIDefrstSts_UB,0,0,0); break;
     Case(this::SignalUBON) :
        resultValue = DisturbUB(Backbone::CEM::CEMBackBoneSignalIpdu13::HMIDefrstSts_UB,0,-1,1); break;
     Default :
        resultValue = -1;
  }
  
}

on sysvar_update sysvar::CEM::Backbone::Signals::Control::UB::RemStrtMsgToDrvr_UB_Control
{
  long resultValue;
  
  // --- FR ---
  setBusContext(getBusNameContext(gFR1BusName));
  switch(@this)
  {
     Case(this::SignalUBOFF) :
        resultValue = DisturbUB(Backbone::CEM::CEMBackBoneSignalIpdu13::RemStrtMsgToDrvr_UB,0,-1,0); break;
     Case(this::SignalUBHandled) :
        resultValue = DisturbUB(Backbone::CEM::CEMBackBoneSignalIpdu13::RemStrtMsgToDrvr_UB,0,0,0); break;
     Case(this::SignalUBON) :
        resultValue = DisturbUB(Backbone::CEM::CEMBackBoneSignalIpdu13::RemStrtMsgToDrvr_UB,0,-1,1); break;
     Default :
        resultValue = -1;
  }
  
}

on sysvar_update sysvar::CEM::Backbone::Signals::Control::UB::UkwnCptReqToInfoMgr_UB_Control
{
  long resultValue;
  
  // --- FR ---
  setBusContext(getBusNameContext(gFR1BusName));
  switch(@this)
  {
     Case(this::SignalUBOFF) :
        resultValue = DisturbUB(Backbone::CEM::CEMBackBoneSignalIpdu13::UkwnCptReqToInfoMgr_UB,0,-1,0); break;
     Case(this::SignalUBHandled) :
        resultValue = DisturbUB(Backbone::CEM::CEMBackBoneSignalIpdu13::UkwnCptReqToInfoMgr_UB,0,0,0); break;
     Case(this::SignalUBON) :
        resultValue = DisturbUB(Backbone::CEM::CEMBackBoneSignalIpdu13::UkwnCptReqToInfoMgr_UB,0,-1,1); break;
     Default :
        resultValue = -1;
  }
  
}

on sysvar_update sysvar::CEM::Backbone::Signals::Control::UB::UkwnCptReqToSoundMgr_UB_Control
{
  long resultValue;
  
  // --- FR ---
  setBusContext(getBusNameContext(gFR1BusName));
  switch(@this)
  {
     Case(this::SignalUBOFF) :
        resultValue = DisturbUB(Backbone::CEM::CEMBackBoneSignalIpdu13::UkwnCptReqToSoundMgr_UB,0,-1,0); break;
     Case(this::SignalUBHandled) :
        resultValue = DisturbUB(Backbone::CEM::CEMBackBoneSignalIpdu13::UkwnCptReqToSoundMgr_UB,0,0,0); break;
     Case(this::SignalUBON) :
        resultValue = DisturbUB(Backbone::CEM::CEMBackBoneSignalIpdu13::UkwnCptReqToSoundMgr_UB,0,-1,1); break;
     Default :
        resultValue = -1;
  }
  
}

on sysvar_update sysvar::CEM::Backbone::Signals::Control::UB::ActvnOfBeamHi_UB_Control
{
  long resultValue;
  
  // --- FR ---
  setBusContext(getBusNameContext(gFR1BusName));
  switch(@this)
  {
     Case(this::SignalUBOFF) :
        resultValue = DisturbUB(Backbone::CEM::CEMBackBoneSignalIpdu13::ActvnOfBeamHi_UB,0,-1,0); break;
     Case(this::SignalUBHandled) :
        resultValue = DisturbUB(Backbone::CEM::CEMBackBoneSignalIpdu13::ActvnOfBeamHi_UB,0,0,0); break;
     Case(this::SignalUBON) :
        resultValue = DisturbUB(Backbone::CEM::CEMBackBoneSignalIpdu13::ActvnOfBeamHi_UB,0,-1,1); break;
     Default :
        resultValue = -1;
  }
  
}

on sysvar_update sysvar::CEM::Backbone::Signals::Control::UB::ActvOfHorn_UB_Control
{
  long resultValue;
  
  // --- FR ---
  setBusContext(getBusNameContext(gFR1BusName));
  switch(@this)
  {
     Case(this::SignalUBOFF) :
        resultValue = DisturbUB(Backbone::CEM::CEMBackBoneSignalIpdu13::ActvOfHorn_UB,0,-1,0); break;
     Case(this::SignalUBHandled) :
        resultValue = DisturbUB(Backbone::CEM::CEMBackBoneSignalIpdu13::ActvOfHorn_UB,0,0,0); break;
     Case(this::SignalUBON) :
        resultValue = DisturbUB(Backbone::CEM::CEMBackBoneSignalIpdu13::ActvOfHorn_UB,0,-1,1); break;
     Default :
        resultValue = -1;
  }
  
}

on sysvar_update sysvar::CEM::Backbone::Signals::Control::UB::AhbcBeamFmtLe_UB_Control
{
  long resultValue;
  
  // --- FR ---
  setBusContext(getBusNameContext(gFR1BusName));
  switch(@this)
  {
     Case(this::SignalUBOFF) :
        resultValue = DisturbUB(Backbone::CEM::CEMBackBoneSignalIpdu13::AhbcBeamFmtLe_UB,0,-1,0); break;
     Case(this::SignalUBHandled) :
        resultValue = DisturbUB(Backbone::CEM::CEMBackBoneSignalIpdu13::AhbcBeamFmtLe_UB,0,0,0); break;
     Case(this::SignalUBON) :
        resultValue = DisturbUB(Backbone::CEM::CEMBackBoneSignalIpdu13::AhbcBeamFmtLe_UB,0,-1,1); break;
     Default :
        resultValue = -1;
  }
  
}

on sysvar_update sysvar::CEM::Backbone::Signals::Control::UB::AhbcBeamFmtRi_UB_Control
{
  long resultValue;
  
  // --- FR ---
  setBusContext(getBusNameContext(gFR1BusName));
  switch(@this)
  {
     Case(this::SignalUBOFF) :
        resultValue = DisturbUB(Backbone::CEM::CEMBackBoneSignalIpdu13::AhbcBeamFmtRi_UB,0,-1,0); break;
     Case(this::SignalUBHandled) :
        resultValue = DisturbUB(Backbone::CEM::CEMBackBoneSignalIpdu13::AhbcBeamFmtRi_UB,0,0,0); break;
     Case(this::SignalUBON) :
        resultValue = DisturbUB(Backbone::CEM::CEMBackBoneSignalIpdu13::AhbcBeamFmtRi_UB,0,-1,1); break;
     Default :
        resultValue = -1;
  }
  
}

on sysvar_update sysvar::CEM::Backbone::Signals::Control::UB::BattLoStsFild_UB_Control
{
  long resultValue;
  
  // --- FR ---
  setBusContext(getBusNameContext(gFR1BusName));
  switch(@this)
  {
     Case(this::SignalUBOFF) :
        resultValue = DisturbUB(Backbone::CEM::CEMBackBoneSignalIpdu13::BattLoStsFild_UB,0,-1,0); break;
     Case(this::SignalUBHandled) :
        resultValue = DisturbUB(Backbone::CEM::CEMBackBoneSignalIpdu13::BattLoStsFild_UB,0,0,0); break;
     Case(this::SignalUBON) :
        resultValue = DisturbUB(Backbone::CEM::CEMBackBoneSignalIpdu13::BattLoStsFild_UB,0,-1,1); break;
     Default :
        resultValue = -1;
  }
  
}

on sysvar_update sysvar::CEM::Backbone::Signals::Control::UB::CarModCrashSaved_UB_Control
{
  long resultValue;
  
  // --- FR ---
  setBusContext(getBusNameContext(gFR1BusName));
  switch(@this)
  {
     Case(this::SignalUBOFF) :
        resultValue = DisturbUB(Backbone::CEM::CEMBackBoneSignalIpdu13::CarModCrashSaved_UB,0,-1,0); break;
     Case(this::SignalUBHandled) :
        resultValue = DisturbUB(Backbone::CEM::CEMBackBoneSignalIpdu13::CarModCrashSaved_UB,0,0,0); break;
     Case(this::SignalUBON) :
        resultValue = DisturbUB(Backbone::CEM::CEMBackBoneSignalIpdu13::CarModCrashSaved_UB,0,-1,1); break;
     Default :
        resultValue = -1;
  }
  
}

on sysvar_update sysvar::CEM::Backbone::Signals::Control::UB::CarModDispdWdDispd_UB_Control
{
  long resultValue;
  
  // --- FR ---
  setBusContext(getBusNameContext(gFR1BusName));
  switch(@this)
  {
     Case(this::SignalUBOFF) :
        resultValue = DisturbUB(Backbone::CEM::CEMBackBoneSignalIpdu13::CarModDispdWdDispd_UB,0,-1,0); break;
     Case(this::SignalUBHandled) :
        resultValue = DisturbUB(Backbone::CEM::CEMBackBoneSignalIpdu13::CarModDispdWdDispd_UB,0,0,0); break;
     Case(this::SignalUBON) :
        resultValue = DisturbUB(Backbone::CEM::CEMBackBoneSignalIpdu13::CarModDispdWdDispd_UB,0,-1,1); break;
     Default :
        resultValue = -1;
  }
  
}

on sysvar_update sysvar::CEM::Backbone::Signals::Control::UB::CarModDynoReq_UB_Control
{
  long resultValue;
  
  // --- FR ---
  setBusContext(getBusNameContext(gFR1BusName));
  switch(@this)
  {
     Case(this::SignalUBOFF) :
        resultValue = DisturbUB(Backbone::CEM::CEMBackBoneSignalIpdu13::CarModDynoReq_UB,0,-1,0); break;
     Case(this::SignalUBHandled) :
        resultValue = DisturbUB(Backbone::CEM::CEMBackBoneSignalIpdu13::CarModDynoReq_UB,0,0,0); break;
     Case(this::SignalUBON) :
        resultValue = DisturbUB(Backbone::CEM::CEMBackBoneSignalIpdu13::CarModDynoReq_UB,0,-1,1); break;
     Default :
        resultValue = -1;
  }
  
}

on sysvar_update sysvar::CEM::Backbone::Signals::Control::UB::ChrgFuseSts_UB_Control
{
  long resultValue;
  
  // --- FR ---
  setBusContext(getBusNameContext(gFR1BusName));
  switch(@this)
  {
     Case(this::SignalUBOFF) :
        resultValue = DisturbUB(Backbone::CEM::CEMBackBoneSignalIpdu13::ChrgFuseSts_UB,0,-1,0); break;
     Case(this::SignalUBHandled) :
        resultValue = DisturbUB(Backbone::CEM::CEMBackBoneSignalIpdu13::ChrgFuseSts_UB,0,0,0); break;
     Case(this::SignalUBON) :
        resultValue = DisturbUB(Backbone::CEM::CEMBackBoneSignalIpdu13::ChrgFuseSts_UB,0,-1,1); break;
     Default :
        resultValue = -1;
  }
  
}

on sysvar_update sysvar::CEM::Backbone::Signals::Control::UB::EgyLvlElecDrvInfo_UB_Control
{
  long resultValue;
  
  // --- FR ---
  setBusContext(getBusNameContext(gFR1BusName));
  switch(@this)
  {
     Case(this::SignalUBOFF) :
        resultValue = DisturbUB(Backbone::CEM::CEMBackBoneSignalIpdu13::EgyLvlElecDrvInfo_UB,0,-1,0); break;
     Case(this::SignalUBHandled) :
        resultValue = DisturbUB(Backbone::CEM::CEMBackBoneSignalIpdu13::EgyLvlElecDrvInfo_UB,0,0,0); break;
     Case(this::SignalUBON) :
        resultValue = DisturbUB(Backbone::CEM::CEMBackBoneSignalIpdu13::EgyLvlElecDrvInfo_UB,0,-1,1); break;
     Default :
        resultValue = -1;
  }
  
}

on sysvar_update sysvar::CEM::Backbone::Signals::Control::UB::ErsStrtApplSts_UB_Control
{
  long resultValue;
  
  // --- FR ---
  setBusContext(getBusNameContext(gFR1BusName));
  switch(@this)
  {
     Case(this::SignalUBOFF) :
        resultValue = DisturbUB(Backbone::CEM::CEMBackBoneSignalIpdu13::ErsStrtApplSts_UB,0,-1,0); break;
     Case(this::SignalUBHandled) :
        resultValue = DisturbUB(Backbone::CEM::CEMBackBoneSignalIpdu13::ErsStrtApplSts_UB,0,0,0); break;
     Case(this::SignalUBON) :
        resultValue = DisturbUB(Backbone::CEM::CEMBackBoneSignalIpdu13::ErsStrtApplSts_UB,0,-1,1); break;
     Default :
        resultValue = -1;
  }
  
}

on sysvar_update sysvar::CEM::Backbone::Signals::Control::UB::FltFogLiRe_UB_Control
{
  long resultValue;
  
  // --- FR ---
  setBusContext(getBusNameContext(gFR1BusName));
  switch(@this)
  {
     Case(this::SignalUBOFF) :
        resultValue = DisturbUB(Backbone::CEM::CEMBackBoneSignalIpdu13::FltFogLiRe_UB,0,-1,0); break;
     Case(this::SignalUBHandled) :
        resultValue = DisturbUB(Backbone::CEM::CEMBackBoneSignalIpdu13::FltFogLiRe_UB,0,0,0); break;
     Case(this::SignalUBON) :
        resultValue = DisturbUB(Backbone::CEM::CEMBackBoneSignalIpdu13::FltFogLiRe_UB,0,-1,1); break;
     Default :
        resultValue = -1;
  }
  
}

on sysvar_update sysvar::CEM::Backbone::Signals::Control::UB::FltIndcrTurnLeFrnt_UB_Control
{
  long resultValue;
  
  // --- FR ---
  setBusContext(getBusNameContext(gFR1BusName));
  switch(@this)
  {
     Case(this::SignalUBOFF) :
        resultValue = DisturbUB(Backbone::CEM::CEMBackBoneSignalIpdu13::FltIndcrTurnLeFrnt_UB,0,-1,0); break;
     Case(this::SignalUBHandled) :
        resultValue = DisturbUB(Backbone::CEM::CEMBackBoneSignalIpdu13::FltIndcrTurnLeFrnt_UB,0,0,0); break;
     Case(this::SignalUBON) :
        resultValue = DisturbUB(Backbone::CEM::CEMBackBoneSignalIpdu13::FltIndcrTurnLeFrnt_UB,0,-1,1); break;
     Default :
        resultValue = -1;
  }
  
}

on sysvar_update sysvar::CEM::Backbone::Signals::Control::UB::FltIndcrTurnLeRe_UB_Control
{
  long resultValue;
  
  // --- FR ---
  setBusContext(getBusNameContext(gFR1BusName));
  switch(@this)
  {
     Case(this::SignalUBOFF) :
        resultValue = DisturbUB(Backbone::CEM::CEMBackBoneSignalIpdu13::FltIndcrTurnLeRe_UB,0,-1,0); break;
     Case(this::SignalUBHandled) :
        resultValue = DisturbUB(Backbone::CEM::CEMBackBoneSignalIpdu13::FltIndcrTurnLeRe_UB,0,0,0); break;
     Case(this::SignalUBON) :
        resultValue = DisturbUB(Backbone::CEM::CEMBackBoneSignalIpdu13::FltIndcrTurnLeRe_UB,0,-1,1); break;
     Default :
        resultValue = -1;
  }
  
}

on sysvar_update sysvar::CEM::Backbone::Signals::Control::UB::FltIndcrTurnRiFrnt_UB_Control
{
  long resultValue;
  
  // --- FR ---
  setBusContext(getBusNameContext(gFR1BusName));
  switch(@this)
  {
     Case(this::SignalUBOFF) :
        resultValue = DisturbUB(Backbone::CEM::CEMBackBoneSignalIpdu13::FltIndcrTurnRiFrnt_UB,0,-1,0); break;
     Case(this::SignalUBHandled) :
        resultValue = DisturbUB(Backbone::CEM::CEMBackBoneSignalIpdu13::FltIndcrTurnRiFrnt_UB,0,0,0); break;
     Case(this::SignalUBON) :
        resultValue = DisturbUB(Backbone::CEM::CEMBackBoneSignalIpdu13::FltIndcrTurnRiFrnt_UB,0,-1,1); break;
     Default :
        resultValue = -1;
  }
  
}

on sysvar_update sysvar::CEM::Backbone::Signals::Control::UB::FltIndcrTurnRiRe_UB_Control
{
  long resultValue;
  
  // --- FR ---
  setBusContext(getBusNameContext(gFR1BusName));
  switch(@this)
  {
     Case(this::SignalUBOFF) :
        resultValue = DisturbUB(Backbone::CEM::CEMBackBoneSignalIpdu13::FltIndcrTurnRiRe_UB,0,-1,0); break;
     Case(this::SignalUBHandled) :
        resultValue = DisturbUB(Backbone::CEM::CEMBackBoneSignalIpdu13::FltIndcrTurnRiRe_UB,0,0,0); break;
     Case(this::SignalUBON) :
        resultValue = DisturbUB(Backbone::CEM::CEMBackBoneSignalIpdu13::FltIndcrTurnRiRe_UB,0,-1,1); break;
     Default :
        resultValue = -1;
  }
  
}

on sysvar_update sysvar::CEM::Backbone::Signals::Control::UB::FltLiDaytiRunngLe_UB_Control
{
  long resultValue;
  
  // --- FR ---
  setBusContext(getBusNameContext(gFR1BusName));
  switch(@this)
  {
     Case(this::SignalUBOFF) :
        resultValue = DisturbUB(Backbone::CEM::CEMBackBoneSignalIpdu13::FltLiDaytiRunngLe_UB,0,-1,0); break;
     Case(this::SignalUBHandled) :
        resultValue = DisturbUB(Backbone::CEM::CEMBackBoneSignalIpdu13::FltLiDaytiRunngLe_UB,0,0,0); break;
     Case(this::SignalUBON) :
        resultValue = DisturbUB(Backbone::CEM::CEMBackBoneSignalIpdu13::FltLiDaytiRunngLe_UB,0,-1,1); break;
     Default :
        resultValue = -1;
  }
  
}

on sysvar_update sysvar::CEM::Backbone::Signals::Control::UB::FltLiRvsg_UB_Control
{
  long resultValue;
  
  // --- FR ---
  setBusContext(getBusNameContext(gFR1BusName));
  switch(@this)
  {
     Case(this::SignalUBOFF) :
        resultValue = DisturbUB(Backbone::CEM::CEMBackBoneSignalIpdu13::FltLiRvsg_UB,0,-1,0); break;
     Case(this::SignalUBHandled) :
        resultValue = DisturbUB(Backbone::CEM::CEMBackBoneSignalIpdu13::FltLiRvsg_UB,0,0,0); break;
     Case(this::SignalUBON) :
        resultValue = DisturbUB(Backbone::CEM::CEMBackBoneSignalIpdu13::FltLiRvsg_UB,0,-1,1); break;
     Default :
        resultValue = -1;
  }
  
}

on sysvar_update sysvar::CEM::Backbone::Signals::Control::UB::FltLiSideMkrFrnt_UB_Control
{
  long resultValue;
  
  // --- FR ---
  setBusContext(getBusNameContext(gFR1BusName));
  switch(@this)
  {
     Case(this::SignalUBOFF) :
        resultValue = DisturbUB(Backbone::CEM::CEMBackBoneSignalIpdu13::FltLiSideMkrFrnt_UB,0,-1,0); break;
     Case(this::SignalUBHandled) :
        resultValue = DisturbUB(Backbone::CEM::CEMBackBoneSignalIpdu13::FltLiSideMkrFrnt_UB,0,0,0); break;
     Case(this::SignalUBON) :
        resultValue = DisturbUB(Backbone::CEM::CEMBackBoneSignalIpdu13::FltLiSideMkrFrnt_UB,0,-1,1); break;
     Default :
        resultValue = -1;
  }
  
}

on sysvar_update sysvar::CEM::Backbone::Signals::Control::UB::FltOfBeamHiLe_UB_Control
{
  long resultValue;
  
  // --- FR ---
  setBusContext(getBusNameContext(gFR1BusName));
  switch(@this)
  {
     Case(this::SignalUBOFF) :
        resultValue = DisturbUB(Backbone::CEM::CEMBackBoneSignalIpdu13::FltOfBeamHiLe_UB,0,-1,0); break;
     Case(this::SignalUBHandled) :
        resultValue = DisturbUB(Backbone::CEM::CEMBackBoneSignalIpdu13::FltOfBeamHiLe_UB,0,0,0); break;
     Case(this::SignalUBON) :
        resultValue = DisturbUB(Backbone::CEM::CEMBackBoneSignalIpdu13::FltOfBeamHiLe_UB,0,-1,1); break;
     Default :
        resultValue = -1;
  }
  
}

on sysvar_update sysvar::CEM::Backbone::Signals::Control::UB::FltOfBeamHiRi_UB_Control
{
  long resultValue;
  
  // --- FR ---
  setBusContext(getBusNameContext(gFR1BusName));
  switch(@this)
  {
     Case(this::SignalUBOFF) :
        resultValue = DisturbUB(Backbone::CEM::CEMBackBoneSignalIpdu13::FltOfBeamHiRi_UB,0,-1,0); break;
     Case(this::SignalUBHandled) :
        resultValue = DisturbUB(Backbone::CEM::CEMBackBoneSignalIpdu13::FltOfBeamHiRi_UB,0,0,0); break;
     Case(this::SignalUBON) :
        resultValue = DisturbUB(Backbone::CEM::CEMBackBoneSignalIpdu13::FltOfBeamHiRi_UB,0,-1,1); break;
     Default :
        resultValue = -1;
  }
  
}

on sysvar_update sysvar::CEM::Backbone::Signals::Control::UB::FltOfBrkLiHiMntd_UB_Control
{
  long resultValue;
  
  // --- FR ---
  setBusContext(getBusNameContext(gFR1BusName));
  switch(@this)
  {
     Case(this::SignalUBOFF) :
        resultValue = DisturbUB(Backbone::CEM::CEMBackBoneSignalIpdu13::FltOfBrkLiHiMntd_UB,0,-1,0); break;
     Case(this::SignalUBHandled) :
        resultValue = DisturbUB(Backbone::CEM::CEMBackBoneSignalIpdu13::FltOfBrkLiHiMntd_UB,0,0,0); break;
     Case(this::SignalUBON) :
        resultValue = DisturbUB(Backbone::CEM::CEMBackBoneSignalIpdu13::FltOfBrkLiHiMntd_UB,0,-1,1); break;
     Default :
        resultValue = -1;
  }
  
}

on sysvar_update sysvar::CEM::Backbone::Signals::Control::UB::FltOfBrkLiLe_UB_Control
{
  long resultValue;
  
  // --- FR ---
  setBusContext(getBusNameContext(gFR1BusName));
  switch(@this)
  {
     Case(this::SignalUBOFF) :
        resultValue = DisturbUB(Backbone::CEM::CEMBackBoneSignalIpdu13::FltOfBrkLiLe_UB,0,-1,0); break;
     Case(this::SignalUBHandled) :
        resultValue = DisturbUB(Backbone::CEM::CEMBackBoneSignalIpdu13::FltOfBrkLiLe_UB,0,0,0); break;
     Case(this::SignalUBON) :
        resultValue = DisturbUB(Backbone::CEM::CEMBackBoneSignalIpdu13::FltOfBrkLiLe_UB,0,-1,1); break;
     Default :
        resultValue = -1;
  }
  
}

on sysvar_update sysvar::CEM::Backbone::Signals::Control::UB::FltOfBrkLiRi_UB_Control
{
  long resultValue;
  
  // --- FR ---
  setBusContext(getBusNameContext(gFR1BusName));
  switch(@this)
  {
     Case(this::SignalUBOFF) :
        resultValue = DisturbUB(Backbone::CEM::CEMBackBoneSignalIpdu13::FltOfBrkLiRi_UB,0,-1,0); break;
     Case(this::SignalUBHandled) :
        resultValue = DisturbUB(Backbone::CEM::CEMBackBoneSignalIpdu13::FltOfBrkLiRi_UB,0,0,0); break;
     Case(this::SignalUBON) :
        resultValue = DisturbUB(Backbone::CEM::CEMBackBoneSignalIpdu13::FltOfBrkLiRi_UB,0,-1,1); break;
     Default :
        resultValue = -1;
  }
  
}

on sysvar_update sysvar::CEM::Backbone::Signals::Control::UB::FltOfFogLiFrnt_UB_Control
{
  long resultValue;
  
  // --- FR ---
  setBusContext(getBusNameContext(gFR1BusName));
  switch(@this)
  {
     Case(this::SignalUBOFF) :
        resultValue = DisturbUB(Backbone::CEM::CEMBackBoneSignalIpdu13::FltOfFogLiFrnt_UB,0,-1,0); break;
     Case(this::SignalUBHandled) :
        resultValue = DisturbUB(Backbone::CEM::CEMBackBoneSignalIpdu13::FltOfFogLiFrnt_UB,0,0,0); break;
     Case(this::SignalUBON) :
        resultValue = DisturbUB(Backbone::CEM::CEMBackBoneSignalIpdu13::FltOfFogLiFrnt_UB,0,-1,1); break;
     Default :
        resultValue = -1;
  }
  
}

on sysvar_update sysvar::CEM::Backbone::Signals::Control::UB::FltOfLiDaytiRunngRi_UB_Control
{
  long resultValue;
  
  // --- FR ---
  setBusContext(getBusNameContext(gFR1BusName));
  switch(@this)
  {
     Case(this::SignalUBOFF) :
        resultValue = DisturbUB(Backbone::CEM::CEMBackBoneSignalIpdu13::FltOfLiDaytiRunngRi_UB,0,-1,0); break;
     Case(this::SignalUBHandled) :
        resultValue = DisturbUB(Backbone::CEM::CEMBackBoneSignalIpdu13::FltOfLiDaytiRunngRi_UB,0,0,0); break;
     Case(this::SignalUBON) :
        resultValue = DisturbUB(Backbone::CEM::CEMBackBoneSignalIpdu13::FltOfLiDaytiRunngRi_UB,0,-1,1); break;
     Default :
        resultValue = -1;
  }
  
}

on sysvar_update sysvar::CEM::Backbone::Signals::Control::UB::FltOfLiPosnFrntLe_UB_Control
{
  long resultValue;
  
  // --- FR ---
  setBusContext(getBusNameContext(gFR1BusName));
  switch(@this)
  {
     Case(this::SignalUBOFF) :
        resultValue = DisturbUB(Backbone::CEM::CEMBackBoneSignalIpdu13::FltOfLiPosnFrntLe_UB,0,-1,0); break;
     Case(this::SignalUBHandled) :
        resultValue = DisturbUB(Backbone::CEM::CEMBackBoneSignalIpdu13::FltOfLiPosnFrntLe_UB,0,0,0); break;
     Case(this::SignalUBON) :
        resultValue = DisturbUB(Backbone::CEM::CEMBackBoneSignalIpdu13::FltOfLiPosnFrntLe_UB,0,-1,1); break;
     Default :
        resultValue = -1;
  }
  
}

on sysvar_update sysvar::CEM::Backbone::Signals::Control::UB::FltOfLiPosnFrntRi_UB_Control
{
  long resultValue;
  
  // --- FR ---
  setBusContext(getBusNameContext(gFR1BusName));
  switch(@this)
  {
     Case(this::SignalUBOFF) :
        resultValue = DisturbUB(Backbone::CEM::CEMBackBoneSignalIpdu13::FltOfLiPosnFrntRi_UB,0,-1,0); break;
     Case(this::SignalUBHandled) :
        resultValue = DisturbUB(Backbone::CEM::CEMBackBoneSignalIpdu13::FltOfLiPosnFrntRi_UB,0,0,0); break;
     Case(this::SignalUBON) :
        resultValue = DisturbUB(Backbone::CEM::CEMBackBoneSignalIpdu13::FltOfLiPosnFrntRi_UB,0,-1,1); break;
     Default :
        resultValue = -1;
  }
  
}

on sysvar_update sysvar::CEM::Backbone::Signals::Control::UB::FltOfPlateNr_UB_Control
{
  long resultValue;
  
  // --- FR ---
  setBusContext(getBusNameContext(gFR1BusName));
  switch(@this)
  {
     Case(this::SignalUBOFF) :
        resultValue = DisturbUB(Backbone::CEM::CEMBackBoneSignalIpdu13::FltOfPlateNr_UB,0,-1,0); break;
     Case(this::SignalUBHandled) :
        resultValue = DisturbUB(Backbone::CEM::CEMBackBoneSignalIpdu13::FltOfPlateNr_UB,0,0,0); break;
     Case(this::SignalUBON) :
        resultValue = DisturbUB(Backbone::CEM::CEMBackBoneSignalIpdu13::FltOfPlateNr_UB,0,-1,1); break;
     Default :
        resultValue = -1;
  }
  
}

on sysvar_update sysvar::CEM::Backbone::Signals::Control::UB::FltOfPosnReLe_UB_Control
{
  long resultValue;
  
  // --- FR ---
  setBusContext(getBusNameContext(gFR1BusName));
  switch(@this)
  {
     Case(this::SignalUBOFF) :
        resultValue = DisturbUB(Backbone::CEM::CEMBackBoneSignalIpdu13::FltOfPosnReLe_UB,0,-1,0); break;
     Case(this::SignalUBHandled) :
        resultValue = DisturbUB(Backbone::CEM::CEMBackBoneSignalIpdu13::FltOfPosnReLe_UB,0,0,0); break;
     Case(this::SignalUBON) :
        resultValue = DisturbUB(Backbone::CEM::CEMBackBoneSignalIpdu13::FltOfPosnReLe_UB,0,-1,1); break;
     Default :
        resultValue = -1;
  }
  
}

on sysvar_update sysvar::CEM::Backbone::Signals::Control::UB::FltOfPosnReRi_UB_Control
{
  long resultValue;
  
  // --- FR ---
  setBusContext(getBusNameContext(gFR1BusName));
  switch(@this)
  {
     Case(this::SignalUBOFF) :
        resultValue = DisturbUB(Backbone::CEM::CEMBackBoneSignalIpdu13::FltOfPosnReRi_UB,0,-1,0); break;
     Case(this::SignalUBHandled) :
        resultValue = DisturbUB(Backbone::CEM::CEMBackBoneSignalIpdu13::FltOfPosnReRi_UB,0,0,0); break;
     Case(this::SignalUBON) :
        resultValue = DisturbUB(Backbone::CEM::CEMBackBoneSignalIpdu13::FltOfPosnReRi_UB,0,-1,1); break;
     Default :
        resultValue = -1;
  }
  
}

on sysvar_update sysvar::CEM::Backbone::Signals::Control::UB::LockgCenStsForUsrFb_UB_Control
{
  long resultValue;
  
  // --- FR ---
  setBusContext(getBusNameContext(gFR1BusName));
  switch(@this)
  {
     Case(this::SignalUBOFF) :
        resultValue = DisturbUB(Backbone::CEM::CEMBackBoneSignalIpdu13::LockgCenStsForUsrFb_UB,0,-1,0); break;
     Case(this::SignalUBHandled) :
        resultValue = DisturbUB(Backbone::CEM::CEMBackBoneSignalIpdu13::LockgCenStsForUsrFb_UB,0,0,0); break;
     Case(this::SignalUBON) :
        resultValue = DisturbUB(Backbone::CEM::CEMBackBoneSignalIpdu13::LockgCenStsForUsrFb_UB,0,-1,1); break;
     Default :
        resultValue = -1;
  }
  
}

on sysvar_update sysvar::CEM::Backbone::Signals::Control::UB::MirrDwnStsAtPass_UB_Control
{
  long resultValue;
  
  // --- FR ---
  setBusContext(getBusNameContext(gFR1BusName));
  switch(@this)
  {
     Case(this::SignalUBOFF) :
        resultValue = DisturbUB(Backbone::CEM::CEMBackBoneSignalIpdu13::MirrDwnStsAtPass_UB,0,-1,0); break;
     Case(this::SignalUBHandled) :
        resultValue = DisturbUB(Backbone::CEM::CEMBackBoneSignalIpdu13::MirrDwnStsAtPass_UB,0,0,0); break;
     Case(this::SignalUBON) :
        resultValue = DisturbUB(Backbone::CEM::CEMBackBoneSignalIpdu13::MirrDwnStsAtPass_UB,0,-1,1); break;
     Default :
        resultValue = -1;
  }
  
}

on sysvar_update sysvar::CEM::Backbone::Signals::Control::UB::PostCrashMsg_UB_Control
{
  long resultValue;
  
  // --- FR ---
  setBusContext(getBusNameContext(gFR1BusName));
  switch(@this)
  {
     Case(this::SignalUBOFF) :
        resultValue = DisturbUB(Backbone::CEM::CEMBackBoneSignalIpdu13::PostCrashMsg_UB,0,-1,0); break;
     Case(this::SignalUBHandled) :
        resultValue = DisturbUB(Backbone::CEM::CEMBackBoneSignalIpdu13::PostCrashMsg_UB,0,0,0); break;
     Case(this::SignalUBON) :
        resultValue = DisturbUB(Backbone::CEM::CEMBackBoneSignalIpdu13::PostCrashMsg_UB,0,-1,1); break;
     Default :
        resultValue = -1;
  }
  
}

on sysvar_update sysvar::CEM::Backbone::Signals::Control::UB::RainSnsrActvnErrToHmi_UB_Control
{
  long resultValue;
  
  // --- FR ---
  setBusContext(getBusNameContext(gFR1BusName));
  switch(@this)
  {
     Case(this::SignalUBOFF) :
        resultValue = DisturbUB(Backbone::CEM::CEMBackBoneSignalIpdu13::RainSnsrActvnErrToHmi_UB,0,-1,0); break;
     Case(this::SignalUBHandled) :
        resultValue = DisturbUB(Backbone::CEM::CEMBackBoneSignalIpdu13::RainSnsrActvnErrToHmi_UB,0,0,0); break;
     Case(this::SignalUBON) :
        resultValue = DisturbUB(Backbone::CEM::CEMBackBoneSignalIpdu13::RainSnsrActvnErrToHmi_UB,0,-1,1); break;
     Default :
        resultValue = -1;
  }
  
}

on sysvar_update sysvar::CEM::Backbone::Signals::Control::UB::RlyPwrDistbnCmd1WdIgnRlyCmd_UB_Control
{
  long resultValue;
  
  // --- FR ---
  setBusContext(getBusNameContext(gFR1BusName));
  switch(@this)
  {
     Case(this::SignalUBOFF) :
        resultValue = DisturbUB(Backbone::CEM::CEMBackBoneSignalIpdu13::RlyPwrDistbnCmd1WdIgnRlyCmd_UB,0,-1,0); break;
     Case(this::SignalUBHandled) :
        resultValue = DisturbUB(Backbone::CEM::CEMBackBoneSignalIpdu13::RlyPwrDistbnCmd1WdIgnRlyCmd_UB,0,0,0); break;
     Case(this::SignalUBON) :
        resultValue = DisturbUB(Backbone::CEM::CEMBackBoneSignalIpdu13::RlyPwrDistbnCmd1WdIgnRlyCmd_UB,0,-1,1); break;
     Default :
        resultValue = -1;
  }
  
}

on sysvar_update sysvar::CEM::Backbone::Signals::Control::UB::RlyPwrDistbnCmd1WdIgnRlyExtCmd_UB_Control
{
  long resultValue;
  
  // --- FR ---
  setBusContext(getBusNameContext(gFR1BusName));
  switch(@this)
  {
     Case(this::SignalUBOFF) :
        resultValue = DisturbUB(Backbone::CEM::CEMBackBoneSignalIpdu13::RlyPwrDistbnCmd1WdIgnRlyExtCmd_UB,0,-1,0); break;
     Case(this::SignalUBHandled) :
        resultValue = DisturbUB(Backbone::CEM::CEMBackBoneSignalIpdu13::RlyPwrDistbnCmd1WdIgnRlyExtCmd_UB,0,0,0); break;
     Case(this::SignalUBON) :
        resultValue = DisturbUB(Backbone::CEM::CEMBackBoneSignalIpdu13::RlyPwrDistbnCmd1WdIgnRlyExtCmd_UB,0,-1,1); break;
     Default :
        resultValue = -1;
  }
  
}

on sysvar_update sysvar::CEM::Backbone::Signals::Control::UB::RstrtAutMovmtReq_UB_Control
{
  long resultValue;
  
  // --- FR ---
  setBusContext(getBusNameContext(gFR1BusName));
  switch(@this)
  {
     Case(this::SignalUBOFF) :
        resultValue = DisturbUB(Backbone::CEM::CEMBackBoneSignalIpdu13::RstrtAutMovmtReq_UB,0,-1,0); break;
     Case(this::SignalUBHandled) :
        resultValue = DisturbUB(Backbone::CEM::CEMBackBoneSignalIpdu13::RstrtAutMovmtReq_UB,0,0,0); break;
     Case(this::SignalUBON) :
        resultValue = DisturbUB(Backbone::CEM::CEMBackBoneSignalIpdu13::RstrtAutMovmtReq_UB,0,-1,1); break;
     Default :
        resultValue = -1;
  }
  
}

on sysvar_update sysvar::CEM::Backbone::Signals::Control::UB::SeatVentnAutCdn_UB_Control
{
  long resultValue;
  
  // --- FR ---
  setBusContext(getBusNameContext(gFR1BusName));
  switch(@this)
  {
     Case(this::SignalUBOFF) :
        resultValue = DisturbUB(Backbone::CEM::CEMBackBoneSignalIpdu13::SeatVentnAutCdn_UB,0,-1,0); break;
     Case(this::SignalUBHandled) :
        resultValue = DisturbUB(Backbone::CEM::CEMBackBoneSignalIpdu13::SeatVentnAutCdn_UB,0,0,0); break;
     Case(this::SignalUBON) :
        resultValue = DisturbUB(Backbone::CEM::CEMBackBoneSignalIpdu13::SeatVentnAutCdn_UB,0,-1,1); break;
     Default :
        resultValue = -1;
  }
  
}

on sysvar_update sysvar::CEM::Backbone::Signals::Control::UB::StrtInProgs_UB_Control
{
  long resultValue;
  
  // --- FR ---
  setBusContext(getBusNameContext(gFR1BusName));
  switch(@this)
  {
     Case(this::SignalUBOFF) :
        resultValue = DisturbUB(Backbone::CEM::CEMBackBoneSignalIpdu13::StrtInProgs_UB,0,-1,0); break;
     Case(this::SignalUBHandled) :
        resultValue = DisturbUB(Backbone::CEM::CEMBackBoneSignalIpdu13::StrtInProgs_UB,0,0,0); break;
     Case(this::SignalUBON) :
        resultValue = DisturbUB(Backbone::CEM::CEMBackBoneSignalIpdu13::StrtInProgs_UB,0,-1,1); break;
     Default :
        resultValue = -1;
  }
  
}

on sysvar_update sysvar::CEM::Backbone::Signals::Control::UB::TrstLiIndcnDisp_UB_Control
{
  long resultValue;
  
  // --- FR ---
  setBusContext(getBusNameContext(gFR1BusName));
  switch(@this)
  {
     Case(this::SignalUBOFF) :
        resultValue = DisturbUB(Backbone::CEM::CEMBackBoneSignalIpdu13::TrstLiIndcnDisp_UB,0,-1,0); break;
     Case(this::SignalUBHandled) :
        resultValue = DisturbUB(Backbone::CEM::CEMBackBoneSignalIpdu13::TrstLiIndcnDisp_UB,0,0,0); break;
     Case(this::SignalUBON) :
        resultValue = DisturbUB(Backbone::CEM::CEMBackBoneSignalIpdu13::TrstLiIndcnDisp_UB,0,-1,1); break;
     Default :
        resultValue = -1;
  }
  
}

on sysvar_update sysvar::CEM::Backbone::Signals::Control::UB::UkwnCptSts1_UB_Control
{
  long resultValue;
  
  // --- FR ---
  setBusContext(getBusNameContext(gFR1BusName));
  switch(@this)
  {
     Case(this::SignalUBOFF) :
        resultValue = DisturbUB(Backbone::CEM::CEMBackBoneSignalIpdu13::UkwnCptSts1_UB,0,-1,0); break;
     Case(this::SignalUBHandled) :
        resultValue = DisturbUB(Backbone::CEM::CEMBackBoneSignalIpdu13::UkwnCptSts1_UB,0,0,0); break;
     Case(this::SignalUBON) :
        resultValue = DisturbUB(Backbone::CEM::CEMBackBoneSignalIpdu13::UkwnCptSts1_UB,0,-1,1); break;
     Default :
        resultValue = -1;
  }
  
}

on sysvar_update sysvar::CEM::Backbone::Signals::Control::UB::VehNotParkInfoWarn_UB_Control
{
  long resultValue;
  
  // --- FR ---
  setBusContext(getBusNameContext(gFR1BusName));
  switch(@this)
  {
     Case(this::SignalUBOFF) :
        resultValue = DisturbUB(Backbone::CEM::CEMBackBoneSignalIpdu13::VehNotParkInfoWarn_UB,0,-1,0); break;
     Case(this::SignalUBHandled) :
        resultValue = DisturbUB(Backbone::CEM::CEMBackBoneSignalIpdu13::VehNotParkInfoWarn_UB,0,0,0); break;
     Case(this::SignalUBON) :
        resultValue = DisturbUB(Backbone::CEM::CEMBackBoneSignalIpdu13::VehNotParkInfoWarn_UB,0,-1,1); break;
     Default :
        resultValue = -1;
  }
  
}

on sysvar_update sysvar::CEM::Backbone::Signals::Control::UB::WshrLvrPosn_UB_Control
{
  long resultValue;
  
  // --- FR ---
  setBusContext(getBusNameContext(gFR1BusName));
  switch(@this)
  {
     Case(this::SignalUBOFF) :
        resultValue = DisturbUB(Backbone::CEM::CEMBackBoneSignalIpdu13::WshrLvrPosn_UB,0,-1,0); break;
     Case(this::SignalUBHandled) :
        resultValue = DisturbUB(Backbone::CEM::CEMBackBoneSignalIpdu13::WshrLvrPosn_UB,0,0,0); break;
     Case(this::SignalUBON) :
        resultValue = DisturbUB(Backbone::CEM::CEMBackBoneSignalIpdu13::WshrLvrPosn_UB,0,-1,1); break;
     Default :
        resultValue = -1;
  }
  
}

on sysvar_update sysvar::CEM::Backbone::Signals::Control::UB::ImobEngMgrReq5_UB_Control
{
  long resultValue;
  
  // --- FR ---
  setBusContext(getBusNameContext(gFR1BusName));
  switch(@this)
  {
     Case(this::SignalUBOFF) :
        resultValue = DisturbUB(Backbone::CEM::CEMBackBoneSignalIpdu16::ImobEngMgrReq5_UB,0,-1,0); break;
     Case(this::SignalUBHandled) :
        resultValue = DisturbUB(Backbone::CEM::CEMBackBoneSignalIpdu16::ImobEngMgrReq5_UB,0,0,0); break;
     Case(this::SignalUBON) :
        resultValue = DisturbUB(Backbone::CEM::CEMBackBoneSignalIpdu16::ImobEngMgrReq5_UB,0,-1,1); break;
     Default :
        resultValue = -1;
  }
  
}

on sysvar_update sysvar::CEM::Backbone::Signals::Control::UB::ImobEngMgrReq6_UB_Control
{
  long resultValue;
  
  // --- FR ---
  setBusContext(getBusNameContext(gFR1BusName));
  switch(@this)
  {
     Case(this::SignalUBOFF) :
        resultValue = DisturbUB(Backbone::CEM::CEMBackBoneSignalIpdu16::ImobEngMgrReq6_UB,0,-1,0); break;
     Case(this::SignalUBHandled) :
        resultValue = DisturbUB(Backbone::CEM::CEMBackBoneSignalIpdu16::ImobEngMgrReq6_UB,0,0,0); break;
     Case(this::SignalUBON) :
        resultValue = DisturbUB(Backbone::CEM::CEMBackBoneSignalIpdu16::ImobEngMgrReq6_UB,0,-1,1); break;
     Default :
        resultValue = -1;
  }
  
}

on sysvar_update sysvar::CEM::Backbone::Signals::Control::UB::AmbTURawAtRiSideForObd_UB_Control
{
  long resultValue;
  
  // --- FR ---
  setBusContext(getBusNameContext(gFR1BusName));
  switch(@this)
  {
     Case(this::SignalUBOFF) :
        resultValue = DisturbUB(Backbone::CEM::CEMBackBoneSignalIpdu16::AmbTURawAtRiSideForObd_UB,0,-1,0); break;
     Case(this::SignalUBHandled) :
        resultValue = DisturbUB(Backbone::CEM::CEMBackBoneSignalIpdu16::AmbTURawAtRiSideForObd_UB,0,0,0); break;
     Case(this::SignalUBON) :
        resultValue = DisturbUB(Backbone::CEM::CEMBackBoneSignalIpdu16::AmbTURawAtRiSideForObd_UB,0,-1,1); break;
     Default :
        resultValue = -1;
  }
  
}

on sysvar_update sysvar::CEM::Backbone::Signals::Control::UB::FuReqForFuHeatr_UB_Control
{
  long resultValue;
  
  // --- FR ---
  setBusContext(getBusNameContext(gFR1BusName));
  switch(@this)
  {
     Case(this::SignalUBOFF) :
        resultValue = DisturbUB(Backbone::CEM::CEMBackBoneSignalIpdu16::FuReqForFuHeatr_UB,0,-1,0); break;
     Case(this::SignalUBHandled) :
        resultValue = DisturbUB(Backbone::CEM::CEMBackBoneSignalIpdu16::FuReqForFuHeatr_UB,0,0,0); break;
     Case(this::SignalUBON) :
        resultValue = DisturbUB(Backbone::CEM::CEMBackBoneSignalIpdu16::FuReqForFuHeatr_UB,0,-1,1); break;
     Default :
        resultValue = -1;
  }
  
}

on sysvar_update sysvar::CEM::Backbone::Signals::Control::UB::IntrLiGearLvrPulse_UB_Control
{
  long resultValue;
  
  // --- FR ---
  setBusContext(getBusNameContext(gFR1BusName));
  switch(@this)
  {
     Case(this::SignalUBOFF) :
        resultValue = DisturbUB(Backbone::CEM::CEMBackBoneSignalIpdu16::IntrLiGearLvrPulse_UB,0,-1,0); break;
     Case(this::SignalUBHandled) :
        resultValue = DisturbUB(Backbone::CEM::CEMBackBoneSignalIpdu16::IntrLiGearLvrPulse_UB,0,0,0); break;
     Case(this::SignalUBON) :
        resultValue = DisturbUB(Backbone::CEM::CEMBackBoneSignalIpdu16::IntrLiGearLvrPulse_UB,0,-1,1); break;
     Default :
        resultValue = -1;
  }
  
}

on sysvar_update sysvar::CEM::Backbone::Signals::Control::UB::TelmChrgnTmrActvd_UB_Control
{
  long resultValue;
  
  // --- FR ---
  setBusContext(getBusNameContext(gFR1BusName));
  switch(@this)
  {
     Case(this::SignalUBOFF) :
        resultValue = DisturbUB(Backbone::CEM::CEMBackBoneSignalIpdu16::TelmChrgnTmrActvd_UB,0,-1,0); break;
     Case(this::SignalUBHandled) :
        resultValue = DisturbUB(Backbone::CEM::CEMBackBoneSignalIpdu16::TelmChrgnTmrActvd_UB,0,0,0); break;
     Case(this::SignalUBON) :
        resultValue = DisturbUB(Backbone::CEM::CEMBackBoneSignalIpdu16::TelmChrgnTmrActvd_UB,0,-1,1); break;
     Default :
        resultValue = -1;
  }
  
}

on sysvar_update sysvar::CEM::Backbone::Signals::Control::UB::TelmStopTiChrgnTmr_UB_Control
{
  long resultValue;
  
  // --- FR ---
  setBusContext(getBusNameContext(gFR1BusName));
  switch(@this)
  {
     Case(this::SignalUBOFF) :
        resultValue = DisturbUB(Backbone::CEM::CEMBackBoneSignalIpdu16::TelmStopTiChrgnTmr_UB,0,-1,0); break;
     Case(this::SignalUBHandled) :
        resultValue = DisturbUB(Backbone::CEM::CEMBackBoneSignalIpdu16::TelmStopTiChrgnTmr_UB,0,0,0); break;
     Case(this::SignalUBON) :
        resultValue = DisturbUB(Backbone::CEM::CEMBackBoneSignalIpdu16::TelmStopTiChrgnTmr_UB,0,-1,1); break;
     Default :
        resultValue = -1;
  }
  
}

on sysvar_update sysvar::CEM::Backbone::Signals::Control::UB::TelmStrtTiChrgnTmr_UB_Control
{
  long resultValue;
  
  // --- FR ---
  setBusContext(getBusNameContext(gFR1BusName));
  switch(@this)
  {
     Case(this::SignalUBOFF) :
        resultValue = DisturbUB(Backbone::CEM::CEMBackBoneSignalIpdu16::TelmStrtTiChrgnTmr_UB,0,-1,0); break;
     Case(this::SignalUBHandled) :
        resultValue = DisturbUB(Backbone::CEM::CEMBackBoneSignalIpdu16::TelmStrtTiChrgnTmr_UB,0,0,0); break;
     Case(this::SignalUBON) :
        resultValue = DisturbUB(Backbone::CEM::CEMBackBoneSignalIpdu16::TelmStrtTiChrgnTmr_UB,0,-1,1); break;
     Default :
        resultValue = -1;
  }
  
}

on sysvar_update sysvar::CEM::Backbone::SignalGroups::Control::E2E::PwrSplyRdyForCrkChks_Control
{
  int controlValue;
  long resultValue;
  
  // --- FR ---
  controlValue = (int) @this;
  setBusContext(getBusNameContext(gFR1BusName));
  switch(controlValue)
  {
     Case(this::ChksHandled) :
        resultValue = EnableCRC("PwrSplyRdyForCrk", 1); break;
     Case(this::ChksManual) :
        resultValue = EnableCRC("PwrSplyRdyForCrk", 0); break;
     Default :
        resultValue = -1;
  }
  
}

on sysvar_update sysvar::CEM::Backbone::SignalGroups::Control::E2E::PwrSplyRdyForCrkCntr_Control
{
  int controlValue;
  long resultValue;
  
  // --- FR ---
  controlValue = (int) @this;
  setBusContext(getBusNameContext(gFR1BusName));
  switch(controlValue)
  {
     Case(this::CntrHandled) :
        resultValue = EnableCounter ("PwrSplyRdyForCrk", 1); break;
     Case(this::CntrManual) :
        resultValue = EnableCounter ("PwrSplyRdyForCrk", 0); break;
     Default :
        resultValue = -1;
  }
  
}

on sysvar_update sysvar::CEM::Backbone::Signals::Control::UB::BattMntnIntl_UB_Control
{
  long resultValue;
  
  // --- FR ---
  setBusContext(getBusNameContext(gFR1BusName));
  switch(@this)
  {
     Case(this::SignalUBOFF) :
        resultValue = DisturbUB(Backbone::CEM::CEMBackBoneSignalIpdu17::BattMntnIntl_UB,0,-1,0); break;
     Case(this::SignalUBHandled) :
        resultValue = DisturbUB(Backbone::CEM::CEMBackBoneSignalIpdu17::BattMntnIntl_UB,0,0,0); break;
     Case(this::SignalUBON) :
        resultValue = DisturbUB(Backbone::CEM::CEMBackBoneSignalIpdu17::BattMntnIntl_UB,0,-1,1); break;
     Default :
        resultValue = -1;
  }
  
}

on sysvar_update sysvar::CEM::Backbone::Signals::Control::UB::DayOfBattMntnChrg_UB_Control
{
  long resultValue;
  
  // --- FR ---
  setBusContext(getBusNameContext(gFR1BusName));
  switch(@this)
  {
     Case(this::SignalUBOFF) :
        resultValue = DisturbUB(Backbone::CEM::CEMBackBoneSignalIpdu17::DayOfBattMntnChrg_UB,0,-1,0); break;
     Case(this::SignalUBHandled) :
        resultValue = DisturbUB(Backbone::CEM::CEMBackBoneSignalIpdu17::DayOfBattMntnChrg_UB,0,0,0); break;
     Case(this::SignalUBON) :
        resultValue = DisturbUB(Backbone::CEM::CEMBackBoneSignalIpdu17::DayOfBattMntnChrg_UB,0,-1,1); break;
     Default :
        resultValue = -1;
  }
  
}

on sysvar_update sysvar::CEM::Backbone::Signals::Control::UB::PwrSplyRdyForCrk_UB_Control
{
  long resultValue;
  
  // --- FR ---
  setBusContext(getBusNameContext(gFR1BusName));
  switch(@this)
  {
     Case(this::SignalUBOFF) :
        resultValue = DisturbUB(Backbone::CEM::CEMBackBoneSignalIpdu17::PwrSplyRdyForCrk_UB,0,-1,0); break;
     Case(this::SignalUBHandled) :
        resultValue = DisturbUB(Backbone::CEM::CEMBackBoneSignalIpdu17::PwrSplyRdyForCrk_UB,0,0,0); break;
     Case(this::SignalUBON) :
        resultValue = DisturbUB(Backbone::CEM::CEMBackBoneSignalIpdu17::PwrSplyRdyForCrk_UB,0,-1,1); break;
     Default :
        resultValue = -1;
  }
  
}

on sysvar_update sysvar::CEM::Backbone::Signals::Control::UB::BattI_UB_Control
{
  long resultValue;
  
  // --- FR ---
  setBusContext(getBusNameContext(gFR1BusName));
  switch(@this)
  {
     Case(this::SignalUBOFF) :
        resultValue = DisturbUB(Backbone::CEM::CEMBackBoneSignalIpdu17::BattI_UB,0,-1,0); break;
     Case(this::SignalUBHandled) :
        resultValue = DisturbUB(Backbone::CEM::CEMBackBoneSignalIpdu17::BattI_UB,0,0,0); break;
     Case(this::SignalUBON) :
        resultValue = DisturbUB(Backbone::CEM::CEMBackBoneSignalIpdu17::BattI_UB,0,-1,1); break;
     Default :
        resultValue = -1;
  }
  
}

on sysvar_update sysvar::CEM::Backbone::Signals::Control::UB::BattIQuiscFildLong_UB_Control
{
  long resultValue;
  
  // --- FR ---
  setBusContext(getBusNameContext(gFR1BusName));
  switch(@this)
  {
     Case(this::SignalUBOFF) :
        resultValue = DisturbUB(Backbone::CEM::CEMBackBoneSignalIpdu17::BattIQuiscFildLong_UB,0,-1,0); break;
     Case(this::SignalUBHandled) :
        resultValue = DisturbUB(Backbone::CEM::CEMBackBoneSignalIpdu17::BattIQuiscFildLong_UB,0,0,0); break;
     Case(this::SignalUBON) :
        resultValue = DisturbUB(Backbone::CEM::CEMBackBoneSignalIpdu17::BattIQuiscFildLong_UB,0,-1,1); break;
     Default :
        resultValue = -1;
  }
  
}

on sysvar_update sysvar::CEM::Backbone::Signals::Control::UB::BattMntnChrg_UB_Control
{
  long resultValue;
  
  // --- FR ---
  setBusContext(getBusNameContext(gFR1BusName));
  switch(@this)
  {
     Case(this::SignalUBOFF) :
        resultValue = DisturbUB(Backbone::CEM::CEMBackBoneSignalIpdu17::BattMntnChrg_UB,0,-1,0); break;
     Case(this::SignalUBHandled) :
        resultValue = DisturbUB(Backbone::CEM::CEMBackBoneSignalIpdu17::BattMntnChrg_UB,0,0,0); break;
     Case(this::SignalUBON) :
        resultValue = DisturbUB(Backbone::CEM::CEMBackBoneSignalIpdu17::BattMntnChrg_UB,0,-1,1); break;
     Default :
        resultValue = -1;
  }
  
}

on sysvar_update sysvar::CEM::Backbone::Signals::Control::UB::BattSocIntgr_UB_Control
{
  long resultValue;
  
  // --- FR ---
  setBusContext(getBusNameContext(gFR1BusName));
  switch(@this)
  {
     Case(this::SignalUBOFF) :
        resultValue = DisturbUB(Backbone::CEM::CEMBackBoneSignalIpdu17::BattSocIntgr_UB,0,-1,0); break;
     Case(this::SignalUBHandled) :
        resultValue = DisturbUB(Backbone::CEM::CEMBackBoneSignalIpdu17::BattSocIntgr_UB,0,0,0); break;
     Case(this::SignalUBON) :
        resultValue = DisturbUB(Backbone::CEM::CEMBackBoneSignalIpdu17::BattSocIntgr_UB,0,-1,1); break;
     Default :
        resultValue = -1;
  }
  
}

on sysvar_update sysvar::CEM::Backbone::Signals::Control::UB::DispBattStsAndBattChrgOkNotOk_UB_Control
{
  long resultValue;
  
  // --- FR ---
  setBusContext(getBusNameContext(gFR1BusName));
  switch(@this)
  {
     Case(this::SignalUBOFF) :
        resultValue = DisturbUB(Backbone::CEM::CEMBackBoneSignalIpdu17::DispBattStsAndBattChrgOkNotOk_UB,0,-1,0); break;
     Case(this::SignalUBHandled) :
        resultValue = DisturbUB(Backbone::CEM::CEMBackBoneSignalIpdu17::DispBattStsAndBattChrgOkNotOk_UB,0,0,0); break;
     Case(this::SignalUBON) :
        resultValue = DisturbUB(Backbone::CEM::CEMBackBoneSignalIpdu17::DispBattStsAndBattChrgOkNotOk_UB,0,-1,1); break;
     Default :
        resultValue = -1;
  }
  
}

on sysvar_update sysvar::CEM::Backbone::Signals::Control::UB::VehicleAge_UB_Control
{
  long resultValue;
  
  // --- FR ---
  setBusContext(getBusNameContext(gFR1BusName));
  switch(@this)
  {
     Case(this::SignalUBOFF) :
        resultValue = DisturbUB(Backbone::CEM::CEMBackBoneSignalIpdu17::VehicleAge_UB,0,-1,0); break;
     Case(this::SignalUBHandled) :
        resultValue = DisturbUB(Backbone::CEM::CEMBackBoneSignalIpdu17::VehicleAge_UB,0,0,0); break;
     Case(this::SignalUBON) :
        resultValue = DisturbUB(Backbone::CEM::CEMBackBoneSignalIpdu17::VehicleAge_UB,0,-1,1); break;
     Default :
        resultValue = -1;
  }
  
}

on sysvar_update sysvar::IL_FR1::NODES::N_CEM::EnableNode
{
  ILFR1_Enable(@this && @sysvar::IL_FR1::enable_AllNodes);
}

on sysvar_update sysvar::IL_FR1::enable_AllNodes
{
  ILFR1_Enable(@this && @sysvar::IL_FR1::NODES::N_CEM::EnableNode);
}

on sysvar_update sysvar::NM_FR1::NODES::N_CEM::DeactivateNM
{
  if( @this == 1 || @sysvar::NM_FR1::StateControl::DeactivateNM == 1)
  {
    NMFR1_Enable(0);
  }
  else
  {
    NMFR1_Enable(1);
  }
}

on sysvar_update sysvar::NM_FR1::StateControl::DeactivateNM
{
  if( @this == 1 || @sysvar::NM_FR1::NODES::N_CEM::DeactivateNM == 1)
  {
    NMFR1_Enable(0);
  }
  else
  {
    NMFR1_Enable(1);
  }
}

/* #ChannelEnd# |FR1| #BusEnd# |Backbone| */
//--- end generated part --- Block end <#SysVar_Handler#> do not delete this line! Add application code below this line.

//--- begin generated part --- Block start <#MsgUpdateFcns#> do not delete this line and do not add application code in this code block!
/* #ChannelStart# |FR1| #BusStart# |Backbone| */
/* #ChannelEnd# |FR1| #BusEnd# |Backbone| */
//--- end generated part --- Block end <#MsgUpdateFcns#> do not delete this line! Add application code below this line.

