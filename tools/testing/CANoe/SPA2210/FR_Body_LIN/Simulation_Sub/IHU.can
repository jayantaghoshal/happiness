includes
{
  #include "..\..\SPAIncludes\SPACommon_Common_SPAIL.cin" //@SPECINC::COMMON@
  #include "..\..\SPAIncludes\SPACommon_FRNM_SPAIL.cin" //@SPECINC::FRNM@
  #include "..\..\SPAIncludes\SPACommon_FRIL.cin" //@SPECINC::FRIL@
  #include "..\GWIncludes\IHU_GW.cin" //@GWINC@
}
