includes
{
  #include "..\..\SPAIncludes\SPACommon_CANNM.cin" //@SPECINC::CANNM@
  #include "..\..\SPAIncludes\SPACommon_Common_SPAIL.cin" //@SPECINC::COMMON@
  #include "..\..\SPAIncludes\SPACommon_SPACANIL.cin" //@SPECINC::CANIL@
  #include "..\GWIncludes\DDM_GW.cin" //@GWINC@
}
