includes
{
  #include "..\..\..\InfotainmentModules\Node_basic_includes\SWSM_eventhandler.cin" //@SPECINC::Panel@
  #include "..\GWIncludes\SWSM_GW.cin" //@GWINC@
}
