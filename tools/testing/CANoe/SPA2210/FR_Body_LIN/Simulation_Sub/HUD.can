includes
{
  #include "..\GWIncludes\HUD_GW.cin" //@GWINC@
}
